## meta-openeuler/conf/machine/generic-x86-64.conf
```bitbake
#@TYPE: Machine
#@NAME: x86-64 machine
#@DESCRIPTION: Machine configuration for running an x86-64 system

require conf/machine/include/qemu.inc

DEFAULTTUNE ?= "x86-64"
require conf/machine/include/x86/arch-x86.inc

KERNEL_IMAGETYPE =. "bzImage"
KERNEL_IMAGETYPE_FOR_MAKE =. "bzImage"

MACHINE_FEATURES += "x86 efi"

# kernel modules to install and autoload
require conf/machine/include/kernel-modules-conf/iso-install.inc
require conf/machine/include/kernel-modules-conf/x86-64-modules.inc
KERNEL_MODULE_AUTOLOAD = "${INSTALLMODULES}"

# specify the suffix of packages for installation of rootfs
export ROOTFS_PACKAGE_ARCH = "x86_64"

# serial console setting
SERIAL_CONSOLES ?= "115200;ttyS0"
# Enable tty1 by default
USE_VT="1"

# cmdline
APPEND += "console=ttyS0,115200 console=tty1"

# set hostname to openEuler-Embedded
hostname:pn-base-files = "openEuler-Embedded"
MCS_FEATURES = "openamp"

# qemuboot options
QB_SYSTEM_NAME = "qemu-system-x86_64"
# get the first item from IMAGE_FSTYPES
QB_DEFAULT_FSTYPE = "${@d.getVar('IMAGE_FSTYPES').split(' ')[0]}"
QB_SMP = "-smp 4"
QB_CPU:x86 = "-cpu IvyBridge -machine q35"
QB_CPU_KVM:x86 = "-cpu IvyBridge -machine q35"

QB_CPU:x86-64 = "-cpu IvyBridge -machine q35"
QB_CPU_KVM:x86-64 = "-cpu IvyBridge -machine q35"

QB_AUDIO_DRV = "alsa"
QB_AUDIO_OPT = "-device AC97"
QB_KERNEL_CMDLINE_APPEND = "oprofile.timer=1 tsc=reliable no_timer_check rcupdate.rcu_expedited=1"
QB_OPT_APPEND = "-usb -device usb-tablet"

# set network configure like openeuler guide
QB_TAP_OPT = "-netdev tap,id=tap0,script=/etc/qemu-ifup"
QB_NETWORK_DEVICE = "-device virtio-net-device,netdev=tap0"
```

## meta-openeuler/conf/machine/include/kernel-modules-conf/common.inc
```bitbake
INSTALLMODULES = " \
kernel-module-overlay \
kernel-module-8021q \
kernel-module-ext2 \
kernel-module-inet-diag \
kernel-module-ip-tunnel \
kernel-module-ip6-udp-tunnel \
kernel-module-ipip \
kernel-module-ipt-reject \
kernel-module-ipv6 \
kernel-module-nf-defrag-ipv6 \
kernel-module-nf-nat \
kernel-module-nf-reject-ipv4 \
kernel-module-nf-reject-ipv6 \
kernel-module-xt-tcpudp \
kernel-module-tunnel4 \
kernel-module-af-packet \
kernel-module-nfs-ssc \
kernel-module-fscache \
kernel-module-grace \
kernel-module-sunrpc \
kernel-module-auth-rpcgss \
kernel-module-lockd \
kernel-module-nfs-acl \
kernel-module-nfs \
kernel-module-nfsv3 \
kernel-module-nfsd \
kernel-module-crc-ccitt \
kernel-module-ip6table-nat \
kernel-module-ip6t-reject \
kernel-module-xt-nat \
"
```

## meta-openeuler/conf/machine/include/kernel-modules-conf/x86-64-modules.inc
```bitbake
INSTALLMODULES += " \
kernel-module-ipv6 \
kernel-module-ip6table-filter \
kernel-module-ip6table-mangle \
kernel-module-ip6table-raw \
kernel-module-iptable-filter \
kernel-module-iptable-mangle \
kernel-module-iptable-raw \
kernel-module-ipt-reject \
kernel-module-sg \
kernel-module-joydev \
kernel-module-pcspkr \
kernel-module-fuse \
kernel-module-sr-mod \
kernel-module-ata-generic \
kernel-module-igb \
kernel-module-igc \
kernel-module-chipreg \
kernel-module-mtdblock \
kernel-module-nfsd \
kernel-module-xhci-plat-hcd \
kernel-module-vfat \
kernel-module-quota-v1 \
kernel-module-quota-v2 \
kernel-module-virtio-net \
kernel-module-virtio-balloon \
kernel-module-virtio-console \
kernel-module-virtio-gpu \
kernel-module-ixgbe \
kernel-module-i40e \
kernel-module-e1000e \
kernel-module-r8169 \
"
```

## meta-openeuler/conf/machine/include/qemu-aarch64-common.inc
```bitbake
# Description: Config for arm64 machine

KERNEL_IMAGETYPE =. "zImage"
KERNEL_IMAGETYPE_FOR_MAKE =. "zImage Image"

#kernel modules to install and autoload
require conf/machine/include/kernel-modules-conf/common.inc
require conf/machine/include/kernel-modules-conf/iso-install.inc
KERNEL_MODULE_AUTOLOAD = "${INSTALLMODULES}"

# Different from arm32, here we use armv8a.inc instead
# of conf/machine/include/tune-cortexa53.inc because
# we are not sure our CPU is cortex a53.
require conf/machine/include/arm/arch-armv8a.inc

# but we are sure in compat32 we should use -mcpu=cortexa9.
# This may be not correct, but to make sure compat32 and arm32
# generate the same binary.
# Should not use conf/machine/include/tune-cortexa9.inc directly.
# In case when using compat32, we alert cflags with same way in tune-cortexa9.inc

TUNE_CCARGS .= "${@bb.utils.contains('TUNE_FEATURES', 'cortexa9', ' -mtune=cortex-a9', '', d)}"
MACHINEOVERRIDES =. "${@bb.utils.contains('TUNE_FEATURES', 'cortexa9', 'armv7a:', '' ,d)}"

TUNE_FEATURES:append:virtclass-multilib-lib32 = " cortexa9"
TUNE_FEATURES:remove:virtclass-multilib-lib32 = " vfp"

# simplest serial console setting, no VT
SERIAL_CONSOLES ?= "115200;ttyAMA0"
USE_VT ?= "0"
# make a APPEND cmdline for grub.cfg while using iso with grub
APPEND += " console=ttyAMA0,115200 "
```
