## meta-openeuler/conf/distro/include/tcmode-external-openeuler.inc
```bitbake
require conf/distro/include/tcmode-external.inc

# Use tuning-defined baselib to align with multilib and external toolchain
baselib = "${@d.getVar('BASE_LIB:tune-' + (d.getVar('DEFAULTTUNE') or 'INVALID')) or d.getVar('BASELIB')}"

# Ensure that the licensing variables are available to the toolchain.
export MGLS_LICENSE_FILE
export LM_LICENSE_FILE

# canon-prefix-map was introduced in gcc 13, but openEuler's external toolchain
# uses GCC 12.3 which does not support it. Remove it from DEBUG_PREFIX_MAP.
REMOVE_CANON_PREFIX_MAP = "-fcanon-prefix-map"
DEBUG_PREFIX_MAP:remove = "${REMOVE_CANON_PREFIX_MAP}"

python openeuler_metadata_setup () {
    # Ensure that changes to toolchain licensing don't affect checksums
    license_vars = ['MGLS_LICENSE_FILE', 'LM_LICENSE_FILE']
    d.appendVar('BB_BASEHASH_IGNORE_VARS', ' ' + ' '.join(license_vars))
}
openeuler_metadata_setup[eventmask] = "bb.event.ConfigParsed"
addhandler openeuler_metadata_setup
```

## meta-openeuler/conf/distro/include/tcmode-gcc-bin.inc
```bitbake
PREFERRED_PROVIDER_gmp-native = "gcc-bin-toolchain-cross-${TARGET_ARCH}"
PREFERRED_PROVIDER_libmpc-native = "gcc-bin-toolchain-cross-${TARGET_ARCH}"
PREFERRED_PROVIDER_mpfr-native = "gcc-bin-toolchain-cross-${TARGET_ARCH}"
PREFERRED_PROVIDER_virtual/${TARGET_PREFIX}binutils = "gcc-bin-toolchain-cross-${TARGET_ARCH}"
PREFERRED_PROVIDER_virtual/${TARGET_PREFIX}gcc = "gcc-bin-toolchain-cross-${TARGET_ARCH}"
PREFERRED_PROVIDER_virtual/${TARGET_PREFIX}g++ = "gcc-bin-toolchain-cross-${TARGET_ARCH}"
PREFERRED_PROVIDER_virtual/${TARGET_PREFIX}compilerlibs = "gcc-bin-toolchain-compilerlibs-${TARGET_ARCH}"
PREFERRED_PROVIDER_gcc-runtime = "gcc-bin-toolchain-compilerlibs-${TARGET_ARCH}"
PREFERRED_PROVIDER_virtual/libc = "glibc"
PREFERRED_PROVIDER_virtual/libc-headers = "linux-libc-headers"
PREFERRED_PROVIDER_libstdc++ = "gcc-bin-toolchain-compilerlibs-${TARGET_ARCH}"
PREFERRED_PROVIDER_libgcc-initial = "gcc-bin-toolchain-compilerlibs-${TARGET_ARCH}"

PATH_append = ":${COMPONENTS_DIR}/${BUILD_ARCH}/gcc-bin-toolchain-cross-${TARGET_ARCH}/bin"

#cannot set with linaro gcc,set it null
DEBUG_PREFIX_MAP = ""
```

## meta-openeuler/conf/distro/openeuler.conf
```bitbake
include conf/distro/include/phosphor-base.inc

## current conf version
LOCALCONF_VERSION = "2"

## DISTRO information
DISTRO = "openeuler"
DISTRO_NAME = "openEuler Embedded Reference Distro"
# note: change DISTRO_VERSION in release branch
DISTRO_VERSION = "latest"
DISTRO_CODENAME = "oEE"
MAINTAINER = "openEuler <dev@openeuler.org>"
TARGET_VENDOR = "-openeuler"

## runtime/rootfs related configurations
# define default init and device manager
# INIT_MANAGER set VIRTUAL-RUNTIME_dev_manager when expanding,
# but packagegroup-core-boot.bb will set VIRTUAL-RUNTIME_dev_manager to udev, it has a higher priority
# than init-manager-xxx.inc, because ? priority is higher than ??
# so we set VIRTUAL-RUNTIME_dev_manager explicitly here, use busybox or systemd, no eudev except declared in local.conf
# or when sysvinit is enabled, set VIRTUAL-RUNTIME_dev_manager explicitly.
INIT_MANAGER ?= "systemd"
VIRTUAL-RUNTIME_dev_manager = "${@['systemd', 'busybox-mdev']['${INIT_MANAGER}' == 'mdev-busybox']}"
PREFERRED_PROVIDER_base-utils = "${@['packagegroup-core-base-utils', 'busybox']['${INIT_MANAGER}' == 'mdev-busybox']}"
VIRTUAL-RUNTIME_base-utils = "${@['packagegroup-core-base-utils', 'busybox']['${INIT_MANAGER}' == 'mdev-busybox']}"
VIRTUAL-RUNTIME_base-utils-hwclock = "${@['util-linux-hwclock', 'busybox-hwclock']['${INIT_MANAGER}' == 'mdev-busybox']}"
VIRTUAL-RUNTIME_base-utils-syslog = "${@['', 'busybox-syslog']['${INIT_MANAGER}' == 'mdev-busybox']}"
VIRTUAL-RUNTIME_syslog = "${@['rsyslog', '']['${INIT_MANAGER}' == 'mdev-busybox']}"

# pam package is used for authentication
OPENEULER_DEFAULT_DISTRO_FEATURES = "pam"
# define root home, default /home/root
ROOT_HOME ?= "/root"
# list of container engine (like cri-o, wasm-edge, docker, podman, containerd, isulad)
# currently we support "isulad", "containerd"
# usefull for higher version of meta-virtualization
VIRTUAL-RUNTIME_container_engine ?= ""
# containers: Enable container runtime support (kernel configs, basic container infrastructure)

DISTRO_FEATURES ?= "${DISTRO_FEATURES_DEFAULT} ${OPENEULER_DEFAULT_DISTRO_FEATURES}"

# if init manager is busybox sysvinit should be
# added into DISTRO_FEATURES
DISTRO_FEATURES += "${@['', 'sysvinit']['${INIT_MANAGER}' == 'mdev-busybox']}"

# remove currently unsupported features in openeuler embedded
# \todo: explicitly define the DISTRO_FEATURES_DEFAULT of openeuler embedded
DISTRO_FEATURES_DEFAULT:remove = "x11 3g phone nfc"

## kernel related configurations
# kernel 6.6 is the default (Scarthgap LTS kernel); 5.10 support removed
OLDEST_KERNEL:forcevariable = "6.6"
# force python3 base version to 3.11; scarthgap's python3-dir.bbclass defaults to 3.12
PYTHON_BASEVERSION:forcevariable = "3.11"
# set default kernel provider
PREFERRED_PROVIDER_virtual/kernel ?= "linux-openeuler"
# set default kernel version: 6.6 (24.03 LTS / Scarthgap)
PREFERRED_VERSION_linux-openeuler ?= "6.6%"
PREFERRED_VERSION_linux-openeuler-rt ?= "6.6%"
# enable kernel6 DISTRO_FEATURE so linux-openeuler.inc selects 6.6 paths
DISTRO_FEATURES:append = " kernel6"
# dhcp-relay provider
PREFERRED_PROVIDER_dhcp-relay ?= "dhcp"

# atk and at-spi2-atk provider
PREFERRED_PROVIDER_atk ?= "at-spi2-core"
PREFERRED_PROVIDER_atk-native ?= "at-spi2-core-native"
PREFERRED_PROVIDER_nativesdk-atk ?= "nativesdk-at-spi2-core"
PREFERRED_PROVIDER_at-spi2-atk ?= "at-spi2-core"
PREFERRED_PROVIDER_at-spi2-atk-native ?= "at-spi2-core-native"
PREFERRED_PROVIDER_nativesdk-at-spi2-atk ?= "nativesdk-at-spi2-core"

## build related configurations
# SOURCE_DATE_EPOCH is set once per BitBake session by the parse_manifest
# handler in openeuler.bbclass (bb.event.ConfigParsed → get_openeuler_epoch).
# The '0' here is a safe fallback only; it is always overridden at runtime.
SOURCE_DATE_EPOCH ?= "0"
# do not split packages for debug purpose
INHIBIT_PACKAGE_DEBUG_SPLIT = "1"


## SDK related configurations
SDK_VENDOR = "-openeulersdk"
SDK_VERSION = "${@d.getVar('DISTRO_VERSION').replace('snapshot-${METADATA_REVISION}', 'snapshot')}"
SDK_VERSION[vardepvalue] = "${SDK_VERSION}"
# set SDK name
SDK_NAME = "${DISTRO}-${TCLIBC}-${SDKMACHINE}-${IMAGE_BASENAME}-${TUNE_PKGARCH}-${MACHINE}"
# The path to default to installing the SDK to
SDKPATHINSTALL = "/opt/${DISTRO}/${SDK_NAME_PREFIX}-${SDK_ARCH}"
# no include buildtools in sdk generation
SDK_INCLUDE_BUILDTOOLS = "0"


## toolchain and c library related configurations
TCLIBCAPPEND = ""
# by default glibc is used
TCLIBC ?= "glibc"
# openeuler use external toolchain, see tcmode-external.inc
TCMODE-LIBC ?= "glibc-external"
TCMODE-CRYPT ?= "libxcrypt-external"

### OUTPUT_DIR point to image installation directory
OUTPUTTIME = "${DATETIME}"
# Ignore how DATETIME is computed
OUTPUTTIME[vardepsexclude] = "DATETIME"
OUTPUT_DIR = "${TOPDIR}/output/${OUTPUTTIME}"
# Ignore how TOPDIR is computed
OUTPUT_DIR[vardepsexclude] = "TOPDIR"

## fetch and source dir related configurations
# set the maximum parallel number of source code download tasks to 4
do_fetch[number_threads] = "4"
# for software packages adapted in openeuler, remove the original external uri
OPENEULER_SRC_URI_REMOVE ?= "https git http"
# do not use default download dir, use openeuler's configuration
OPENEULER_LOCAL_NAME ?= "${BPN}"
# use OPENEULER_REPO_NAMES to match the content of the manifest.yaml file for downloading the code
OPENEULER_REPO_NAMES ?= "${OPENEULER_LOCAL_NAME}"
OPENEULER_DL_DIR ?= "${OPENEULER_SP_DIR}/openeuler/${OPENEULER_LOCAL_NAME}"
DL_DIR ?= "${OPENEULER_SP_DIR}/downloads"
# for all .bb file, OPENEULER_SP_DIR  will be included
# in file path.
# According to yocto's mechanism of setting FILESPATH,
# openEuler repos's path has a higher priority than yocto's path.
# For example,  file://busybox.conf may exist both yocto's path and openeuler's
# repo path. by default, openeuler's busybox.conf will be used not yocto's.
# However this may cause some issues,  the unmatch of runtime conf from openeuler
# and build configuration from yocto. Taking rsyslog as example, yocto's build
# does not enable imjournal module, but the rsyslog.conf from openeuler assume
# imjournal module enabled with systemd, this unmatch will cause error of rsyslog.
# A better way is to use yocto's rsyslog.conf to match yocto's build.
# To fix it, you can do it in ryslog.bbappend, or set yocto's path has a higher priority
# than openeuler's path the following :
##FILEPATH:append = ":${OPENEULER_DL_DIR}:"
##FILEPATH:append = "${OPENEULER_SP_DIR}/openeuler:"
# if you want yocto's path has a higher priority
# than openeuler's path, then comment FILESEXTRAPATHS lines,
# and use FILEPATH lines
FILESEXTRAPATHS:prepend = "${OPENEULER_DL_DIR}:"
FILESEXTRAPATHS:prepend = "${OPENEULER_SP_DIR}/openeuler:"
# cache SRCREV during parsing to avoid re-querying remote servers for AUTOREV.
# SRCREV for openeuler-adapted recipes is set via src_uri_set (RecipePostKeyExpansion)
# and kept current by bb.parse.mark_dependency on manifest.yaml — no need to set
# BB_SRCREV_POLICY = "clear" for manifest changes to take effect.
BB_SRCREV_POLICY ?= "cache"

## task hash configuration for openEuler
BB_SIGNATURE_HANDLER ?= "OEEquivHash"
BB_HASHSERVE ??= "auto"
## the openeuler related variables and functions should not be included in
## task hash generation
# OPENEULER_SP_DIR is frequently changed
# do_openeuler_fetch is still evolving, so exclude it, if required, run it forcedly
BB_BASEHASH_IGNORE_VARS:append = " OPENEULER_SP_DIR do_openeuler_fetch MANIFEST_LIST"

## set CONNECTIVITY_CHECK_URIS to empty to disable url checkstatus
CONNECTIVITY_CHECK_URIS = ""

## host tools related configurations
# used to unpack source such as *.tar.xz, *.rpm, etc
# some python3 scripts still use old shebang  #!/usr/bin/env python, so add python here to keep compatible
# yocto-poky only adds python3 in HOSTTOOLS
HOSTTOOLS += "xz xzcat"
HOSTTOOLS_NONFATAL += "python"

## bsp related configurations
require conf/distro/openeuler-bsp.conf

## all bb files should inherit openeuler.bbclass
INHERIT += "openeuler"

# The openeuler-image-live as the live-os.
# When LIVE_ROOTFS_TYPE defined, bug may come out in poky, so just use default value ext4 in image-live.bbclass.
# Notice: We need MACHINE_FEATURES += "efi" in machine conf
INITRD_IMAGE_LIVE ?= "openeuler-image-live"

# not set INITRAMFS MAXSIZE
INITRAMFS_MAXSIZE = ""

# alsa-utils-scripts merge to alsa-utils from 1.2.8
PREFERRED_PROVIDER_alsa-utils-scripts ?= "alsa-utils"

PREFERRED_VERSION_xen ?= "4.18%"
PREFERRED_VERSION_xen-tools ?= "4.18%"
```

## meta-openeuler/conf/layer.conf
```bitbake
# We have a conf and classes directory, add to BBPATH
BBPATH =. "${LAYERDIR}:"

# We have recipes-* directories, add to BBFILES
BBFILES += "${LAYERDIR}/recipes-*/*/*.bb \
            ${LAYERDIR}/recipes-*/*/*.bbappend"

BBFILE_COLLECTIONS += "openeuler"
BBFILE_PATTERN_openeuler = "^${LAYERDIR}/"
BBFILE_PRIORITY_openeuler = "30"

LAYERSERIES_COMPAT_openeuler = "kirkstone"

# This should only be incremented on significant changes that will
# cause compatibility issues with other layers
LAYERVERSION_openeuler = "13"

LAYERDEPENDS_openeuler = "core"

REQUIRED_POKY_BBLAYERS_CONF_VERSION = "2"

# The dynamic-layers directory hosts the extensions and layer specific
# modifications.
#
# The .bbappend and .bb files are included if the respective layer
# collection is available.
BBFILES_DYNAMIC += " \
openembedded-layer:${LAYERDIR}/dynamic-layers/openembedded-layer/recipes-*/*/*.bb \
openembedded-layer:${LAYERDIR}/dynamic-layers/openembedded-layer/recipes-*/*/*.bbappend \
multimedia-layer:${LAYERDIR}/dynamic-layers/multimedia-layer/recipes-*/*/*.bb \
multimedia-layer:${LAYERDIR}/dynamic-layers/multimedia-layer/recipes-*/*/*.bbappend \
meta-python:${LAYERDIR}/dynamic-layers/meta-python/recipes-*/*/*.bb \
meta-python:${LAYERDIR}/dynamic-layers/meta-python/recipes-*/*/*.bbappend \
networking-layer:${LAYERDIR}/dynamic-layers/networking-layer/recipes-*/*/*.bb \
networking-layer:${LAYERDIR}/dynamic-layers/networking-layer/recipes-*/*/*.bbappend \
qt5-layer:${LAYERDIR}/dynamic-layers/qt5-layer/recipes-*/*/*.bb \
qt5-layer:${LAYERDIR}/dynamic-layers/qt5-layer/recipes-*/*/*.bbappend \
"

# enable .bb under clang-layer/ when exist meta-clang
BBFILES_DYNAMIC += " \
clang-layer:${LAYERDIR}/dynamic-layers/clang-layer/recipes-*/*/*.bb \
clang-layer:${LAYERDIR}/dynamic-layers/clang-layer/recipes-*/*/*.bbappend \
"

# enable .bb under ros2-layer/ when exist meta-ros
BBFILES_DYNAMIC += " \
ros2-layer:${LAYERDIR}/dynamic-layers/ros2-layer/recipes-*/*/*.bb \
ros2-layer:${LAYERDIR}/dynamic-layers/ros2-layer/recipes-*/*/*.bbappend \
"

# enable .bb under phosphor-layer/ when exist meta-phosphor
BBFILES_DYNAMIC += " \
phosphor-layer:${LAYERDIR}/dynamic-layers/phosphor-layer/recipes-*/*/*.bb \
phosphor-layer:${LAYERDIR}/dynamic-layers/phosphor-layer/recipes-*/*/*.bbappend \
"

# For get lib dir under meta-openeuler by external_run
LAYERDIR_openeuler = "${LAYERDIR}"
# These will rebuild when EXTERNAL_TOOLCHAIN changes, but we don't want
# everything to rebuild in such a case.
SIGGEN_EXCLUDERECIPES_ABISAFE += "\
    gcc-external-cross \
    gcc-external-cross-${TARGET_ARCH} \
    binutils-external-cross  \
    binutils-external-cross-${TARGET_ARCH} \
"

# add openeuler related licenses
LICENSE_PATH += "${LAYERDIR}/licenses"

# Needed for external_run() for PV & LICENSE in the recipes, to be able to parse
INHERIT:append = " external_global"

# Fallback default for when the tcmode isn't sourced
GCC_VERSION ?= "0.0"

# open or close OPENFULER_FETCH function through seting global param OPENEULER_FETCH
# default enable for opening or you set it disable for closing
# if you want to build with your own src code, you can set OPENEULER_FETCH disable, thus
# it will not download or fetch automatic anymore when compilling, you also can set it in 
# your repo bb or bbappend file. 
# for example, you can set it enable global and set it disable in some one repo's bb or 
# bbappend file, when running compile, the other repo will run openeuler_fetch continue and
# the repo you set it OPENEULER_FETCH disable will not do it
OPENEULER_FETCH = "enable"

# openeuler decoupled ros runtime package but in meta-ros blacklist, so we remove from blacklist here:
require openeuler-ros-distro-recipe-blacklist.inc
```
