## bsp/meta-phytium/conf/machine/phytium-ft2000-4.conf
```bitbake
require conf/machine/include/arm/arch-armv8a.inc

MACHINEOVERRIDES =. "phytium:march64le:"
MACHINE_FEATURES =. "efi pci serial usbhost ext2 ext3 ext4"
DEFAULTTUNE = "aarch64"

require conf/multilib.conf
# currently, don't support 32 bit libs
MULTILIBS = ""

ROOTFS_PACKAGE_ARCH = "aarch64"

KERNEL_IMAGETYPE = "Image"

# arm and arm64 both support -mlittle-endian so no
# need to consider compat32.
TUNE_CCARGS .= " -mlittle-endian"
```

## bsp/meta-phytium/conf/machine/phytium.conf
```bitbake
require conf/machine/include/phytium-base.inc

MACHINE_FEATURES =. "pci serial usbhost ext2 ext3 ext4 efi"

# serial console setting
SERIAL_CONSOLES = "115200;ttyAMA1 115200;ttyAMA0"
SERIAL_CONSOLES_CHECK ?= "${SERIAL_CONSOLES}"

# The default fitimage requires the Image.gz file.
KERNEL_IMAGETYPE = "Image.gz"

# this FSTYPE is required for sdcard image generated by genimage
IMAGE_FSTYPES = "tar.gz ext4 genimage iso wic"

IMGCLASSES:append = " image_types_genimage"

# phytiumpi.config needs phyuboot to provide bootloader: fip-all.bin
EXTRA_IMAGEDEPENDS += "phyuboot"
GENIMAGE_CONFIG_FILE = "${BOOT}-${MACHINE}.config"

# efi, sdcard
BOOT = "${@bb.utils.contains('MACHINE_FEATURES', 'sd', 'sdcard', 'efi', d)}"
WKS_FILE = "efi-image-phytium.wks"
```

## bsp/meta-phytium/conf/machine/phytiumpi.conf
```bitbake
require conf/machine/include/e2000.inc

MACHINEOVERRIDES =. "phytiumpi:march64le:"
MACHINE_FEATURES =. "pci serial usbhost ext2 ext3 ext4"

# serial console setting
SERIAL_CONSOLES = "115200;ttyAMA1"

# The default fitimage requires the Image.gz file.
KERNEL_IMAGETYPE = "Image.gz"
KERNEL_DEVICETREE = "phytium/phytiumpi_firefly.dtb"

# this FSTYPE is required for sdcard image generated by genimage
IMAGE_FSTYPES = "tar.gz ext4 genimage"

IMGCLASSES:append = " image_types_genimage"
# phytiumpi.config needs phyuboot to provide bootloader: fip-all.bin
EXTRA_IMAGEDEPENDS += "phyuboot"
GENIMAGE_CONFIG_FILE = "sdcard-phytiumpi.config"
```

## bsp/meta-phytium/recipes-kernel/linux/files/phytiumpi.its
```
/*
 * Compilation:
 * mkimage -f fit_kernel_dtb.its fit_kernel_dtb.itb
 *
 * Files in linux build dir:
 * - arch/arm/boot/Image (zImage-old-ok)
 * - arch/arm/boot/dts/ft.dtb
 *
 * fatload usb 0:1 0x90100000 fit_kernel_dtb.itb
 * bootm 0x90100000#e2000
 *
 */

/dts-v1/;
/ {
	description = "U-Boot fitImage for Phytium Phytiumpi";
	#address-cells = <1>;

	images {
		kernel {
			description = "Linux kernel";
			data = /incbin/("arch/arm64/boot/Image.gz");
			type = "kernel";
			arch = "arm64";
			os = "linux";
			compression = "gzip";
			load =  <0x80080000>;
			entry = <0x80080000>;
			hash-1 {
				algo = "sha1";
			};
		};

		fdt-phytium {
			description = "FDT phytiumpi";
			data = /incbin/("arch/arm64/boot/dts/phytium/phytiumpi_firefly.dtb");
			type = "flat_dt";
			arch = "arm64";
			compression = "none";
			hash-1 {
				algo = "sha1";
			};
		};
	};

	configurations {
		default = "phytium@cecport";

		phytium {
			description = "phytimpi";
			kernel = "kernel";
			fdt = "fdt-phytium";
			hash-1 {
				algo = "sha1";
			};
		};

	};
};
```

## bsp/meta-phytium/wic/efi-image-phytium.wks
```
# short-description: partitioned image with necessary layout
# long-description: This image contains boot partition and rootfs partitions

part /boot --source bootimg-efi --sourceparams="loader=grub-efi" --ondisk sda --label boot --active --align 4096
part / --source rootfs --ondisk sda --fstype=ext4 --label platform --align 4096 --use-uuid --size=4096

bootloader --ptable gpt --timeout=5  --append="rw console=tty0"
```

## bsp/meta-rockchip/conf/layer.conf
```bitbake
# We have a conf and classes directory, add to BBPATH
BBPATH .= ":${LAYERDIR}"

# We have recipes-* directories, add to BBFILES
BBFILES += "${LAYERDIR}/recipes-*/*/*.bb \
            ${LAYERDIR}/recipes-*/*/*.bbappend"

BBFILE_COLLECTIONS += "rockchip"
BBFILE_PATTERN_rockchip := "^${LAYERDIR}/"
BBFILE_PRIORITY_rockchip = "6"

LAYERDEPENDS_rockchip = "core"
LAYERSERIES_COMPAT_rockchip = "kirkstone"

# enable .bb under qt5-layer/ when exist meta-qt5
BBFILES_DYNAMIC += " \
qt5-layer:${LAYERDIR}/dynamic-layers/qt5-layer/recipes-*/*/*.bb \
qt5-layer:${LAYERDIR}/dynamic-layers/qt5-layer/recipes-*/*/*.bbappend \
"
```

## bsp/meta-rockchip/conf/machine/include/rk3568.inc
```bitbake
require conf/machine/include/arm/armv8-2a/tune-cortexa55.inc
MACHINE_FEATURES += "efi pci vc4graphics"
MACHINEOVERRIDES =. "rk3568:march64le:"
DEFAULTTUNE = "aarch64"

require conf/multilib.conf
# currently, don't support 32 bit libs
MULTILIBS = ""

ROOTFS_PACKAGE_ARCH = "aarch64"

# set IMAGETYPE and dtb
KERNEL_IMAGETYPE = "Image"
# choose dtb file
RK3568_KERNEL_DTB_NAME ?= "OK3568-C-linux.dtb"
KERNEL_DEVICETREE = "rockchip/${RK3568_KERNEL_DTB_NAME}"
ENABLE_UART = "1"
# serial port enabled in ok3568
CMDLINE_SERIAL = "console=tty1 console=ttyFIQ0,115200"
SERIAL_CONSOLES = "115200;ttyFIQ0"

# arm and arm64 both support -mlittle-endian so no
# need to consider compat32.
TUNE_CCARGS .= " -mlittle-endian"
IMAGE_INSTALL:append = " kernel-modules"

# auto load module during startup
KERNEL_MODULE_AUTOLOAD = "mlan moal "

# set MCS_FEATURES
# rk3568 only supports the "openamp" mechanism,
# and client os only supports uniproton, rtt
MCS_FEATURES = "openamp"
MCS_FEATURES := "${@bb.utils.contains('DISTRO_FEATURES', 'mcs', '${MCS_FEATURES}', '', d)}"
```

## bsp/meta-rockchip/conf/machine/ok3568.conf
```bitbake
require conf/machine/include/rk3568.inc
KERNEL_MODULE_AUTOLOAD:append = " ${@bb.utils.contains('MCS_FEATURES', 'openamp', 'mcs_km', '', d)} "
```

## bsp/meta-rockchip/conf/machine/ryd-3568.conf
```bitbake
require conf/machine/include/rk3568.inc
RK3568_KERNEL_DTB_NAME = "rk3568-8897-ddr4-v1-linux-hdmi.dtb"
```

## bsp/meta-visionfive2/conf/layer.conf
```bitbake
# We have a conf and classes directory, add to BBPATH
BBPATH =. "${LAYERDIR}:"

# We have recipes-* directories, add to BBFILES
BBFILES += "${LAYERDIR}/recipes-*/*/*.bb \
            ${LAYERDIR}/recipes-*/*/*.bbappend"

BBFILE_COLLECTIONS += "meta-visionfive2"
BBFILE_PATTERN_meta-visionfive2 = "^${LAYERDIR}/"
BBFILE_PRIORITY_meta-visionfive2 = "7" 

LAYERVERSION_meta-visionfive2 = "1"
LAYERDEPENDS_meta-visionfive2 = "core"
LAYERSERIES_COMPAT_meta-visionfive2 = "kirkstone"
```

## bsp/meta-visionfive2/conf/machine/starfive-dubhe.conf
```bitbake
require conf/machine/include/riscv/tune-riscv.inc

MACHINEOVERRIDES =. "visionfive:mriscv64:"
MACHINE_FEATURES = "screen keyboard ext2 ext3 serial alsa pci usbhost"
DEFAULTTUNE ?= "riscv64"

export ROOTFS_PACKAGE_ARCH = "riscv64"

KERNEL_IMAGETYPE = "Image.gz"
KERNEL_IMAGETYPE_FOR_MAKE = "Image.gz"

BASE_LIB:tune-riscv64 = "lib64/lp64d"

require conf/multilib.conf
MULTILIBS = "" 

SERIAL_CONSOLES = "115200;ttyS0"

RISCV_SBI_FDT ?=  "jh7110-visionfive-v2.dtb"
KERNEL_DEVICETREE ?= "starfive/${RISCV_SBI_FDT}"  

RISCV_SBI_PLAT = "generic"
IMAGE_INSTALL:append = " kernel-modules"

# sd image partition
WKS_FILE = "sdimage-vfive2.wks"
# the final sd image is in wic format
IMAGE_FSTYPES = "wic.bz2"
# image, flatten device tree and vf2_uEnv.txt should be installed
# into the boot partition
IMAGE_BOOT_FILES = "${KERNEL_IMAGETYPE} ${RISCV_SBI_FDT} vf2_uEnv.txt"
```

## meta-airos/conf/layer.conf
```bitbake
# We have a conf and classes directory, add to BBPATH
BBPATH .= ":${LAYERDIR}"

# We have recipes-* directories, add to BBFILES
BBFILES += "${LAYERDIR}/recipes-*/*/*.bb \
            ${LAYERDIR}/recipes-*/*/*.bbappend"

BBFILE_COLLECTIONS += "meta-airos"
BBFILE_PATTERN_meta-airos = "^${LAYERDIR}/"
BBFILE_PRIORITY_meta-airos = "31"

LAYERDEPENDS_meta-airos = "core"
LAYERSERIES_COMPAT_meta-airos = "kirkstone"
```

## meta-clang/conf/distro/include/tcmode-external-clang.inc
```bitbake
EXTERNAL_CLANG ?= "clang"
CLANG_VERSION = "${@get_clang_version(d)}"
CLANG_VERSION_allarch = ""
CLANG_VERSION[vardepvalue] = "${CLANG_VERSION}"
BUILDCFG_VARS += "CLANG_VERSION"

PREFERRED_PROVIDER_clang-cross-${TARGET_ARCH} = "clang-external-cross-${TARGET_ARCH}"

# use gcc sysroot now, but set `--target=xxx` in wrapper script
HOST_CC_ARCH:remove:toolchain-clang = "-target ${HOST_SYS}"

# no need for clang
HOST_CC_ARCH:remove:toolchain-clang = "--no-sysroot-suffix"

TUNE_CCARGS:remove:toolchain-clang = "-Qunused-arguments"

# not use compiler-rt now, will be enable in the future.
COMPILER_RT:remove:runtime-gnu = "-rtlib=compiler-rt"

LDFLAGS:append:toolchain-clang:class-target:aarch64 = " -Wl,-dynamic-linker,${base_libdir}/ld-linux-aarch64.so.1"

TOOLCHAIN = "clang"
TOOLCHAIN:class-native = "clang"
TOOLCHAIN:class-cross = "clang"

BASEDEPENDS:toolchain-clang:class-native = " clang-native"
BASEDEPENDS:remove:pn-clang-native = "clang-native"

def get_clang_version(d):
    import os.path
    import re
    import subprocess
    import oe.path
    import bb
    version_output = ""
    toolchain_bin = d.getVar('EXTERNAL_TOOLCHAIN_CLANG_BIN')
    if toolchain_bin:
        path = os.path.join(toolchain_bin, d.getVar('EXTERNAL_CLANG'))
        cmd = path + " --version | head -n1"
        bb.debug(1, 'oe.external.run({})'.format(cmd))
        version_output = subprocess.getoutput(cmd)
        # clang version xx.yy.zz, here we get xx.yy.zz
        match = re.search("[0-9]+\.[0-9]+\.[0-9]", version_output)
        if match:
            return match.group()
    return 'UNKNOWN'
```

## meta-musl/conf/layer.conf
```bitbake
# We have a conf and classes directory, add to BBPATH
BBPATH =. "${LAYERDIR}:"

# We have recipes-* directories, add to BBFILES
BBFILES += "${LAYERDIR}/recipes-*/*/*.bb \
            ${LAYERDIR}/recipes-*/*/*.bbappend"

BBFILE_COLLECTIONS += "openeuler-musl"
BBFILE_PATTERN_openeuler-musl = "^${LAYERDIR}/"
BBFILE_PRIORITY_openeuler-musl = "25"

LAYERSERIES_COMPAT_openeuler-musl = "kirkstone"

# This should only be incremented on significant changes that will
# cause compatibility issues with other layers
LAYERVERSION_openeuler-musl = "13"

LAYERDEPENDS:openeuler-musl = "core"

REQUIRED_POKY_BBLAYERS_CONF_VERSION = "2"


# enable .bb under phosphor-layer/ when exist meta-phosphor
BBFILES_DYNAMIC += " \
phosphor-layer:${LAYERDIR}/dynamic-layers/phosphor-layer/recipes-*/*/*.bb \
phosphor-layer:${LAYERDIR}/dynamic-layers/phosphor-layer/recipes-*/*/*.bbappend \
"

# For get lib dir under meta-openeuler by external_run
LAYERDIR_openeuler = "${LAYERDIR}"
INHERIT += "musl"
```

## meta-openeuler/conf/bblayers.conf.sample
```bitbake
# POKY_BBLAYERS_CONF_VERSION is increased each time build/conf/bblayers.conf
# changes incompatibly
POKY_BBLAYERS_CONF_VERSION = "2"

BBPATH = "${TOPDIR}"
BBFILES ?= ""

BBLAYERS ?= " \
  ##OEROOT##/meta \
  ##OEROOT##/../yocto-meta-openembedded/meta-oe \
  ##OEROOT##/../yocto-meta-openembedded/meta-python \
  ##OEROOT##/../yocto-meta-openembedded/meta-networking \
  ##OEROOT##/../yocto-meta-openembedded/meta-filesystems \
  ##OEROOT##/../yocto-meta-ros/meta-ros-common \
  ##OEROOT##/../yocto-meta-ros/meta-ros2 \
  ##OEROOT##/../yocto-meta-ros/meta-ros2-humble \
  ##OEROOT##/../yocto-meta-openeuler/meta-openeuler \
  ##OEROOT##/../yocto-meta-openeuler/bsp/meta-openeuler-bsp \
  "
```

## meta-openeuler/conf/distro/include/openeuler_hosttools.inc
```bitbake
# to save initial build time, remove unnecessary software dependency, openeuler embedded will
# use as many as possible prebuilt nativesdk/host tools to replace native tools.
# this file has related HOSTTOOLS and ASSUME_PROVIDED settings.

HOSTTOOLS:remove = "chrpath cpp rpcgen"
HOSTTOOLS_NONFATAL += "chrpath cpp rpcgen"
# basic tools
HOSTTOOLS += "python3 python pod2man pkg-config"
HOSTTOOLS_NONFATAL += "gnu-configize"
# used by perl-native
HOSTTOOLS_NONFATAL += "cc"
ASSUME_PROVIDED += "util-linux-native pkgconfig-native chrpath-replacement-native"

# package management tools
HOSTTOOLS_NONFATAL += "rpm rpmbuild createrepo_c dnf unzip rpm2cpio"
ASSUME_PROVIDED += "rpm-native createrepo-c-native unzip-native"

# commands used by kernel build
HOSTTOOLS_NONFATAL += "flex bison bc kmod depmod insmod"
ASSUME_PROVIDED += "bc-native bison-native flex-native kmod-native"

# autotools related tools
HOSTTOOLS_NONFATAL += "automake autoreconf aclocal libtoolize m4 autoconf autoheader automake-1.16 aclocal-1.16 \
              libtool autopoint autoscan autom4te autoupdate"
ASSUME_PROVIDED += "automake-native autoconf-native libtool-native m4-native"

# source file build tools
HOSTTOOLS_NONFATAL += "cmake ninja"
ASSUME_PROVIDED += "cmake-native ninja-native make-native"

# used by cracklib, built from cracklib-native
HOSTTOOLS_NONFATAL += "create-cracklib-dict cracklib-format cracklib-packer cracklib-unpacker"

# commands for create image
HOSTTOOLS_NONFATAL += "ldconfig"
ASSUME_PROVIDED +="ldconfig-native "

# compress and decompress tools
HOSTTOOLS_NONFATAL += "xz"
ASSUME_PROVIDED += " pigz-native gzip-native"


# gettext amd documentation related tools
HOSTTOOLS_NONFATAL += "msgfmt msgmerge makeinfo xgettext"
ASSUME_PROVIDED += "texinfo-dummy-native gettext-native"

# openssl tools 
# temporarily remove openssl nativesdk and use openssl-native for bugs (cmake not found)
# HOSTTOOLS_NONFATAL += "openssl"

# command from glib2 used by gobject-introspection and libdnf
HOSTTOOLS_NONFATAL += "gtkdocize gtkdoc-scan gtkdoc-scangobj gtkdoc-mkdb gtkdoc-mkhtml gtkdoc-fixxref"

# commands used by iso and wic
HOSTTOOLS_NONFATAL += "cpio mkdosfs mcopy mkfs.ext4 debugfs fsck.ext4 dumpe2fs parted mkfs.vfat mmd"
ASSUME_PROVIDED += "cpio-native parted-native dosfstools-native  mtools-native bmap-tools-native gptfdisk-native"

# graphics related
ASSUME_PROVIDED +=  "pixman-native mesa-native virglrenderer-native libsdl2-native"

# audio related
ASSUME_PROVIDED += "alsa-lib-native"

#some commands added in poky by default do not used now, make it optional
HOSTTOOLS:remove = "diffstat lz4c pzstd"
HOSTTOOLS_NONFATAL += "diffstat lz4c pzstd"

SANITY_REQUIRED_UTILITIES:remove = "diffstat chrpath"
CONNECTIVITY_CHECK_URIS = ""

# Misc. assume provided software package
# tic used by ncurses-native
# zic used by tzdata(tzcode-native)
HOSTTOOLS_NONFATAL += "fmt gperf tic zic"

# the following are used to remove dependency
## tools required possibly required by linux-libc-hearders
ASSUME_PROVIDED += "unifdef-native rsync-native"
## prebuilt qemu is used (gobject-introspection), so no qemu-native and nativesdk-qemuwrapper-cross
ASSUME_PROVIDED += "qemu-native rsync-native nativesdk-qemuwrapper-cross"
HOSTTOOLS_NONFATAL += "qemu-aarch64 qemu-arm qemu-i386 qemu-ppc qemu-ppc64 qemu-pr-helper qemu-riscv32 qemu-riscv64 generic-x86_64 qemu-x86_64"
## dwarfsrcfiles-native is used in package.bbclass, it needs elfutil
## \todo remove dwarfsrcfiles-native after elfutil is added into nativesdk
ASSUME_PROVIDED += "dwarfsrcfiles-native"

# used by libpam
ASSUME_PROVIDED += "attr-native"
# used by make-mod-scripts
ASSUME_PROVIDED += "gmp-native"
# used by cracklib
ASSUME_PROVIDED += "cracklib-native"
# used by glib-2.0
ASSUME_PROVIDED += "glib-2.0-native"
# used by libarchive
ASSUME_PROVIDED += "e2fsprogs-native"
ASSUME_PROVIDED += "file-native"
# used by binutils
ASSUME_PROVIDED += "gnu-config-native"

ASSUME_PROVIDED += "gperf-native perl-native \
                    init-system-helpers \
                    nativesdk-glibc-locale \
                    gtk-doc-native \
                    "

HOSTTOOLS_NONFATAL += "dtc"
ASSUME_PROVIDED += "intltool-native"

# used by wayland
ASSUME_PROVIDED += "xorgproto-native expat-native"

# used by tcl
ASSUME_PROVIDED += "tcl-native"

# used by python3
# remove ASSUME_PROVIDED of openssl-native zlib-native for cmake not found bugs
ASSUME_PROVIDED += "bzip2-replacement-native libffi-native sqlite3-native \
        xz-native libtirpc-native libnsl2-native autoconf-archive-native \
        gdbm-native readline-native"

# used by harfbuzz
HOSTTOOLS_NONFATAL += "glib-mkenums"

# used by gstreamer1.0
HOSTTOOLS_NONFATAL += "xgettext"
```
