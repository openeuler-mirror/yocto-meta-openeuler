## bsp/meta-openeuler-bsp/conf/machine/include/openeuler-raspberrypi4-64.conf
```bitbake
require conf/multilib.conf
# currently, don't support 32 bit libs
MULTILIBS = ""

ROOTFS_PACKAGE_ARCH = "aarch64"

#set 0 to create zImage
RPI_USE_U_BOOT = "0"
KERNEL_IMAGETYPE_DIRECT = "Image"
ENABLE_UART = "1"
# serial port enabled by default in raspberrypi
CMDLINE_SERIAL = "console=tty1 console=ttyS0,115200"
# ttyS0 may use for ROS driver
# ttyAMA0 use for bluetooth
SERIAL_CONSOLES = ""

# now, we still use vc4-fkms-v3d.dtbo, not vc4-kms-v3d.dtbo
# Otherwise, graphics drivers will trigger an error：
# "could not open drm device"
VC4DTBO = "vc4-fkms-v3d"

# add kernel-module for support wifi
INSTALLMODULES += " \
kernel-module-rfkill \
kernel-module-cfg80211 \
kernel-module-brcmutil \
kernel-module-brcmfmac \
"

# add kernel-module for uvc camera
INSTALLMODULES += " \
kernel-module-usb-f-uvc \
kernel-module-uvcvideo \
"

# add kernel-module for wayland
INSTALLMODULES += " \
kernel-module-vc4 \
kernel-module-v3d \
kernel-module-drm \
"

# add common usb serial drivers
INSTALLMODULES += " \
kernel-module-usbserial \
kernel-module-cp210x \
kernel-module-ch341 \
"

# add kernel-module for bluetooth
INSTALLMODULES += " \
kernel-module-ecc \
kernel-module-ecdh-generic \
kernel-module-bluetooth \
kernel-module-btbcm \
kernel-module-hci-uart \
kernel-module-rfcomm \
kernel-module-cmac \
kernel-module-bnep \
"

# add kernel-module for isula
INSTALLMODULES += " \
kernel-module-overlay \
"

KERNEL_MODULE_AUTOLOAD = "${INSTALLMODULES}"

# automatic file system expansion
AUTO-EXPAND-FS = "1"

# remove bcm2711-rpi-4-b.dtb from kernel_devicetree
RPI_KERNEL_DEVICETREE:remove = " \
    broadcom/bcm2711-rpi-4-b.dtb \
"

# It will occur error below when rosslam and qt compiling together:
# ERROR: Nothing RPROVIDES 'nav2-rviz-plugins' (but /usr1/openeuler/src/yocto-poky/../yocto-meta-ros/meta-ros2-foxy/generated-recipes/navigation2/navigation2_0.4.7-1.bb RDEPENDS on or otherwise requires it)
# nav2-rviz-plugins was skipped: Recipe is blacklisted: qt5: depends on qtbase; x11: depends on rviz-ogre-vendor->(libx11,libxrandr,libxaw) which require x11 in DISTRO_FEATURES; opengl: depends on rviz-common, rviz-rendering, rviz-default-plugins which depend on rviz-ogre-vendor which depends on mesa which is not available because of missing opengl or vulkan in DISTRO_FEATURES
# nav2-rviz-plugins will be removed from RDEPENDS when adding qt5-layer
# see yocto-meta-ros/meta-ros2-foxy/recipes-bbappends/navigation2/navigation2_0.4.7-1.bbappend file
# line 4: ROS_EXEC_DEPENDS:remove = "${@bb.utils.contains_any('ROS_WORLD_SKIP_GROUPS', ['qt5', 'pyqt5', 'ogre'], 'nav2-rviz-plugins', '', d)}"
# so remove pacakgegroup-rosslam when adding qt5 
DISTRO_FEATURES:append = " ros-camera ${@bb.utils.contains('BBFILE_COLLECTIONS', 'qt5-layer', '', 'ros-slam', d)}"

require ${@bb.utils.contains('BUILD_GUEST_OS', '1', 'rpi4-initramfs.conf', '', d)}
```

## bsp/meta-openeuler-bsp/conf/machine/include/openeuler-rockchip-rk3568-evb.conf
```bitbake
require conf/machine/include/rk356x.inc
# set IMAGETYPE and dtb

RK_WIFIBT_FIRMWARES = " \
	rkwifibt-firmware-ap6398s-wifi \
	rkwifibt-firmware-ap6398s-bt \
	brcm-tools \
"

MACHINE_EXTRA_RRECOMMENDS:append = " \
	drm-cursor \
"

# set uboot and kernel Image config
UBOOT_MACHINE = "rk3568_defconfig"

# choose dtb file
ROCKCHIP_KERNEL_DTB_NAME ?= "OK3568-C-linux.dtb"
KERNEL_DEVICETREE = "rockchip/${ROCKCHIP_KERNEL_DTB_NAME}"
```

## bsp/meta-openeuler-bsp/conf/machine/include/openeuler-rockchip-rk3588-evb.conf
```bitbake
require conf/machine/include/rk3588.inc
# set IMAGETYPE and dtb

RK_WIFIBT_FIRMWARES = " \
	rkwifibt-firmware-ap6398s-wifi \
	rkwifibt-firmware-ap6398s-bt \
	brcm-tools \
"

MACHINE_EXTRA_RRECOMMENDS:append = " \
	drm-cursor \
"

# set uboot and kernel Image config
UBOOT_MACHINE = "rk3588_defconfig"
KERNEL_IMAGETYPE = "Image"

# choose dtb file
ROCKCHIP_KERNEL_DTB_NAME ?= "OK3588-C.dtb"
KERNEL_DEVICETREE = "rockchip/${ROCKCHIP_KERNEL_DTB_NAME}"
```

## bsp/meta-openeuler-bsp/conf/machine/include/rockchip-wic.inc
```bitbake
WKS_FILE = "sdimage-opi.wks"

# enable extlinux.conf auto-generation
UBOOT_EXTLINUX = "1"
UBOOT_EXTLINUX_KERNEL_IMAGE = "/${KERNEL_IMAGETYPE}"
UBOOT_EXTLINUX_FDT = "/${ROCKCHIP_KERNEL_DTB_NAME}"

# only used by UBOOT_EXTLINUX_CONSOLE
RK_CONSOLE_BAUD ?= "${@d.getVar('SERIAL_CONSOLES').split(';')[0]}"
RK_CONSOLE_DEVICE ?= "${@d.getVar('SERIAL_CONSOLES').split(';')[1].split()[0]}"

UBOOT_EXTLINUX_CONSOLE ?= "console=${RK_CONSOLE_DEVICE},${RK_CONSOLE_BAUD} console=tty1"

# Install the files for boot partition
# Note: the ROCKCHIP_KERNEL_DTB_NAME must be the same as fdt in extlinux.conf
IMAGE_BOOT_FILES = " \
        ${KERNEL_IMAGETYPE} \
        ${ROCKCHIP_KERNEL_DTB_NAME} \
        "
```

## bsp/meta-openeuler-bsp/conf/machine/include/rpi4-initramfs.conf
```bitbake
# enable ttyS0 for initramfs
SERIAL_CONSOLES = "115200;ttyS0"

INITRAMFS_IMAGE = "openeuler-image-mcs"
INITRAMFS_IMAGE_BUNDLE = "0"
```

## bsp/meta-openeuler-bsp/conf/machine/include/rzg2l-common.inc
```bitbake
require conf/machine/include/${SOC_FAMILY}.inc
require rzg2-common.inc

# Firmware-pack 
EXTRA_IMAGEDEPENDS += " firmware-pack"

MACHINEOVERRIDES =. "rzg2l:"

BBMASK:append = " recipes-rzg2h|recipes-rzv2l"
```

## bsp/meta-openeuler-bsp/conf/machine/myd-ym62x-k3r5.conf
```bitbake
require conf/machine/include/k3r5.inc
require conf/machine/include/ti-extras.inc

SYSFW_SOC = "am62x"
SYSFW_CONFIG = "evm"
SYSFW_SUFFIX = "gp"
SYSFW_PREFIX= "fs"
UBOOT_MACHINE = "myc_am62x_r5_defconfig"
```

## bsp/meta-openeuler-bsp/conf/machine/myd-ym62x.conf
```bitbake
require conf/machine/include/myd-am62x.inc
require conf/machine/include/ti-extras.inc

KERNEL_DEVICETREE_PREFIX = "myir/myd-y62x"

KERNEL_DEVICETREE = " \
    myir/myd-y62x-6254.dtb \
"

UBOOT_MACHINE = "myc_am62x_a53_defconfig"

# we need tiboot3.bin for wic image for r5 
do_image_wic[mcdepends] += "mc::k3r5:virtual/bootloader:do_deploy"
```
