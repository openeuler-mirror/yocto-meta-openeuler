## bsp/meta-aspeed/conf/machine/ast2600.conf
```bitbake
# PREFERRED_PROVIDER_virtual/kernel ?= "linux-aspeed"
KERNEL_DEVICETREE = "aspeed-ast2600-evb.dtb"

UBOOT_MACHINE = "ast2600_openbmc_spl_defconfig"
UBOOT_DEVICETREE = "ast2600-evb"
SPL_BINARY = "spl/u-boot-spl.bin"
SOCSEC_SIGN_ENABLE = "0"
VOLATILE_LOG_DIR = "no"

require conf/machine/include/ast2600.inc
require conf/machine/include/obmc-evb-common.inc

SERIAL_CONSOLES = "115200;ttyS4"

# AST2600 EVB has 64MB SPI flash
FLASH_SIZE = "65536"
# FLASH_SIZE = "131072"

# FLASH_RWFS_OFFSET:flash-65536 ?= "43008" 文件系统大小超出，调整大小，对应修改设备树
FLASH_RWFS_OFFSET:flash-65536 = "55296"

# require conf/machine/include/qemu-arm-common.inc
#kernel modules to install and autoload
require conf/machine/include/kernel-modules-conf/common.inc
INSTALLMODULES += " \
kernel-module-unix \
"

KERNEL_MODULE_AUTOLOAD = "${INSTALLMODULES}"
TUNE_FEATURES:append = " cortexa7"

# 编译器不支持 DEFAULTTUNE:aspeed-g6 ?= "armv7ahf-vfpv4d16"
DEFAULTTUNE:aspeed-g6 = "armv7a"

TUNE_CCARGS .= " -mno-unaligned-access"

# require conf/machine/include/obmc-bsp-common.inc
KERNEL_CLASSES ?= "kernel-fitimage"
KERNEL_IMAGETYPES ?= "fitImage vmlinux"

IMAGE_FSTYPES += "mtd-static mtd-static-tar mtd-static-alltar"
INITRAMFS_IMAGE = "obmc-phosphor-initramfs"

INITRAMFS_CTYPE ?= "xz"
INITRAMFS_FSTYPES = "cpio.${INITRAMFS_CTYPE}"
```

## bsp/meta-hisilicon/conf/layer.conf
```bitbake
# We have a conf and classes directory, add to BBPATH
BBPATH .= ":${LAYERDIR}"

# We have recipes-* directories, add to BBFILES
BBFILES += "${LAYERDIR}/recipes-*/*/*.bb \
            ${LAYERDIR}/recipes-*/*/*.bbappend"

BBFILE_COLLECTIONS += "hisilicon"
BBFILE_PATTERN_hisilicon := "^${LAYERDIR}/"
BBFILE_PRIORITY_hisilicon = "6"

LAYERDEPENDS_hisilicon = "core"
LAYERSERIES_COMPAT_hisilicon = "kirkstone"

# enable .bb under qt5-layer/ when exist meta-qt5
BBFILES_DYNAMIC += " \
qt5-layer:${LAYERDIR}/dynamic-layers/qt5-layer/recipes-*/*/*.bb \
qt5-layer:${LAYERDIR}/dynamic-layers/qt5-layer/recipes-*/*/*.bbappend \
ros2-layer:${LAYERDIR}/dynamic-layers/ros2-layer/recipes-*/*/*.bb \
ros2-layer:${LAYERDIR}/dynamic-layers/ros2-layer/recipes-*/*/*.bbappend \
"
```

## bsp/meta-hisilicon/conf/machine/hi3093.conf
```bitbake
require conf/machine/include/hi3093.inc

# auto load module during startup
KERNEL_MODULE_AUTOLOAD = " ${@bb.utils.contains('MCS_FEATURES', 'openamp', 'mcs_km', '', d)} "
```

## bsp/meta-hisilicon/conf/machine/hi309a.conf
```bitbake
require conf/machine/include/hi309a.inc

# auto load module during startup
KERNEL_MODULE_AUTOLOAD = " ${@bb.utils.contains('MCS_FEATURES', 'openamp', 'mcs_km', '', d)} "

#==================================================================================
# README: Add a New hi309x Machine (hi3093 Configuration As Template)
#==================================================================================
#
# This file demonstrates the pattern for adding a new hi309x variant machine
# by inheriting from the base hi3093 configuration with basic customizations, using
# similar file system contents and structure.
#
# BACKGROUND:
# -----------
# The hi3093 recipes are the first recipes set in the hi309x platform series. 
# To add a new variant (like hi309a, hi309b, etc.) with subtle difference, 
# you mirror the structure and use inheritance to avoid code duplication.
#
#
# Take hi309a as an example,
# FILES CREATED/ADDED FOR hi309a:
# --------------------------------
# 1. conf/machine/hi309a.conf              - Main machine config (this file)
# 2. conf/machine/include/hi309a.inc       - Machine-specific overrides
# 3. recipes-kernel/linux/linux-hi309a.inc - Kernel-related configurations
# 4. recipes-core/images/bsp-hi309a.inc    - BSP packages to be installed, used for all openeuiler images (tiny, standard, etc.)
# 5. recipes-core/images/image-hi309a.inc  - Image composition config, (mainly kernel modules)
# 6. recipes-core/images/image-early-config-hi309a.inc - Early image config
# 7. .oebuild/platform/hi309a.yaml         - Platform config for oebuild
# files above plays a basic role for hi309a divergence from hi3093.
#
# Common customization areas:
#   1. MACHINEOVERRIDES - Add your machine name to the override chain
#   2. Kernel defconfig - Only create if different from hi3093
#   3. MACHINE_FEATURES - Add/remove features specific to your variant
#   4. IMAGE_INSTALL - Add/remove packages in bsp-<new-machine>.inc
#   5. KERNEL_MODULE_AUTOLOAD - Auto-load specific modules
#   6. DISTRO_FEATURES - Add variant-specific distro features
#
#
# MAINTENANCE TIP:
# ----------------
# When hi3093 base configuration is updated, review if changes need to be
# **propagated** to or are compatible with your hi309x variant. Since most
# configuration is inherited automatically, updates are usually minimal.
#
# TODO:
# ----------------
# If nessesary, we will write a hi309x-common instead of considering hi3093 as base for all hi309x variants.
#
# TROUBLESHOOTING:
# ----------------
# - If a package isn't working as expected, check MACHINEOVERRIDES includes
#   your machine name
# - Verify kernel configuration with: bitbake -c menuconfig virtual/kernel
# - Check package inclusion with: bitbake <image-name> -g
# - Use bitbake-getvar to inspect variable values
#
# For more information, see hi3093.inc and hi309a.inc for examples.
#==================================================================================
```

## bsp/meta-hisilicon/conf/machine/hieulerpi1.conf
```bitbake
require conf/machine/include/arm/armv8-2a/tune-cortexa55.inc
MACHINE_FEATURES += "efi pci"
MACHINEOVERRIDES =. "hieulerpi1:march64le:"
DEFAULTTUNE = "aarch64"

require conf/multilib.conf
# currently, don't support 32 bit libs
MULTILIBS = ""

ROOTFS_PACKAGE_ARCH = "aarch64"

# set IMAGETYPE and dtb
KERNEL_IMAGETYPE = "Image"
# choose dtb file
KERNEL_DEVICETREE = ""
ENABLE_UART = "1"
# serial port enabled in hieulerpi1
CMDLINE_SERIAL = "ttyAMA0,115200"
SERIAL_CONSOLES = "115200;ttyAMA0"

# arm and arm64 both support -mlittle-endian so no
# need to consider compat32.
TUNE_CCARGS .= " -mlittle-endian"
IMAGE_INSTALL:append = " kernel-modules"

# auto load module during startup
KERNEL_MODULE_AUTOLOAD = ""
USE_VT ?= "0"
```

## bsp/meta-hisilicon/conf/machine/hipico.conf
```bitbake
require conf/machine/include/arm/arch-armv7a.inc

MACHINE_FEATURES += "pci"
MACHINEOVERRIDES =. "hipico:march32le:"
DEFAULTTUNE = "armv7a"

ROOTFS_PACKAGE_ARCH = "armv7l"

# set IMAGETYPE and dtb
KERNEL_IMAGETYPE = "zImage"
# choose dtb file
KERNEL_DEVICETREE = ""
ENABLE_UART = "1"
# serial port enabled in hipico
CMDLINE_SERIAL = "ttyAMA0,115200"
SERIAL_CONSOLES = "115200;ttyAMA0"

# arm and arm64 both support -mlittle-endian so no
# need to consider compat32.
TUNE_CCARGS .= " -mno-unaligned-access"
IMAGE_INSTALL:append = " kernel-modules"

# auto load module during startup
KERNEL_MODULE_AUTOLOAD = ""
USE_VT ?= "1"
```

## bsp/meta-hisilicon/conf/machine/include/hi1711.inc
```bitbake
include conf/machine/include/tune-cortexa55.inc
MACHINE_FEATURES += "efi pci vc4graphics"
MACHINEOVERRIDES =. "hi1711:march64le:"
DEFAULTTUNE = "aarch64"

require conf/multilib.conf
# currently, don't support 32 bit libs
MULTILIBS = ""

ROOTFS_PACKAGE_ARCH = "aarch64"

# set IMAGETYPE and dtb
KERNEL_IMAGETYPE = "zImage"
# choose dtb file
KERNEL_DEVICETREE = ""
ENABLE_UART = "1"
# serial port enabled in hi1711
CMDLINE_SERIAL = "ttyS0,115200"
SERIAL_CONSOLES = "115200;ttyS0"

# arm and arm64 both support -mlittle-endian so no
# need to consider compat32.
TUNE_CCARGS .= " -mlittle-endian"
IMAGE_INSTALL_append = " kernel-modules"

# auto load module during startup
KERNEL_MODULE_AUTOLOAD = ""
USE_VT ?= "0"

# set MCS_FEATURES
# hi3093 only supports the "openamp" mechanism,
# and client os only supports uniproton
MCS_FEATURES = "openamp"
MCS_FEATURES := "${@bb.utils.contains('DISTRO_FEATURES', 'mcs', '${MCS_FEATURES}', '', d)}"
```

## bsp/meta-hisilicon/conf/machine/include/hi309a.inc
```bitbake
require conf/machine/include/hi3093.inc

MACHINEOVERRIDES =. "hi309a:march64le:"
```

## bsp/meta-hisilicon/recipes-kernel/linux/files/config/hipico/hipico_mini_defconfig
```kconfig
CONFIG_LOCALVERSION="-openeuler"
# CONFIG_LOCALVERSION_AUTO is not set
CONFIG_KERNEL_XZ=y
# CONFIG_SWAP is not set
CONFIG_SYSVIPC=y
# CONFIG_CROSS_MEMORY_ATTACH is not set
CONFIG_LOG_BUF_SHIFT=14
CONFIG_CC_OPTIMIZE_FOR_SIZE=y
# CONFIG_MULTIUSER is not set
# CONFIG_SYSFS_SYSCALL is not set
# CONFIG_FHANDLE is not set
# CONFIG_POSIX_TIMERS is not set
# CONFIG_BUG is not set
# CONFIG_ELF_CORE is not set
# CONFIG_BASE_FULL is not set
# CONFIG_FUTEX is not set
# CONFIG_EPOLL is not set
# CONFIG_SIGNALFD is not set
# CONFIG_TIMERFD is not set
# CONFIG_EVENTFD is not set
# CONFIG_SHMEM is not set
# CONFIG_AIO is not set
# CONFIG_IO_URING is not set
# CONFIG_ADVISE_SYSCALLS is not set
# CONFIG_MEMBARRIER is not set
# CONFIG_KALLSYMS is not set
# CONFIG_RSEQ is not set
CONFIG_EMBEDDED=y
# CONFIG_SLUB_DEBUG is not set
# CONFIG_COMPAT_BRK is not set
# CONFIG_SLAB_MERGE_DEFAULT is not set
# CONFIG_SLUB_CPU_PARTIAL is not set
# CONFIG_KABI_RESERVE is not set
CONFIG_ARCH_BSP=y
CONFIG_ARCH_HI3516CV610=y
# CONFIG_CACHE_L2X0 is not set
# CONFIG_DEBUG_ALIGN_RODATA is not set
CONFIG_SMP=y
# CONFIG_ARM_CPU_TOPOLOGY is not set
CONFIG_VMSPLIT_3G_OPT=y
# CONFIG_ARM_PATCH_IDIV is not set
# CONFIG_CPU_SW_DOMAIN_PAN is not set
# CONFIG_ARM_MODULE_PLTS is not set
CONFIG_ARM_APPENDED_DTB=y
CONFIG_ARM_ATAG_DTB_COMPAT=y
CONFIG_VFP=y
CONFIG_NEON=y
# CONFIG_SUSPEND is not set
# CONFIG_SECCOMP is not set
CONFIG_MODULES=y
CONFIG_MODULE_UNLOAD=y
CONFIG_PARTITION_ADVANCED=y
CONFIG_CMDLINE_PARTITION=y
# CONFIG_MQ_IOSCHED_DEADLINE is not set
# CONFIG_MQ_IOSCHED_KYBER is not set
# CONFIG_ENABLE_IPREC_DEBUG is not set
CONFIG_PAGE_REPORTING=y
CONFIG_KSM=y
CONFIG_ZBUD=y
CONFIG_ZSMALLOC=y
CONFIG_UEVENT_HELPER=y
CONFIG_UEVENT_HELPER_PATH="/sbin/hotplug"
CONFIG_DEVTMPFS=y
CONFIG_DEVTMPFS_MOUNT=y
# CONFIG_PREVENT_FIRMWARE_BUILD is not set
CONFIG_MTD=y
CONFIG_MTD_CMDLINE_PARTS=y
CONFIG_MTD_SPI_NAND_BSP=y
CONFIG_MTD_RAW_NAND=y
CONFIG_MTD_SPI_NAND_FMC100=y
CONFIG_MTD_SPI_NAND=y
CONFIG_INPUT_EVDEV=y
# CONFIG_LEGACY_PTYS is not set
CONFIG_SERIAL_AMBA_PL011=y
CONFIG_SERIAL_AMBA_PL011_CONSOLE=y
# CONFIG_HW_RANDOM is not set
CONFIG_I2C=y
CONFIG_I2C_CHARDEV=y
CONFIG_I2C_BSP=y
CONFIG_SPI=y
CONFIG_SPI_PL022=y
CONFIG_SPI_SPIDEV=y
CONFIG_GPIOLIB=y
CONFIG_GPIO_SYSFS=y
CONFIG_GPIO_GENERIC_PLATFORM=y
CONFIG_GPIO_PL061=y
CONFIG_POWER_RESET_BSP=y
# CONFIG_HWMON is not set
CONFIG_MFD_BSP_FMC=y
CONFIG_MFD_SYSCON=y
# CONFIG_USB_SUPPORT is not set
# CONFIG_VIRTIO_MENU is not set
# CONFIG_VHOST_MENU is not set
# CONFIG_ARM_ARCH_TIMER_EVTSTREAM is not set
# CONFIG_IOMMU_SUPPORT is not set
CONFIG_PM_DEVFREQ=y
CONFIG_DEVFREQ_GOV_SIMPLE_ONDEMAND=y
# CONFIG_NVMEM is not set
CONFIG_EXT4_FS=y
# CONFIG_DNOTIFY is not set
# CONFIG_INOTIFY_USER is not set
CONFIG_CONFIGFS_FS=y
CONFIG_NLS=y
CONFIG_CRYPTO_MANAGER=y
# CONFIG_CRYPTO_MANAGER_DISABLE_TESTS is not set
CONFIG_CRYPTO_DEFLATE=y
CONFIG_CRYPTO_LZO=y
CONFIG_CRYPTO_842=y
CONFIG_CRYPTO_LZ4=y
CONFIG_CRYPTO_LZ4HC=y
CONFIG_CRYPTO_ZSTD=y
# CONFIG_CRYPTO_HW is not set
CONFIG_XZ_DEC=y
# CONFIG_XZ_DEC_X86 is not set
# CONFIG_XZ_DEC_POWERPC is not set
# CONFIG_XZ_DEC_IA64 is not set
# CONFIG_XZ_DEC_ARM is not set
# CONFIG_XZ_DEC_ARMTHUMB is not set
# CONFIG_XZ_DEC_SPARC is not set
CONFIG_MAGIC_SYSRQ=y
# CONFIG_DEBUG_MISC is not set
CONFIG_PANIC_ON_OOPS=y
# CONFIG_SCHED_DEBUG is not set
# CONFIG_RCU_TRACE is not set
# CONFIG_FTRACE is not set
```

## bsp/meta-kunpeng/conf/layer.conf
```bitbake
# We have a conf and classes directory, add to BBPATH
BBPATH .= ":${LAYERDIR}"

# We have recipes-* directories, add to BBFILES
BBFILES += "${LAYERDIR}/recipes-*/*/*.bb \
            ${LAYERDIR}/recipes-*/*/*.bbappend"

BBFILE_COLLECTIONS += "meta-kunpeng"
BBFILE_PATTERN_meta-kunpeng := "^${LAYERDIR}/"
BBFILE_PRIORITY_meta-kunpeng = "7"

LAYERVERSION_meta-kunpeng = "1"
LAYERDEPENDS_meta-kunpeng = "core"
LAYERSERIES_COMPAT_meta-kunpeng = "kirkstone"
```

## bsp/meta-kunpeng/conf/machine/kp920.conf
```bitbake
require conf/machine/include/arm/arch-armv8a.inc

MACHINE_FEATURES += "efi pci vc4graphics"
MACHINEOVERRIDES =. "kp920:march64le:"
DEFAULTTUNE = "aarch64"

require conf/multilib.conf
# currently, don't support 32 bit libs
MULTILIBS = ""

ROOTFS_PACKAGE_ARCH = "aarch64"

# set IMAGETYPE and dtb
KERNEL_IMAGETYPE = "zImage"
# choose dtb file
KERNEL_DEVICETREE = ""
ENABLE_UART = "1"
# serial port enabled in kp920
CMDLINE_SERIAL = "ttyAMA0,115200"
SERIAL_CONSOLES = "115200;ttyAMA0"

# arm and arm64 both support -mlittle-endian so no
# need to consider compat32.
TUNE_CCARGS .= " -mlittle-endian"
IMAGE_INSTALL:append = " kernel-modules"

# the final sd image is in iso format
IMAGE_FSTYPES += "iso"

# auto load module during startup
KERNEL_MODULE_AUTOLOAD = ""
USE_VT ?= "1"

# set MCS_FEATURES
# kp920 only supports the "openamp" mechanism,
# and client os only supports uniproton
MCS_FEATURES = "openamp"
MCS_FEATURES := "${@bb.utils.contains('DISTRO_FEATURES', 'mcs', '${MCS_FEATURES}', '', d)}"

# auto load module during startup
KERNEL_MODULE_AUTOLOAD = " ${@bb.utils.contains('MCS_FEATURES', 'openamp', 'mcs_km', '', d)} "
```

## bsp/meta-openeuler-bsp/conf/layer.conf
```bitbake
# We have a conf and classes directory, add to BBPATH
BBPATH =. "${LAYERDIR}:"

# We have recipes-* directories, add to BBFILES
BBFILES += "${LAYERDIR}/recipes-*/*/*.bb \
            ${LAYERDIR}/recipes-*/*/*.bbappend"

BBFILE_COLLECTIONS += "openeuler-bsp"
BBFILE_PATTERN_openeuler-bsp = "^${LAYERDIR}/"
BBFILE_PRIORITY_openeuler-bsp = "25"

LAYERSERIES_COMPAT_openeuler-bsp = "kirkstone"
#no bb file under meta-openeuler-bsp, set it to 1 to ignore "No bb files" warning
BBFILE_PATTERN_IGNORE_EMPTY_openeuler-bsp = "1"


#enable .bb under raspberrypi/ when exist meta-raspberrypi
BBFILES_DYNAMIC += " \
raspberrypi:${LAYERDIR}/raspberrypi/*/*/*.bb \
raspberrypi:${LAYERDIR}/raspberrypi/*/*/*.bbappend \
"

#enable find .inc under raspberrypi/, included in .bb
BBPATH:append = ":${LAYERDIR}/raspberrypi"

#enable .bb under rockchip/ when exist yocto-meta-rockchip
BBFILES_DYNAMIC += " \
rockchip:${LAYERDIR}/rockchip/*/*/*.bb \
rockchip:${LAYERDIR}/rockchip/*/*/*.bbappend \
"

#enable find .inc under rockchip/, included in .bb
BBPATH:append = ":${LAYERDIR}/rockchip"


#enable .bb under renesas/ when exist yocto-meta-renesas
BBFILES_DYNAMIC += " \
renesas-bsp:${LAYERDIR}/renesas/recipes-remi/recipes-*/*/*.bb \
renesas-bsp:${LAYERDIR}/renesas/recipes-remi/recipes-*/*/*.bbappend \
"

#enable find .inc under renesas/, included in .bb
BBPATH:append = ":${LAYERDIR}/renesas/recipes-remi"

#enable .bb under sunxi/ when exist yocto-meta-sunxi
BBFILES_DYNAMIC += " \
sunxi:${LAYERDIR}/sunxi/*/*/*.bb \
sunxi:${LAYERDIR}/sunxi/*/*/*.bbappend \
"
```

## bsp/meta-openeuler-bsp/conf/machine/include/myd-am62x.inc
```bitbake
require conf/machine/include/k3.inc
SOC_FAMILY:append = ":am62xx"

MACHINE_FEATURES += "screen gpu"

require conf/machine/include/mesa-pvr.inc
PREFERRED_PROVIDER_virtual/gpudriver ?= "ti-img-rogue-driver"

# Default tiboot3.bin on AM62x is for HS-FS
IMAGE_BOOT_FILES += "tiboot3-am62x-hs-fs-evm.bin"

# Since default tiboot3.bin on AM62x is for HS-FS, add a version for GP
IMAGE_BOOT_FILES += "tiboot3-am62x-gp-evm.bin"

# Since default tiboot3.bin on AM62x is for HS-FS, add a version for HS-SE
IMAGE_BOOT_FILES += "tiboot3-am62x-hs-evm.bin"

# Bitmap image tarball for early splashscreen
IMAGE_BOOT_FILES += "ti_logo_414x97_32bpp.bmp.gz"

TFA_BOARD = "lite"
TFA_K3_SYSTEM_SUSPEND = "1"

OPTEEMACHINE = "k3-am62x"

# Normally AM62 boards use ttyS2, but our Jailhouse inmate may use ttyS3, so try both
SERIAL_CONSOLES = "115200;ttyS2 115200;ttyS3"

IMAGE_FSTYPES += " ext4 "
```
