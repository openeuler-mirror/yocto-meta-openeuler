## bsp/meta-openeuler-bsp/conf/machine/myir-remi.conf
```bitbake
#@TYPE: Machine
#@NAME: myir-yg2lx machine
#@DESCRIPTION: RZ/G2L myir platform

SOC_FAMILY = "r9a07g044l"
require conf/machine/include/rzg2l-common.inc

DEFAULTTUNE ?= "cortexa55"

TUNE_CONF ?= "conf/machine/include/arm/armv8-2a/tune-cortexa55.inc"
require ${TUNE_CONF}

PREFERRED_PROVIDER_virtual/kernel="linux-myir"
COMPATIBLE_MACHINE:myir-remi = "myir-remi"
# DISTRO_FEATURES:append = " qt5"
# DISTRO_FEATURES:append = " virtualization"

# MACHINE_EXTRA_RRECOMMENDS = "kernel-modules"

UBOOT_CONFIG ??= "mys-rzg2l"
#2G DDR
#UBOOT_CONFIG[myc-rzg2l] = "myc-rzg2l_defconfig"

#1G DDR
UBOOT_CONFIG[mys-rzg2l] = "mys-rzg2l_defconfig"

# flash writer
EXTRA_IMAGEDEPENDS += " flash-writer"

# Support board with PMIC. Default:yes.
# With this option enabled, build both bin files for PMIC board and Concrete board.
PMIC_SUPPORT ?= "1"

KERNEL_DEVICETREE = " \
       myir/mys-rzg2l-wifi.dtb \
       myir/mys-rzg2l-sdcard.dtb \
"
```

## bsp/meta-openeuler-bsp/conf/machine/ok3399.conf
```bitbake
require conf/machine/include/openeuler-rockchip-rk3399pro-evb.conf

KBUILD_DEFCONFIG = "OK3399-C-linux_defconfig"
ROCKCHIP_KERNEL_DTB_NAME = "OK3399-C-linux.dtb"
SERIAL_CONSOLES = "115200;ttyS2"
```

## bsp/meta-openeuler-bsp/conf/machine/ok3568.conf
```bitbake
require conf/machine/include/openeuler-rockchip-rk3568-evb.conf

ROCKCHIP_KERNEL_DTB_NAME = "OK3568-C-linux.dtb"

# auto load module during startup
KBUILD_DEFCONFIG = "OK3568-C-linux_defconfig"

INSTALLMODULES += " \
kernel-module-mlan \
kernel-module-moal \
"

KERNEL_MODULE_AUTOLOAD = " kernel-module-mlan kernel-module-moal "
SERIAL_CONSOLES = "115200;ttyFIQ0"
```

## bsp/meta-openeuler-bsp/conf/machine/ok3588.conf
```bitbake
require conf/machine/include/openeuler-rockchip-rk3588-evb.conf

KBUILD_DEFCONFIG = ""
ROCKCHIP_KERNEL_DTB_NAME = "OK3588-C-linux.dtb"
SERIAL_CONSOLES = "115200;ttyFIQ0"
```

## bsp/meta-openeuler-bsp/conf/machine/oka40i.conf
```bitbake
require conf/machine/include/sun8i.inc

MACHINEOVERRIDES =. "march32le:"
DEFAULTTUNE = "armv7a"

UBOOT_LOCALVERSION = ""

TUNE_CCARGS .= " -mlittle-endian"
export ROOTFS_PACKAGE_ARCH = "armv7l"

KERNEL_DEVICETREE = "oka40i.dtb"
# UBOOT_MACHINE ?= "Bananapi_m2m_defconfig"

KBUILD_DEFCONFIG = "oka40i_defconfig"

export LOADADDR = "0x40008000"
export KERNEL_SRC = "${STAGING_KERNEL_DIR}"
export LICHEE_BSP_DIR = "${STAGING_KERNEL_DIR}/bsp"
export BSP_TOP = "${STAGING_KERNEL_DIR}/bsp/"
export LICHEE_OUT_DIR = "${B}"
export LICHEE_IC = "a40i_h"
export LICHEE_KERN_DIR = "${STAGING_KERNEL_DIR}"
export LICHEE_PLATFORM  = "linux"
export LICHEE_MOD_DIR = "${B}"

HOSTTOOLS_NONFATAL += " pod2text pod2html dos2unix"
ASSUME_PROVIDED += " dos2unix-native "
```

## bsp/meta-openeuler-bsp/conf/machine/openeuler-ok3568.conf
```bitbake
# set IMAGETYPE and dtb
KERNEL_IMAGETYPE = "Image"

# choose dtb file
RK3568_KERNEL_DTB_NAME ?= "OK3568-C-linux.dtb"
KERNEL_DEVICETREE = "rockchip/${RK3568_KERNEL_DTB_NAME}"

PREFERRED_PROVIDER_virtual/kernel = "linux-openeuler"
PREFERRED_PROVIDER_virtual/bootloader = "u-boot"

UBOOT_MACHINE = "evb-rk3568_defconfig"
KBUILD_DEFCONFIG = "OK3568-C-linux_defconfig"
```

## bsp/meta-openeuler-bsp/conf/machine/openeuler-raspberrypi4-64.conf
```bitbake
require conf/multilib.conf
# currently, don't support 32 bit libs
MULTILIBS = ""

ROOTFS_PACKAGE_ARCH = "aarch64"

#set 0 to create zImage
RPI_USE_U_BOOT = "0"
KERNEL_IMAGETYPE_DIRECT = "Image"
ENABLE_UART = "1"
# serial port enabled by default in raspberrypi
CMDLINE_SERIAL = "console=tty1 console=ttyS0,115200"
# ttyS0 may use for ROS driver
# ttyAMA0 use for bluetooth
SERIAL_CONSOLES = ""

# add kernel-module for support wifi
INSTALLMODULES += "\
kernel-module-rfkill \
kernel-module-cfg80211 \
kernel-module-brcmutil \
kernel-module-brcmfmac \
"

# add kernel-module for support wayland
INSTALLMODULES +=" \
kernel-module-vc4 \
kernel-module-v3d \
kernel-module-drm \
"

# add common usb serial drivers
INSTALLMODULES +=" \
kernel-module-usbserial \
kernel-module-cp210x \
kernel-module-ch341 \
"

# add kernel-module for support bluetooth
INSTALLMODULES +="\
kernel-module-ecc \
kernel-module-ecdh-generic \
kernel-module-bluetooth \
kernel-module-btbcm \
kernel-module-hci-uart \
kernel-module-rfcomm \
kernel-module-cmac \
kernel-module-bnep \
"

KERNEL_MODULE_AUTOLOAD = "${INSTALLMODULES}"

# automatic file system expansion
AUTO-EXPAND-FS = "1"

# remove bcm2711-rpi-4-b.dtb from kernel_devicetree
RPI_KERNEL_DEVICETREE_remove = " \
    broadcom/bcm2711-rpi-4-b.dtb \
"
```

## bsp/meta-openeuler-bsp/conf/machine/openeuler-rockchip-rk3399pro-evb.conf
```bitbake
#@TYPE: Machine
#@NAME: rk3399-openeuler
require conf/machine/include/rk3399.inc

RK_WIFIBT_FIRMWARES = " \
	rkwifibt-firmware-ap6354-wifi \
	rkwifibt-firmware-ap6354-bt \
	brcm-tools \
"

MACHINE_EXTRA_RRECOMMENDS:append = " \
	linux-firmware-rk-cdndp \
	rockchip-npu \
"

# set uboot and kernel Image config
UBOOT_MACHINE = "rk3399_defconfig"
KERNEL_IMAGETYPE = "Image"

# choose dtb file
ROCKCHIP_KERNEL_DTB_NAME ?= "rk3399-evb.dtb"
KERNEL_DEVICETREE = "rockchip/${ROCKCHIP_KERNEL_DTB_NAME}"
```

## bsp/meta-openeuler-bsp/conf/machine/openeuler-rockchip-rk3588-evb.conf
```bitbake
require conf/machine/include/rk3588.inc
# set IMAGETYPE and dtb

RK_WIFIBT_FIRMWARES = " \
	rkwifibt-firmware-ap6398s-wifi \
	rkwifibt-firmware-ap6398s-bt \
	brcm-tools \
"

MACHINE_EXTRA_RRECOMMENDS:append = " \
	drm-cursor \
"

# set uboot and kernel Image config
UBOOT_MACHINE = "evb-rk3588_defconfig"
KBUILD_DEFCONFIG = ""
KERNEL_IMAGETYPE = "Image"

# choose dtb file
ROCKCHIP_KERNEL_DTB_NAME ?= "OK3588-C.dtb"
KERNEL_DEVICETREE = "rockchip/${ROCKCHIP_KERNEL_DTB_NAME}"

# set PREFERRED_PROVIDER_virtual/kernel and bootloader 
# so it will overwrite the pre-definition from yocto-meta-rockchip
PREFERRED_PROVIDER_virtual/kernel = "linux-openeuler"
PREFERRED_PROVIDER_virtual/bootloader = "u-boot"
```

## bsp/meta-openeuler-bsp/conf/machine/orangepi4-lts.conf
```bitbake
require conf/machine/include/rk3399.inc
require conf/machine/include/rockchip-default-providers.inc
require conf/machine/include/rockchip-wic.inc

# Specify the U-Boot configuration
UBOOT_MACHINE = "rk3399_defconfig"

# use defconfig from kernel source
OPENEULER_KERNEL_CONFIG:orangepi4-lts = ""
KBUILD_DEFCONFIG = "OK3399-C-linux_defconfig"
ROCKCHIP_KERNEL_DTB_NAME = "rk3399-orangepi-4-lts.dtb"

KERNEL_IMAGETYPE = "Image"
KERNEL_DEVICETREE = "rockchip/${ROCKCHIP_KERNEL_DTB_NAME}"

# serial console setting
SERIAL_CONSOLES = "1500000;ttyS2"

UBOOT_EXTLINUX_ROOT ?= "root=/dev/mmcblk0p2 rootfstype=ext4 "

UBOOT_EXTLINUX_KERNEL_ARGS:prepend = "earlycon=uart8250,mmio32,0xff1a0000 "
```

## bsp/meta-openeuler-bsp/conf/machine/orangepi5.conf
```bitbake
require conf/machine/include/rk3588.inc
require conf/machine/include/rockchip-default-providers.inc
require conf/machine/include/rockchip-wic.inc

# RK_WIFIBT_FIRMWARES parm come from conf/machine/include/openeuler-rockchip-rk3588-evb.conf
RK_WIFIBT_FIRMWARES = " \
	rkwifibt-firmware-ap6398s-wifi \
	rkwifibt-firmware-ap6398s-bt \
	brcm-tools \
"

# Specify the U-Boot configuration
UBOOT_MACHINE = "rk3588_defconfig"

# Specify the linux kernel configuration and device tree
KBUILD_DEFCONFIG = ""
ROCKCHIP_KERNEL_DTB_NAME = "rk3588s-orangepi-5.dtb"
KERNEL_DEVICETREE = "rockchip/${ROCKCHIP_KERNEL_DTB_NAME}"

# serial console setting
SERIAL_CONSOLES = "1500000;ttyFIQ0"

UBOOT_EXTLINUX_ROOT ?= "root=/dev/mmcblk1p2 rootfstype=ext4 "
```

## bsp/meta-openeuler-bsp/conf/machine/roc-rk3588s-pc.conf
```bitbake
require conf/machine/include/openeuler-rockchip-rk3588-evb.conf

# 将KBUILD_DEFCONFIG设置为空，使用OPENEULER_KERNEL_CONFIG变量设置config
KBUILD_DEFCONFIG = ""
ROCKCHIP_KERNEL_DTB_NAME = "roc-rk3588s-pc.dtb"
SERIAL_CONSOLES = "115200;ttyFIQ0"
```

## bsp/meta-openeuler-bsp/conf/machine/ryd-3568.conf
```bitbake
require conf/machine/include/openeuler-rockchip-rk3568-evb.conf

ROCKCHIP_KERNEL_DTB_NAME = "rk3568-8897-ddr4-v1-linux-hdmi.dtb"
```

## bsp/meta-openeuler-bsp/conf/machine/tspi-3566.conf
```bitbake
require conf/machine/include/openeuler-rockchip-rk3568-evb.conf

ROCKCHIP_KERNEL_DTB_NAME = "tspi-rk3566-user-v10-linux.dtb"

# auto load module during startup
KBUILD_DEFCONFIG = "rockchip_linux_defconfig"

SERIAL_CONSOLES = "115200;ttyFIQ0"

IMAGE_INSTALL:append = "\
    gstreamer1.0 \
    gstreamer1.0-plugins-bad \
    gstreamer1.0-plugins-base \
    gstreamer1.0-plugins-good \
    i2c-tools \
"
```

## bsp/meta-openeuler-bsp/raspberrypi/conf/layer.conf
```bitbake
# We have a conf and classes directory, append to BBPATH
BBPATH .= ":${LAYERDIR}"

# We have a recipes directory containing .bb and .bbappend files, add to BBFILES
BBFILES += "${LAYERDIR}/recipes*/*/*.bb \
            ${LAYERDIR}/recipes*/*/*.bbappend"

BBFILE_COLLECTIONS += "openeuler-raspberrypi"
BBFILE_PATTERN_openeuler-raspberrypi := "^${LAYERDIR}/"
BBFILE_PRIORITY_openeuler-raspberrypi = "10"

LAYERSERIES_COMPAT_openeuler-raspberrypi = "hardknott honister"
LAYERDEPENDS_openeuler-raspberrypi = "raspberrypi"
```
