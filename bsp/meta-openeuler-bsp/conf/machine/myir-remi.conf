## bsp/meta-openeuler-bsp/sunxi/recipes-kernel/linux/files/config/ok-a40i/defconfig
```kconfig
CONFIG_AW_BSP=y
CONFIG_AW_IC_BOARD=y
CONFIG_AW_SOC_NAME="sun8iw11"
CONFIG_AW_TIMER=y
CONFIG_AW_DMA=y
CONFIG_AW_WATCHDOG=y
CONFIG_AW_I2C=y
CONFIG_AW_SPI=y
CONFIG_AW_PWM=y
CONFIG_AW_IR_RX=y
CONFIG_AW_RTP=y
CONFIG_USB_EHCI_HCD_SUNXI=y
CONFIG_USB_OHCI_HCD_SUNXI=y
CONFIG_USB_SUNXI_HCD=y
CONFIG_USB_SUNXI_HCI=y
CONFIG_USB_SUNXI_EHCI0=y
CONFIG_USB_SUNXI_EHCI1=y
CONFIG_USB_SUNXI_EHCI2=y
CONFIG_USB_SUNXI_OHCI0=y
CONFIG_USB_SUNXI_OHCI1=y
CONFIG_USB_SUNXI_OHCI2=y
CONFIG_USB_SUNXI_USB=y
CONFIG_USB_SUNXI_USB_MANAGER=y
CONFIG_USB_SUNXI_USB_DEBUG=y
CONFIG_USB_SUNXI_USB_ADB=y
CONFIG_USB_SUNXI_UDC0=y
CONFIG_AW_EMAC=y
CONFIG_AW_MBUS_SUN8IW11=y
CONFIG_AW_WAKEUPGEN=y
CONFIG_AW_SUN8I_NMI=y
CONFIG_AW_THERMAL=y
CONFIG_AW_MFD_AXP2101_I2C=y
CONFIG_AW_REGULATOR_AXP2101=y
CONFIG_AW_AXP22X_POWER=y
CONFIG_AW_CPUFREQ_DT=y
CONFIG_AW_INPUT_SENSORINIT=y
CONFIG_AW_INPUT_CTP=y
# CONFIG_TOUCHSCREEN_GSLX680NEW is not set
CONFIG_TOUCHSCREEN_GT9XXNEW_TS=y
CONFIG_KEYBOARD_SUNXI=y
CONFIG_AW_MMC=y
CONFIG_AW_HDMI_DISP2=y
CONFIG_TV_AW_DISP2=y
CONFIG_AW_DISP2_DEBUG=y
CONFIG_AW_DI=y
CONFIG_SUNXI_DI_V2X=y
CONFIG_CSI_VFE=y
CONFIG_AW_VIDEO_SUNXI_TVD=y
CONFIG_SND_SOC_SUNXI_AAUDIO=y
CONFIG_SND_SOC_SUNXI_SPDIF=y
# CONFIG_SND_SOC_SUNXI_SPDIF_RXIEC61937 is not set
CONFIG_SND_SOC_SUNXI_DAUDIO=y
CONFIG_SND_SOC_SUNXI_PCM_HDMI=y
CONFIG_AW_SYS_INFO=y
CONFIG_AW_SMC=y
CONFIG_AW_SID=y
CONFIG_RTL8723DU=m
CONFIG_AIC_WLAN_SUPPORT=y
CONFIG_BT_HCIBTUSB_RTLBTUSB=m
CONFIG_AW_RFKILL=y
CONFIG_AW_MACADDR_MGT=y
CONFIG_AW_CRASHDUMP=y
CONFIG_AW_AHCI=y
CONFIG_AW_MTD=y
CONFIG_AW_MTD_BLOCK=y
CONFIG_AW_MTD_RAWNAND=y
CONFIG_AW_GPU_TYPE="mali400"
# CONFIG_LOCALVERSION_AUTO is not set
CONFIG_SYSVIPC=y
CONFIG_NO_HZ=y
CONFIG_HIGH_RES_TIMERS=y
CONFIG_PREEMPT=y
CONFIG_BSD_PROCESS_ACCT=y
CONFIG_BSD_PROCESS_ACCT_V3=y
CONFIG_IKCONFIG=y
CONFIG_IKCONFIG_PROC=y
CONFIG_LOG_BUF_SHIFT=14
CONFIG_CGROUPS=y
CONFIG_CC_OPTIMIZE_FOR_SIZE=y
# CONFIG_SYSFS_SYSCALL is not set
CONFIG_KALLSYMS_ALL=y
CONFIG_EMBEDDED=y
# CONFIG_SLUB_DEBUG is not set
# CONFIG_COMPAT_BRK is not set
CONFIG_PROFILING=y
# CONFIG_MACH_SUN4I is not set
# CONFIG_MACH_SUN5I is not set
# CONFIG_MACH_SUN6I is not set
# CONFIG_MACH_SUN7I is not set
# CONFIG_MACH_SUN9I is not set
# CONFIG_VDSO is not set
CONFIG_SMP=y
CONFIG_HAVE_ARM_ARCH_TIMER=y
CONFIG_ARM_PSCI=y
CONFIG_OABI_COMPAT=y
CONFIG_HIGHMEM=y
# CONFIG_ARM_MODULE_PLTS is not set
# CONFIG_ATAGS is not set
CONFIG_CMDLINE="earlyprintk=sunxi-uart,0x01c28000 loglevel=8 initcall_debug=1 console=ttyS0 init=/init"
CONFIG_CPU_FREQ=y
CONFIG_CPU_FREQ_STAT=y
CONFIG_CPU_FREQ_DEFAULT_GOV_ONDEMAND=y
CONFIG_CPU_FREQ_GOV_POWERSAVE=y
CONFIG_CPU_FREQ_GOV_USERSPACE=y
CONFIG_CPU_FREQ_GOV_CONSERVATIVE=y
CONFIG_CPU_FREQ_GOV_SCHEDUTIL=y
CONFIG_VFP=y
CONFIG_NEON=y
CONFIG_PM_WAKELOCKS=y
CONFIG_PM_DEBUG=y
CONFIG_PM_ADVANCED_DEBUG=y
CONFIG_JUMP_LABEL=y
CONFIG_MODULES=y
CONFIG_MODULE_UNLOAD=y
CONFIG_MODULE_COMPRESS=y
# CONFIG_CORE_DUMP_DEFAULT_ELF_HEADERS is not set
# CONFIG_COMPACTION is not set
CONFIG_CMA=y
CONFIG_NET=y
CONFIG_PACKET=y
CONFIG_PACKET_DIAG=y
CONFIG_UNIX=y
CONFIG_UNIX_DIAG=y
CONFIG_INET=y
CONFIG_IP_MULTICAST=y
CONFIG_IP_ADVANCED_ROUTER=y
CONFIG_IP_FIB_TRIE_STATS=y
CONFIG_IP_MULTIPLE_TABLES=y
CONFIG_NETFILTER=y
CONFIG_NF_CONNTRACK=y
CONFIG_NF_CONNTRACK_MARK=y
CONFIG_NF_CONNTRACK_ZONES=y
CONFIG_NF_CONNTRACK_EVENTS=y
CONFIG_NF_CONNTRACK_TIMESTAMP=y
CONFIG_NETFILTER_XT_TARGET_MASQUERADE=y
CONFIG_IP_NF_IPTABLES=y
CONFIG_IP_NF_NAT=y
CONFIG_BT=y
CONFIG_BT_RFCOMM=y
CONFIG_BT_RFCOMM_TTY=y
CONFIG_BT_HCIUART=y
CONFIG_BT_HCIUART_H4=y
CONFIG_CFG80211=y
CONFIG_NL80211_TESTMODE=y
CONFIG_CFG80211_DEVELOPER_WARNINGS=y
CONFIG_CFG80211_CERTIFICATION_ONUS=y
# CONFIG_CFG80211_REQUIRE_SIGNED_REGDB is not set
CONFIG_CFG80211_DEBUGFS=y
# CONFIG_CFG80211_CRDA_SUPPORT is not set
CONFIG_CFG80211_WEXT=y
CONFIG_MAC80211=y
CONFIG_MAC80211_MESH=y
CONFIG_RFKILL=y
CONFIG_RFKILL_INPUT=y
CONFIG_RFKILL_GPIO=y
CONFIG_PCI=y
CONFIG_PCI_MSI=y
CONFIG_UEVENT_HELPER=y
CONFIG_UEVENT_HELPER_PATH="/sbin/hotplug"
CONFIG_DEVTMPFS=y
# CONFIG_SUNXI_RSB is not set
CONFIG_BLK_DEV_SD=y
# CONFIG_NET_VENDOR_ALLWINNER is not set
CONFIG_MDIO_SUN4I=y
CONFIG_USB_USBNET=y
# CONFIG_INPUT_MOUSE is not set
CONFIG_INPUT_TOUCHSCREEN=y
CONFIG_TOUCHSCREEN_EDT_FT5X06=y
CONFIG_INPUT_MISC=y
CONFIG_INPUT_UINPUT=y
# CONFIG_LEGACY_PTYS is not set
# CONFIG_HW_RANDOM is not set
# CONFIG_DEVMEM is not set
CONFIG_SPI_MEM=y
CONFIG_SPI_SPIDEV=y
# CONFIG_PINCTRL_SUN4I_A10 is not set
# CONFIG_PINCTRL_SUN8I_A23 is not set
# CONFIG_PINCTRL_SUN8I_A33 is not set
# CONFIG_PINCTRL_SUN8I_A83T is not set
# CONFIG_PINCTRL_SUN8I_A83T_R is not set
# CONFIG_PINCTRL_SUN8I_A23_R is not set
# CONFIG_PINCTRL_SUN8I_H3 is not set
# CONFIG_PINCTRL_SUN8I_H3_R is not set
# CONFIG_PINCTRL_SUN8I_V3S is not set
CONFIG_GPIO_SYSFS=y
CONFIG_THERMAL_STATISTICS=y
# CONFIG_THERMAL_HWMON is not set
CONFIG_THERMAL_WRITABLE_TRIPS=y
CONFIG_THERMAL_GOV_FAIR_SHARE=y
CONFIG_THERMAL_GOV_BANG_BANG=y
CONFIG_THERMAL_GOV_USER_SPACE=y
CONFIG_CPU_THERMAL=y
CONFIG_THERMAL_EMULATION=y
CONFIG_REGULATOR_FIXED_VOLTAGE=y
# CONFIG_MEDIA_CEC_SUPPORT is not set
CONFIG_MEDIA_USB_SUPPORT=y
CONFIG_USB_VIDEO_CLASS=y
CONFIG_FB=y
CONFIG_SOUND=y
CONFIG_SND=y
CONFIG_SND_USB_AUDIO=y
CONFIG_SND_SOC=y
CONFIG_UHID=y
CONFIG_USB=y
CONFIG_USB_EHCI_HCD=y
CONFIG_USB_OHCI_HCD=y
CONFIG_USB_STORAGE=y
CONFIG_USB_STORAGE_REALTEK=y
CONFIG_USB_STORAGE_DATAFAB=y
CONFIG_USB_STORAGE_FREECOM=y
CONFIG_USB_STORAGE_ISD200=y
CONFIG_USB_STORAGE_USBAT=y
CONFIG_USB_STORAGE_SDDR09=y
CONFIG_USB_STORAGE_SDDR55=y
CONFIG_USB_STORAGE_JUMPSHOT=y
CONFIG_USB_STORAGE_ALAUDA=y
CONFIG_USB_STORAGE_ONETOUCH=y
CONFIG_USB_STORAGE_KARMA=y
CONFIG_USB_STORAGE_CYPRESS_ATACB=y
CONFIG_USB_STORAGE_ENE_UB6250=y
CONFIG_USB_UAS=y
CONFIG_USB_SERIAL=y
CONFIG_USB_SERIAL_OPTION=y
CONFIG_USB_GADGET=y
CONFIG_USB_CONFIGFS=y
CONFIG_USB_CONFIGFS_ACM=y
CONFIG_USB_CONFIGFS_RNDIS=y
CONFIG_USB_CONFIGFS_MASS_STORAGE=y
CONFIG_USB_CONFIGFS_F_FS=y
CONFIG_USB_CONFIGFS_F_HID=y
CONFIG_USB_ROLE_SWITCH=y
CONFIG_MMC=y
CONFIG_MMC_HSQ=y
CONFIG_NEW_LEDS=y
CONFIG_LEDS_CLASS=y
CONFIG_LEDS_GPIO=y
CONFIG_LEDS_TRIGGERS=y
CONFIG_LEDS_TRIGGER_HEARTBEAT=y
CONFIG_LEDS_TRIGGER_GPIO=y
CONFIG_RTC_CLASS=y
CONFIG_RTC_DRV_RX8010=y
# CONFIG_RTC_DRV_SUN6I is not set
CONFIG_DMABUF_HEAPS=y
CONFIG_DMABUF_HEAPS_SYSTEM=y
CONFIG_DMABUF_HEAPS_CMA=y
CONFIG_DMABUF_HEAPS_DEFERRED_FREE=y
CONFIG_DMABUF_HEAPS_PAGE_POOL=y
CONFIG_STAGING=y
# CONFIG_CLK_SUNXI is not set
# CONFIG_SUNXI_CCU is not set
# CONFIG_IOMMU_SUPPORT is not set
CONFIG_PM_DEVFREQ=y
CONFIG_DEVFREQ_GOV_SIMPLE_ONDEMAND=y
CONFIG_EXTCON=y
CONFIG_EXT4_FS=y
# CONFIG_DNOTIFY is not set
CONFIG_AUTOFS_FS=y
CONFIG_FUSE_FS=y
CONFIG_MSDOS_FS=y
CONFIG_VFAT_FS=y
CONFIG_TMPFS=y
CONFIG_TMPFS_POSIX_ACL=y
CONFIG_UBIFS_FS=y
CONFIG_SQUASHFS=y
CONFIG_NFS_FS=y
CONFIG_NFSD=y
CONFIG_CIFS=y
CONFIG_NLS_CODEPAGE_437=y
CONFIG_NLS_ISO8859_1=y
CONFIG_CRYPTO_RSA=y
CONFIG_ASYMMETRIC_KEY_TYPE=y
CONFIG_ASYMMETRIC_PUBLIC_KEY_SUBTYPE=y
CONFIG_X509_CERTIFICATE_PARSER=y
CONFIG_PKCS7_MESSAGE_PARSER=y
CONFIG_SYSTEM_TRUSTED_KEYRING=y
CONFIG_CRC_T10DIF=y
CONFIG_XZ_DEC=y
CONFIG_DMA_CMA=y
CONFIG_PRINTK_TIME=y
CONFIG_DYNAMIC_DEBUG=y
CONFIG_DEBUG_INFO=y
CONFIG_FRAME_WARN=2048
CONFIG_MAGIC_SYSRQ=y
CONFIG_DEBUG_FS=y
CONFIG_DEBUG_VM=y
# CONFIG_SCHED_DEBUG is not set
CONFIG_DEBUG_MUTEXES=y
CONFIG_STACKTRACE=y
# CONFIG_FTRACE is not set
CONFIG_DEBUG_LL=y
CONFIG_ATOMIC64_SELFTEST=y
```

## bsp/meta-openeuler-bsp/wic/sdimage-opi.wks
```
# Disk layout
# reference: https://opensource.rock-chips.com/wiki_Partitions
# Note that the reference documentation refers to 512 byte disk sectors,
# but wic uses 1KB blocks
#
#   Partition   Start Sector    Number of Sectors
#   loader1     64              8000
#   reserved1   8064            128
#   reserved2   8192            8192
#   loader2     16384           8192
#   atf         24576           8192
#   boot        32768           229376
#   root        262144          -           (suggested)

part loader1  --offset 32     --fixed-size 4000K         --no-table    --source rawcopy   --sourceparams="file=idblock.img"
part loader2  --offset 8192   --fixed-size 4096K         --no-table    --source rawcopy   --sourceparams="file=uboot.img"
part atf      --offset 12288  --fixed-size 4096K         --no-table    --source rawcopy   --sourceparams="file=trust.img"
part /boot    --offset 16384  --source bootimg-partition --fstype=vfat --label boot       --sourceparams="loader=u-boot" --ondisk mmcblk1 --active
part /                        --source rootfs            --fstype ext4 --part-name rootfs --ondisk mmcblk1

bootloader --ptable gpt --configfile="${DEPLOY_DIR_IMAGE}/extlinux.conf"
```

## bsp/meta-openeuler-bsp/wic/sdimage-vfive2.wks
```
# Create VisionFive2 SD card image

# the u-boot will read vf2_uEnv.txt from mmc 1:3
# just reserve the first two partitions
part --ondisk mmcblk1 --align 4096 --label empty1 --size 1
part --ondisk mmcblk1 --align 4096 --label empty2 --size 1
# this partition contains kernel, dtb, vf2_uEnv.txt and extlinux.conf
part /boot --source bootimg-partition --ondisk mmcblk1 --label boot --fstype=vfat --sourceparams="loader=u-boot" --active --align 4096
# this part is purely the rootfs partition
part / --source rootfs --ondisk mmcblk1 --fstype=ext4 --label root --align 4096

# the default extlinux file is predefined
bootloader --ptable gpt --configfile="${DEPLOY_DIR_IMAGE}/visionfive-v2-extlinux.conf"
```

## bsp/meta-phytium/conf/layer.conf
```bitbake
# This bsp have a conf add classes directory, add to BBPATH
BBPATH =. "${LAYERDIR}:"

BBFILES += "${LAYERDIR}/recipes-*/*/*.bb \
            ${LAYERDIR}/recipes-*/*/*.bbappend"

BBFILE_COLLECTIONS += "phytium"
BBFILE_PATTERN_phytium = "^${LAYERDIR}/"
BBFILE_PRIORITY_phytium = "6"

LAYERDEPENDS_phytium = "core"
LAYERSERIES_COMPAT_phytium = "kirkstone"

LICENSE_PATH += "${LAYERDIR}/custom-licenses"

# genimage requires
HOSTTOOLS:append = " tune2fs e2fsck"
```

## bsp/meta-phytium/conf/machine/d2000.conf
```bitbake
require conf/machine/include/tengrui.inc

MACHINEOVERRIDES =. "d2000:march64le:"
MACHINE_FEATURES =. "efi pci serial usbhost ext2 ext3 ext4"

IMAGE_FSTYPES = "wic"
WKS_FILE = "efi-image-phytium.wks"
```

## bsp/meta-phytium/conf/machine/ft2000-4.conf
```bitbake
require conf/machine/include/tengrui.inc

MACHINEOVERRIDES =. "ft2000-4:march64le:"
MACHINE_FEATURES =. "efi pci serial usbhost ext2 ext3 ext4"

IMAGE_FSTYPES = "wic"
WKS_FILE = "efi-image-phytium.wks"
```

## bsp/meta-phytium/conf/machine/include/phytium-base.inc
```bitbake
require conf/machine/include/arm/arch-armv8a.inc
require conf/multilib.conf
# currently, don't support 32 bit libs
MULTILIBS = ""

DEFAULTTUNE = "aarch64"

ROOTFS_PACKAGE_ARCH = "aarch64"

# arm and arm64 both support -mlittle-endian so no
# need to consider compat32.
TUNE_CCARGS .= " -mlittle-endian"

IMAGE_INSTALL:append = " kernel-modules grub-efi"
IMAGE_INSTALL:remove = " syslinux"

# recovery EFI_PROVIDER option, which is removed in packagegroup-core-boot
EFI_PROVIDER ??= "grub-efi"

KERNEL_DEVICETREE ?= " phytium/pe2201-demo-ddr4.dtb phytium/pe2202-chillipi-edu-board.dtb phytium/pe2202-demo-ddr4.dtb phytium/pe2202-miniitx-board.dtb phytium/pe2202-power-board.dtb phytium/pe2204-come-board.dtb phytium/pe2204-demo-ddr4.dtb phytium/pe2204-edu-board.dtb phytium/pe2204-hanwei-board.dtb phytium/pe2204-miniitx-board.dtb phytium/pe2204-vpx-board.dtb phytium/phytiumpi_firefly.dtb"
```

## bsp/meta-phytium/conf/machine/include/tengrui.inc
```bitbake
require conf/machine/include/arm/arch-armv8a.inc
require conf/multilib.conf
# currently, don't support 32 bit libs
MULTILIBS = ""

DEFAULTTUNE = "aarch64"

ROOTFS_PACKAGE_ARCH = "aarch64"

KERNEL_IMAGETYPE = "Image"

# serial console setting
SERIAL_CONSOLES = "115200;ttyAMA0"

# arm and arm64 both support -mlittle-endian so no
# need to consider compat32.
TUNE_CCARGS .= " -mlittle-endian"

# recovery EFI_PROVIDER option, which is removed in packagegroup-core-boot
EFI_PROVIDER ??= "grub-efi"
IMAGE_INSTALL:append = " ${@bb.utils.contains("MACHINE_FEATURES", "efi", "${EFI_PROVIDER}", "", d)} "
```
