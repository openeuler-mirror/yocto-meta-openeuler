/dts-v1/;
/plugin/;

/ {
	fragment@0 {
        target-path = "/";
		__overlay__ {
            reserved-memory {
                #address-cells = <2>;
                #size-cells = <1>;

                mcsconfig: mcs@70000000 {
                    compatible = "mcs_mem";
                    #address-cells = <2>;
                    #size-cells = <1>;
                    reg = <0x0 0x70000000 0x10000000>;
                };
            };
		};
	};
};
