## bsp/meta-hisilicon/conf/machine/hi3095.conf
```bitbake
require conf/machine/include/hi3095.inc

# auto load module during startup
KERNEL_MODULE_AUTOLOAD = " ${@bb.utils.contains('MCS_FEATURES', 'openamp', 'mcs_km', '', d)} "
```
