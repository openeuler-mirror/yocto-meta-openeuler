drm@401000000 {
    compatible = "atlas-200a2,plat-drm";
    reg = <0x4 0x1000000 0x0 0x4000>;
    interrupt-parent = <&mbigen_vdp0>;
    interrupts = <0x38E 0x4>;
    interrupt-names = "drm0";
    dma-coherent;
    memory-region = <&hmi_cma>;
};
