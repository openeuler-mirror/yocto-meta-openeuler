
	devdrv@0x130000000 {
		compatible = "hisi,mini-devdrv-device";
		#address-cells = <0x2>;
		#size-cells = <0x2>;
		reg = <0x1 0x09000000 0x0 0x10000>,  /* 0 GICV3_base */
			  <0x1 0x02060000 0x0 0x10000>,  /* 1 Dispatch */
			  <0x0 0x80000000 0x0 0x10000>,  /* 2 SYSCTL */
			  <0x1 0x000A0000 0x0 0x1000>,   /* 3 MN */
			  <0x1 0x100C3000 0x0 0x1000>,   /* 4 LPM3_STATUS_BASE */
			  <0x9 0x00000000 0x0 0x10000>,  /* 5 FIRMWARE_CORE_RESET_ENTRY */
			  <0x1 0x000E0000 0x0 0x10000>,  /* 6 FIRMWARE_CLUSTER0_SUBCTRL_PHYS */
			  <0x8 0x80080000 0x0 0x10000>;  /* 7 TSCPU_FIRMWARE_CORE_RESET_ENTRY */

		chip_id = <0>;
		aicpu,ts2ai_interrupt = <328>;
		aicpu,host_interrpt = <312>;
		aicpu,ipc_cpu_interrpt = <201>;
		aicpu,ipc_mbx_interrpt = <213>;
		aicpu,system_freq = <50000000>;

		aicpu,esl_occupy_bitmap = <0xF0>;
		aicpu,emu_occupy_bitmap = <0xF0>;
		aicpu,fpga_occupy_bitmap = <0x02>;
		aicpu,asic_occupy_bitmap = <0xFFFC>;

		status = "ok";

		ts-0 {
			compatible = "ts-0";
			tsid = <0>;
			interrupts = <0 0xDC 1>, <0 0xED 1>, <0 0x135 1>;
			ts_sysctl_paddr = <0x0 0xba080000>;
			ts_sysctl_size = <0x1000>;
			ts_doorbell_paddr = <0x0 0xbac00000>;
			ts_doorbell_size = <0x400000>;
			ts_sram_paddr = <0x0 0xba400000>;
			ts_sram_size = <0x1000>;
		};

	};

