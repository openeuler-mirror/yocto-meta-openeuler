	hdmi:hdmi {
		#address-cells = <0x2>;
		#size-cells = <0x2>;
		compatible = "vendor,hdmi";
		reg = <0x4 0x1A0000 0x0 0x20000>,
		      <0x4 0x180000 0x0 0x10000>,
		      <0x4 0x1C0000 0x0 0x20000>,
		      <0x4 0x190000 0x0 0x10000>;
		reg-names = "hdmi0", "phy0", "hdmi1", "phy1";
	};
