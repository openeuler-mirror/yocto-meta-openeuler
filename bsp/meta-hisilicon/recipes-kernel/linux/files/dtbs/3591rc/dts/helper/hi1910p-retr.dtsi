	davinci_retr: retr@c9c00000 {
		compatible = "davinci,retr";
		reg = <0x0 0xc9c00000 0x0 0x400000>;
		interrupt-parent = <&mbigen_retr>;
		interrupts = <576 0x4>;
		chip_id = <0>;
		irq_affinity_hint = <0>;
		retr_smmu0{
			compatible = "davinci,retr,smmu";
			iommus = <&dsmmu2 0x7f23>;
			dma-coherent;
			dma-can-stall;
			pasid-bits = <0x10>;
			pasid-num-bits = <16>;
		};
		retr_smmu1{
			compatible = "davinci,retr,smmu";
			iommus = <&dsmmu3 0x7f24>;
			dma-coherent;
			dma-can-stall;
			pasid-bits = <0x10>;
			pasid-num-bits = <16>;
		};
	};
