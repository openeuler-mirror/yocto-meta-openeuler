davinci_devfault_sfc {
	compatible = "sfc";
	#address-cells = <0x2>;
	#size-cells = <0x2>;
	chip_id = <0>;

	int_sfc_hiss@0x84100000 {
			compatible = "int_sfc_hiss";
			reg = <0x0 0x84100000 0x0 0x10000>;
			interrupt-parent = <&mbigen_sfc>;
			interrupts = <744 0x4>; /* 64 +  128*5 + 40; int_sfc_hiss */
			smmuflag = <0x0>;
	};
};
