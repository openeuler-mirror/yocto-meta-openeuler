
    hi195x_pm {
        compatible = "hisilicon,hi195x-pm";
    };

    drv_lpm_devmng {
        compatible = "hisi,lpm_dev_manager";
    };

    drv_lpm_fault {
        compatible = "hisi,lpm_fault_manager";
    };
