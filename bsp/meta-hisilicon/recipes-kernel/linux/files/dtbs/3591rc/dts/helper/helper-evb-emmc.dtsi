
	aliases {
		mshc0 = &dwmmc0;
	};

	/* dw emmc 4.5 */
	dwmmc0: dwmmc0@A4580000 {
		compatible = "hisilicon,davinci-dw-mshc";
		#address-cells = <0x2>;
		#size-cells = <0x2>;
		reg = <0x0 0xA4580000 0x0 0x1000>,
		      <0x0 0xA40C0000 0x0 0x10000>,
		      <0x0 0x80000000 0x0 0x10000>;
		interrupts = <0 123 4>;
		customized;
		num-slots = <1>;
		mshc = <0x0>;
		device-type = <0x1>;
		fifo-depth = <0x100>;
		card-detect-delay = <200>;
		broken-cd;
		non-removable;
		supports-highspeed;
		caps2-mmc-hs200-1_8v;
		caps2-mmc-cache-ctrl;
		keep-power-in-suspend;
		caps2-mmc-bkops_auto-ctrl;
		pinctrl-names = "default", "idle";
		pinctrl-0 = <&gpio13_pmx_func &gpio14_pmx_func &gpio15_pmx_func
			&gpio16_pmx_func &gpio17_pmx_func &gpio18_pmx_func
			&gpio19_pmx_func &gpio20_pmx_func &gpio21_pmx_func
			&gpio22_pmx_func &gpio13_cfg_func &gpio14_cfg_func
			&gpio15_cfg_func &gpio16_cfg_func &gpio17_cfg_func
			&gpio18_cfg_func &gpio19_cfg_func &gpio20_cfg_func
			&gpio21_cfg_func &gpio22_cfg_func>;
		pinctrl-1 = <&gpio13_pmx_idle &gpio14_pmx_idle &gpio15_pmx_idle
			&gpio16_pmx_idle &gpio17_pmx_idle &gpio18_pmx_idle
			&gpio19_pmx_idle &gpio20_pmx_idle &gpio21_pmx_idle
			&gpio22_pmx_idle &gpio13_cfg_idle &gpio14_cfg_idle
			&gpio15_cfg_idle &gpio16_cfg_idle &gpio17_cfg_idle
			&gpio18_cfg_idle &gpio19_cfg_idle &gpio20_cfg_idle
			&gpio21_cfg_idle &gpio22_cfg_idle>;
		status = "ok";
		slot@0 {
			reg = <0 0 0 0>;
			bus-width = <8>;
			disable-wp;
		};

		mmccard: mmccard@0 {
			reg = <0 0 0 0>;
			compatible = "mmc-card";
			broken-hpi;
		};
	};

