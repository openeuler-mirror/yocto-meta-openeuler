    hi191x_pm {
        compatible = "hisilicon,hi191x-pm";
    };

    /* pm used gpios:
     *    port8-0 sleep_in
     *    port8-1 sleep_out
     *    port8-2 power_button
     *    poer8-3 power_out
     */
    gpio8@C4060000 {
        compatible = "snps,dw-apb-gpio";
        reg = <0x0 0xC4060000 0x0 0x1000>;
        #address-cells = <1>;
        #size-cells = <0>;

        port8: gpio-controller@0 {
            compatible = "snps,dw-apb-gpio-port";
            gpio-controller;
            #gpio-cells = <2>;
            snps,nr-gpios = <4>;
            reg = <0>;
            interrupt-controller;
            interrupt-parent = <&mbigen_gpio8>;
            interrupts = <801 0x4>,
                         <802 0x4>,
                         <802 0x4>,
                         <803 0x4>;
            status = "ok";
        };
    };
