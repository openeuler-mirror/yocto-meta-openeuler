    power_off {
        compatible = "hisi,power_off";
        pinctrl-names = "default";
        reg = <0x0 0x840F0000 0x0 0x10000>;
        pinctrl-0 = <&gpio271_pmx_func &gpio271_cfg_func>;
        power-down-gpio = <&porth 15 0>;
        status = "ok";
    };