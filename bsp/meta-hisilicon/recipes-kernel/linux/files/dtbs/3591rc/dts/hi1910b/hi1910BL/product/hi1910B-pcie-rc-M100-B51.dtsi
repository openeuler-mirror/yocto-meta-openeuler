	pcie@0x820000000 {
		compatible = "ascend-pcie-rc";
		pcie-core-id = <0>;
		// ECAM 0x820000000 pci host bridge0
		reg = <0x8 0x20000000 0 0x00400000>;
		reg-names = "ecam-cfg";
		bus-range = <0x0 0x3>;
		msi-map = <0x0 &its 0x0 0x2000>;
		msi-map-mask = <0xffff>;
		#address-cells = <3>;
		#size-cells = <2>;
		device_type = "pci";
		dma-coherent;
		// BAR MAP: 32bit mem 64M, 64bit mem 256M
		ranges = <0x02000000 0x0 0xB0000000 0x0 0xB0000000 0x0 0x04000000
				  0x43000000 0x8 0x30000000 0x8 0x30000000 0x0 0x10000000>;
		#interrupt-cells = <1>;
		interrupt-map-mask = <0xff0000 0 0 0x7>;
		// INTX
		interrupt-map = <0x00000 0 0 1 &mbigen_pcie0_local 704 4
						 0x00000 0 0 1 &mbigen_pcie0_local 705 4
						 0x00000 0 0 1 &mbigen_pcie0_local 706 4
						 0x00000 0 0 1 &mbigen_pcie0_local 707 4>;
		iommu-map = <0 &io_smmu 0 0x400>;
		status = "ok";
	};

	pcie@0x840000000 {
		compatible = "ascend-pcie-rc";
		pcie-core-id = <1>;
		// ECAM 0x840000000 pci host bridge0
		reg = <0x8 0x40400000 0 0x00400000>;
		reg-names = "ecam-cfg";
		bus-range = <0x4 0x7>;
		msi-map = <0x400 &its 0x400 0x2000>;
		msi-map-mask = <0xffff>;
		#address-cells = <3>;
		#size-cells = <2>;
		device_type = "pci";
		dma-coherent;
		// BAR MAP: 32bit mem 64M, 64bit mem 256M
		ranges = <0x02000000 0x0 0xB4000000 0x0 0xB4000000 0x0 0x04000000
				  0x43000000 0x8 0x50000000 0x8 0x50000000 0x0 0x10000000>;
		#interrupt-cells = <1>;
		interrupt-map-mask = <0xff0000 0 0 0x7>;
		// INTX
		interrupt-map = <0x40000 0 0 1 &mbigen_pcie1_local 712 4
						 0x40000 0 0 1 &mbigen_pcie1_local 713 4
						 0x40000 0 0 1 &mbigen_pcie1_local 714 4
						 0x40000 0 0 1 &mbigen_pcie1_local 715 4>;
		iommu-map = <0x400 &io_smmu 0x400 0x400>;
		status = "ok";
	};

	pcie@0x860000000 {
		compatible = "ascend-pcie-rc";
		pcie-core-id = <2>;
		// ECAM 0x860000000 pci host bridge0
		reg = <0x8 0x60800000 0 0x00400000>;
		reg-names = "ecam-cfg";
		bus-range = <0x8 0xb>;
		msi-map = <0x800 &its 0x800 0x2000>;
		msi-map-mask = <0xffff>;
		#address-cells = <3>;
		#size-cells = <2>;
		device_type = "pci";
		dma-coherent;
		// BAR MAP: 32bit mem 64M, 64bit mem 256M
		ranges = <0x02000000 0x0 0xB8000000 0x0 0xB8000000 0x0 0x04000000
				  0x43000000 0x8 0x70000000 0x8 0x70000000 0x0 0x10000000>;
		#interrupt-cells = <1>;
		interrupt-map-mask = <0xff0000 0 0 0x7>;
		// INTX
		interrupt-map = <0x80000 0 0 1 &mbigen_pcie2_local 720 4
						 0x80000 0 0 1 &mbigen_pcie2_local 721 4
						 0x80000 0 0 1 &mbigen_pcie2_local 722 4
						 0x80000 0 0 1 &mbigen_pcie2_local 723 4>;
		iommu-map = <0x800 &io_smmu 0x800 0x400>;
		status = "ok";
	};

	pcie@0x900000000 {
		compatible = "ascend-pcie-rc";
		pcie-core-id = <3>;
		// ECAM 0x900000000 pci host bridge0
		reg = <0x9 0x00c00000 0 0x00400000>;
		reg-names = "ecam-cfg";
		bus-range = <0xc 0xf>;
		msi-map = <0xc00 &its 0xc00 0x2000>;
		msi-map-mask = <0xffff>;
		#address-cells = <3>;
		#size-cells = <2>;
		device_type = "pci";
		dma-coherent;
		// BAR MAP: 32bit mem 64M, 64bit mem 256M
		ranges = <0x02000000 0x0 0xBC000000 0x0 0xBC000000 0x0 0x04000000
				  0x43000000 0x9 0x10000000 0x9 0x10000000 0x0 0x10000000>;
		#interrupt-cells = <1>;
		interrupt-map-mask = <0xff0000 0 0 0x7>;
		// INTX
		interrupt-map = <0xc0000 0 0 1 &mbigen_pcie3_local 728 4
						 0xc0000 0 0 1 &mbigen_pcie3_local 729 4
						 0xc0000 0 0 1 &mbigen_pcie3_local 730 4
						 0xc0000 0 0 1 &mbigen_pcie3_local 731 4>;
		iommu-map = <0xc00 &io_smmu 0xc00 0x400>;
		status = "ok";
	};
