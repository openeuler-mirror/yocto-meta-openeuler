	eth0:xge0@a7100000 {
		compatible = "hisilicon,hns3-platform-device";
		id = <0>;
		reg = <0x0 0xa7100000 0x0 0x10000>,
			  <0x0 0xa7000000 0x0 0x800000>,
			  <0x0 0xa0120000 0x0 0x10000>,
			  <0x0 0xa0180000 0x0 0x10000>,
			  <0x0 0xa0160000 0x0 0x10000>,
			  <0x0 0xa0150000 0x0 0x10000>,
			  <0x0 0xa0140000 0x0 0x10000>,
			  <0x0 0xa0100000 0x0 0x10000>;
		reg-names = "network_base";
		//249 +#253 - 32 = 0xdd
		interrupts = <
		0x0 0xd9 0x1
		0x0 0xda 0x1
		0x0 0xdb 0x1
		0x0 0xdc 0x1
		0x0 0xdd 0x1
		0x0 0xde 0x1
		0x0 0xdf 0x1
		0x0 0xe0 0x1
		0x0 0xe1 0x1
		0x0 0xe2 0x1
		0x0 0xe3 0x1
		0x0 0xe4 0x1
		0x0 0xe5 0x1
		0x0 0xe6 0x1
		0x0 0xe7 0x1
		0x0 0xe8 0x1
		0x0 0xe9 0x4
		0x0 0xed 0x4
		0x0 0xd1 0x4>;
		status = "ok";
		tc_num = <8>;
		queue_num = <8>;
		gpio_index = <6>;
		phy_addr = <0>;
		phy_mode = <1>; // 0:sgmii 1:rgmii 2:sfp
		port_speed = <1000>; // 10: 10M, 100: 100M, 1000: 1G; 2500: 2.5G(only phy_mode sfp support)
		ds_index = <2>;
		phy_gpio_index = <12>;
	};

	eth1:xge1@a7200000 {
		compatible = "hisilicon,hns3-platform-device";
		id = <1>;
		reg = <0x0 0xa7200000 0x0 0x10000>,
			  <0x0 0xa7000000 0x0 0x800000>,
			  <0x0 0xa0120000 0x0 0x10000>,
			  <0x0 0xa0190000 0x0 0x10000>,
			  <0x0 0xa0160000 0x0 0x10000>,
			  <0x0 0xa0150000 0x0 0x10000>,
			  <0x0 0xa0140000 0x0 0x10000>,
			  <0x0 0xa0100000 0x0 0x10000>;
		reg-names = "network_base";
		//249 +#253 - 32 = 0xdd
		interrupts = <
		0x0 0xd9 0x1
		0x0 0xda 0x1
		0x0 0xdb 0x1
		0x0 0xdc 0x1
		0x0 0xdd 0x1
		0x0 0xde 0x1
		0x0 0xdf 0x1
		0x0 0xe0 0x1
		0x0 0xe1 0x1
		0x0 0xe2 0x1
		0x0 0xe3 0x1
		0x0 0xe4 0x1
		0x0 0xe5 0x1
		0x0 0xe6 0x1
		0x0 0xe7 0x1
		0x0 0xe8 0x1
		0x0 0xea 0x4
		0x0 0xee 0x4
		0x0 0xd2 0x4>;
		status = "ok";
		tc_num = <8>;
		queue_num = <8>;
		gpio_index = <9>;
		phy_addr = <1>;
		phy_mode = <1>; // 0:sgmii 1:rgmii 2:sfp
		port_speed = <1000>; // 10: 10M, 100: 100M, 1000: 1G; 2500: 2.5G(only phy_mode sfp support)
		ds_index = <3>;
		phy_gpio_index = <25>;
	};

	xge2@a7300000 {
		compatible = "hisilicon,hns3-platform-device2";
		id = <2>;
		reg = <0x0 0xa7300000 0x0 0x10000>,
			  <0x0 0xa7000000 0x0 0x800000>,
			  <0x0 0xa0120000 0x0 0x10000>,
			  <0x0 0xa0180000 0x0 0x10000>,
			  <0x0 0xa0160000 0x0 0x10000>,
			  <0x0 0xa0150000 0x0 0x10000>,
			  <0x0 0xa0140000 0x0 0x10000>,
			  <0x0 0xa0100000 0x0 0x10000>;
		reg-names = "network_base";
		//249 +#253 - 32 = 0xdd
		interrupts = <
		0x0 0xd9 0x1
		0x0 0xda 0x1
		0x0 0xdb 0x1
		0x0 0xdc 0x1
		0x0 0xdd 0x1
		0x0 0xde 0x1
		0x0 0xdf 0x1
		0x0 0xe0 0x1
		0x0 0xe1 0x1
		0x0 0xe2 0x1
		0x0 0xe3 0x1
		0x0 0xe4 0x1
		0x0 0xe5 0x1
		0x0 0xe6 0x1
		0x0 0xe7 0x1
		0x0 0xe8 0x1
		0x0 0xeb 0x4
		0x0 0xef 0x4
		0x0 0xd3 0x4>;
		status = "ok";
		tc_num = <4>;
		queue_num = <4>;
		gpio_index = <6>;
		phy_addr = <0xff>;
		phy_mode = <2>; // 0:sgmii 1:rgmii 2:sfp
		port_speed = <1000>; // 10: 10M, 100: 100M, 1000: 1G; 2500: 2.5G(only phy_mode sfp support)
		ds_index = <0>;
		phy_gpio_index = <0xff>;
	};

	xge3@a7400000 {
		compatible = "hisilicon,hns3-platform-device3";
		id = <3>;
		reg = <0x0 0xa7400000 0x0 0x10000>,
			  <0x0 0xa7000000 0x0 0x800000>,
			  <0x0 0xa0120000 0x0 0x10000>,
			  <0x0 0xa0180000 0x0 0x10000>,
			  <0x0 0xa0160000 0x0 0x10000>,
			  <0x0 0xa0150000 0x0 0x10000>,
			  <0x0 0xa0140000 0x0 0x10000>,
			  <0x0 0xa0100000 0x0 0x10000>;
		reg-names = "network_base";
		//249 +#253 - 32 = 0xdd
		interrupts = <
		0x0 0xd9 0x1
		0x0 0xda 0x1
		0x0 0xdb 0x1
		0x0 0xdc 0x1
		0x0 0xdd 0x1
		0x0 0xde 0x1
		0x0 0xdf 0x1
		0x0 0xe0 0x1
		0x0 0xe1 0x1
		0x0 0xe2 0x1
		0x0 0xe3 0x1
		0x0 0xe4 0x1
		0x0 0xe5 0x1
		0x0 0xe6 0x1
		0x0 0xe7 0x1
		0x0 0xe8 0x1
		0x0 0xec 0x4
		0x0 0xf0 0x4
		0x0 0xd4 0x4>;
		status = "ok";
		tc_num = <4>;
		queue_num = <4>;
		gpio_index = <9>;
		phy_addr = <0xff>;
		phy_mode = <2>; // 0:sgmii 1:rgmii 2:sfp
		port_speed = <1000>; // 10: 10M, 100: 100M, 1000: 1G; 2500: 2.5G(only phy_mode sfp support)
		ds_index = <1>;
		phy_gpio_index = <0xff>;
	};
