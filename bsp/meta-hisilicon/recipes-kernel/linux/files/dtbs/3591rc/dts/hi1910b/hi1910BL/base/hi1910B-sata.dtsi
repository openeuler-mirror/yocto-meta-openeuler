sata:sata@0xa6000000 {
	compatible = "generic-ahci";
	interrupt-parent = <&mbigen_sata>;
	reg =  <0x0 0xa6000000 0x0 0x10000>;
	interrupts = <736 4>;
	dma-coherent;
	//iommus = <&io_smmu 0x1f>;
};
sata_dfx:sata_hisi {
	compatible = "sata_hisi";
	reg =  <0x0 0xa6000000 0x0 0x10000>;
	bus-num =<0>;
};

