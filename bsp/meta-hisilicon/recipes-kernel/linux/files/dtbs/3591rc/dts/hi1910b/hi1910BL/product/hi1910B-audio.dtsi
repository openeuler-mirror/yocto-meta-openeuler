audio: audio {
        compatible = "vendor,aiao";
        reg = <0x4 0x00160000 0x0 0x7000>, /* asp_wrap_reg */
              <0x4 0x00130000 0x0 0x10000>, /* adss_sub_subctrl_reg */
              <0x4 0x0314e000 0x0 0x400>, /* asp_cfg_reg */
              <0x4 0x00120000 0x0 0x4000>, /* adss_disp_reg */
              <0x4 0x0314b000 0x0 0x1000>, /* dma */
              <0x4 0x03152000 0x0 0x290>; /* i2s */
        reg-names = "asp-wrap","adss-sub","asp-cfg","adss-disp","dma","i2s";
        // 中断
        dmac = <0>;
        irq_name = "asp_dmac_irq";
        interrupt-names = "asp_dmac_irq";
        interrupts = <590 0x4>;
        interrupt-parent = <&mbigen_audio>;
        status = "ok";

};

audio-sys {
        compatible = "hisilicon,hisi-audio-sys";
};
