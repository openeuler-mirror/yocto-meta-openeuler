    caf_memory_manager:caf_memory_manager_node {
        compatible = "arm,physical-memory-group-manager";
        status = "ok";
    };

    mali@404000000 {
        compatible = "arm,malit6xx", "arm,mali-bifrost";
        reg = <0x4 0x4000000 0x0 0x4000>;
        interrupt-parent = <&mbigen_gpu>;
        interrupts = <0x2ec 0x4 0x2ed 0x4 0x2ee 0x4>;
        interrupt-names = "JOB", "MMU", "GPU";
        physical-memory-group-manager = <&caf_memory_manager>;
    };
