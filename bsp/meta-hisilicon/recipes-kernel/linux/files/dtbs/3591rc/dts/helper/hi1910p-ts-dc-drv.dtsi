	tsdrv@0x1F0200000 {
		compatible = "hisi,tsdrv_device";
		max_aicpu_num = <16>; /* 最大的aicpu core个数 */
		#address-cells = <0x2>;
		#size-cells = <0x2>;
		status = "ok";

		ts@0 {
			compatible = "ts-0";
			interrupts = <0 0xeb 4>; //aic interrupts = <0 235 4>;
		};
	};

