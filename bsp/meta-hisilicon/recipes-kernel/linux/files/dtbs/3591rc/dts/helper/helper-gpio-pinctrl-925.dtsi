	pmx_peri: pinmux@A4560000 {
		compatible = "pinctrl-single", "pinctrl-single1";
		reg = <0x0 0xA4560000 0x0 0x10c>;
		#gpio-range-cells = <3>;
		pinctrl-single,register-width = <32>;
		pinctrl-single,function-mask = <7>;
		#pinctrl-cells = <1>;
		//pinctrl-names = "default", "idle";
		//pinctrl-0 = <&iomg060_pmx_func>;
		//pinctrl-1 = <&iomg060_pmx_idle>;

		gpio0_pmx_func: gpio0_pmx_func {
			pinctrl-single,pins = <0x00    0x0>;
		};

		gpio0_pmx_idle: gpio0_pmx_idle {
			pinctrl-single,pins = <0x00    0x0>;
		};

		gpio1_pmx_func: gpio1_pmx_func {
			pinctrl-single,pins = <0x04    0x1>;
		};

		gpio1_pmx_idle: gpio1_pmx_idle {
			pinctrl-single,pins = <0x04    0x1>;
		};

		gpio2_pmx_func: gpio2_pmx_func {
			pinctrl-single,pins = <0x08    0x1>;
		};

		gpio2_pmx_idle: gpio2_pmx_idle {
			pinctrl-single,pins = <0x08    0x1>;
		};

		gpio3_pmx_func: gpio3_pmx_func {
			pinctrl-single,pins = <0x0c    0x1>;
		};

		gpio3_pmx_idle: gpio3_pmx_idle {
			pinctrl-single,pins = <0x0c    0x1>;
		};

		gpio4_pmx_func: gpio4_pmx_func {
			pinctrl-single,pins = <0x10    0x1>;
		};

		gpio4_pmx_idle: gpio4_pmx_idle {
			pinctrl-single,pins = <0x10    0x1>;
		};

		gpio5_pmx_func: gpio5_pmx_func {
			pinctrl-single,pins = <0x14    0x2>;
		};

		gpio5_pmx_idle: gpio5_pmx_idle {
			pinctrl-single,pins = <0x14    0x2>;
		};

		gpio6_pmx_func: gpio6_pmx_func {
			pinctrl-single,pins = <0x18    0x2>;
		};

		gpio6_pmx_idle: gpio6_pmx_idle {
			pinctrl-single,pins = <0x18    0x2>;
		};
		gpio13_pmx_func: gpio13_pmx_func {
			pinctrl-single,pins = <0x1c    0x1>;
		};

		gpio13_pmx_idle: gpio13_pmx_idle {
			pinctrl-single,pins = <0x1c    0x1>;
		};

		gpio14_pmx_func: gpio14_pmx_func {
			pinctrl-single,pins = <0x20    0x1>;
		};

		gpio14_pmx_idle: gpio14_pmx_idle {
			pinctrl-single,pins = <0x20    0x1>;
		};

		gpio15_pmx_func: gpio15_pmx_func {
			pinctrl-single,pins = <0x24    0x1>;
		};

		gpio15_pmx_idle: gpio15_pmx_idle {
			pinctrl-single,pins = <0x24    0x1>;
		};

		gpio16_pmx_func: gpio16_pmx_func {
			pinctrl-single,pins = <0x28    0x1>;
		};

		gpio16_pmx_idle: gpio16_pmx_idle {
			pinctrl-single,pins = <0x28    0x1>;
		};

		gpio17_pmx_func: gpio17_pmx_func {
			pinctrl-single,pins = <0x2c    0x1>;
		};

		gpio17_pmx_idle: gpio17_pmx_idle {
			pinctrl-single,pins = <0x2c    0x1>;
		};

		gpio18_pmx_func: gpio18_pmx_func {
			pinctrl-single,pins = <0x30    0x1>;
		};

		gpio18_pmx_idle: gpio18_pmx_idle {
			pinctrl-single,pins = <0x30    0x1>;
		};

		gpio19_pmx_func: gpio19_pmx_func {
			pinctrl-single,pins = <0x34    0x1>;
		};

		gpio19_pmx_idle: gpio19_pmx_idle {
			pinctrl-single,pins = <0x34    0x1>;
		};

		gpio20_pmx_func: gpio20_pmx_func {
			pinctrl-single,pins = <0x38    0x1>;
		};

		gpio20_pmx_idle: gpio20_pmx_idle {
			pinctrl-single,pins = <0x38    0x1>;
		};

		gpio21_pmx_func: gpio21_pmx_func {
			pinctrl-single,pins = <0x3c    0x1>;
		};

		gpio21_pmx_idle: gpio21_pmx_idle {
			pinctrl-single,pins = <0x3c    0x1>;
		};

		gpio22_pmx_func: gpio22_pmx_func {
			pinctrl-single,pins = <0x40    0x1>;
		};

		gpio22_pmx_idle: gpio22_pmx_idle {
			pinctrl-single,pins = <0x40    0x1>;
		};

		strob10_pmx_func: strob10_pmx_func {
			pinctrl-single,pins = <0x44    0x1>;
		};

		strob10_pmx_idle: strob10_pmx_idle {
			pinctrl-single,pins = <0x44    0x1>;
		};

		strob11_pmx_func: strob11_pmx_func {
			pinctrl-single,pins = <0x48    0x1>;
		};

		strob11_pmx_idle: strob11_pmx_idle {
			pinctrl-single,pins = <0x48    0x1>;
		};

		strob12_pmx_func: strob12_pmx_func {
			pinctrl-single,pins = <0x4c    0x1>;
		};

		strob12_pmx_idle: strob12_pmx_idle {
			pinctrl-single,pins = <0x4c    0x1>;
		};

		strob13_pmx_func: strob13_pmx_func {
			pinctrl-single,pins = <0x50    0x1>;
		};

		strob13_pmx_idle: strob13_pmx_idle {
			pinctrl-single,pins = <0x50    0x1>;
		};

		strob14_pmx_func: strob14_pmx_func {
			pinctrl-single,pins = <0x54    0x1>;
		};

		strob14_pmx_idle: strob14_pmx_idle {
			pinctrl-single,pins = <0x54    0x1>;
		};

		strob15_pmx_func: strob15_pmx_func {
			pinctrl-single,pins = <0x58    0x1>;
		};

		strob15_pmx_idle: strob15_pmx_idle {
			pinctrl-single,pins = <0x58    0x1>;
		};

		gpio23_pmx_func: gpio23_pmx_func {
			pinctrl-single,pins = <0x5c    0x0>;
		};

		gpio23_pmx_idle: gpio23_pmx_idle {
			pinctrl-single,pins = <0x5c    0x0>;
		};

		gpio24_pmx_func: gpio24_pmx_func {
			pinctrl-single,pins = <0x60    0x0>;
		};

		gpio24_pmx_idle: gpio24_pmx_idle {
			pinctrl-single,pins = <0x60    0x0>;
		};

		gpio25_pmx_func: gpio25_pmx_func {
			pinctrl-single,pins = <0x64    0x0>;
		};

		gpio25_pmx_idle: gpio25_pmx_idle {
			pinctrl-single,pins = <0x64    0x0>;
		};

		gpio26_pmx_func: gpio26_pmx_func {
			pinctrl-single,pins = <0x68    0x0>;
		};

		gpio26_pmx_idle: gpio26_pmx_idle {
			pinctrl-single,pins = <0x68    0x0>;
		};

		gpio27_pmx_func: gpio27_pmx_func {
			pinctrl-single,pins = <0x6C    0x0>;
		};

		gpio27_pmx_idle: gpio27_pmx_idle {
			pinctrl-single,pins = <0x6C    0x0>;
		};

		gpio28_pmx_func: gpio28_pmx_func {
			pinctrl-single,pins = <0x70    0x0>;
		};

		gpio28_pmx_idle: gpio28_pmx_idle {
			pinctrl-single,pins = <0x70    0x0>;
		};

		gpio29_pmx_func: gpio29_pmx_func {
			pinctrl-single,pins = <0x74    0x0>;
		};

		gpio29_pmx_idle: gpio29_pmx_idle {
			pinctrl-single,pins = <0x74    0x0>;
		};

		gpio30_pmx_func: gpio30_pmx_func {
			pinctrl-single,pins = <0x78    0x0>;
		};

		gpio30_pmx_idle: gpio30_pmx_idle {
			pinctrl-single,pins = <0x78    0x0>;
		};

		gpio31_pmx_func: gpio31_pmx_func {
			pinctrl-single,pins = <0x7C    0x0>;
		};

		gpio31_pmx_idle: gpio31_pmx_idle {
			pinctrl-single,pins = <0x7C    0x0>;
		};

		gpio32_pmx_func: gpio32_pmx_func {
			pinctrl-single,pins = <0x80    0x0>;
		};

		gpio32_pmx_idle: gpio32_pmx_idle {
			pinctrl-single,pins = <0x80    0x0>;
		};

		gpio33_pmx_func: gpio33_pmx_func {
			pinctrl-single,pins = <0x84    0x0>;
		};

		gpio33_pmx_idle: gpio33_pmx_idle {
			pinctrl-single,pins = <0x84    0x0>;
		};

		gpio34_pmx_func: gpio34_pmx_func {
			pinctrl-single,pins = <0x88    0x0>;
		};

		gpio34_pmx_idle: gpio34_pmx_idle {
			pinctrl-single,pins = <0x88    0x0>;
		};

		gpio35_pmx_func: gpio35_pmx_func {
			pinctrl-single,pins = <0x8C    0x0>;
		};

		gpio35_pmx_idle: gpio35_pmx_idle {
			pinctrl-single,pins = <0x8C    0x0>;
		};

		gpio36_pmx_func: gpio36_pmx_func {
			pinctrl-single,pins = <0x90    0x0>;
		};

		gpio36_pmx_idle: gpio36_pmx_idle {
			pinctrl-single,pins = <0x90    0x0>;
		};

		gpio37_pmx_func: gpio37_pmx_func {
			pinctrl-single,pins = <0x94    0x0>;
		};

		gpio37_pmx_idle: gpio37_pmx_idle {
			pinctrl-single,pins = <0x94    0x0>;
		};

		gpio38_pmx_func: gpio38_pmx_func {
			pinctrl-single,pins = <0x98    0x0>;
		};

		gpio38_pmx_idle: gpio38_pmx_idle {
			pinctrl-single,pins = <0x98    0x0>;
		};

		gpio39_pmx_func: gpio39_pmx_func {
			pinctrl-single,pins = <0x9C    0x0>;
		};

		gpio39_pmx_idle: gpio39_pmx_idle {
			pinctrl-single,pins = <0x9C    0x0>;
		};

		gpio40_pmx_func: gpio40_pmx_func {
			pinctrl-single,pins = <0xA0    0x0>;
		};

		gpio40_pmx_idle: gpio40_pmx_idle {
			pinctrl-single,pins = <0xA0    0x0>;
		};

		gpio41_pmx_func: gpio41_pmx_func {
			pinctrl-single,pins = <0xA4    0x0>;
		};

		gpio41_pmx_idle: gpio41_pmx_idle {
			pinctrl-single,pins = <0xA4    0x0>;
		};

		gpio42_pmx_func: gpio42_pmx_func {
			pinctrl-single,pins = <0xA8    0x0>;
		};

		gpio42_pmx_idle: gpio42_pmx_idle {
			pinctrl-single,pins = <0xA8    0x0>;
		};

		gpio43_pmx_func: gpio43_pmx_func {
			pinctrl-single,pins = <0xAC    0x0>;
		};

		gpio43_pmx_idle: gpio43_pmx_idle {
			pinctrl-single,pins = <0xAC    0x0>;
		};

		gpio44_pmx_func: gpio44_pmx_func {
			pinctrl-single,pins = <0xB0    0x0>;
		};

		gpio44_pmx_idle: gpio44_pmx_idle {
			pinctrl-single,pins = <0xB0    0x0>;
		};

		iomg045_pmx_func: iomg045_pmx_func {
			pinctrl-single,pins = <0xB4    0x0>;
		};

		iomg045_pmx_idle: iomg045_pmx_idle {
			pinctrl-single,pins = <0xB4    0x0>;
		};

		iomg046_pmx_func: iomg046_pmx_func {
			pinctrl-single,pins = <0xB8    0x0>;
		};

		iomg046_pmx_idle: iomg046_pmx_idle {
			pinctrl-single,pins = <0xB8    0x0>;
		};

		iomg047_pmx_func: iomg047_pmx_func {
			pinctrl-single,pins = <0xBC    0x0>;
		};

		iomg047_pmx_idle: iomg047_pmx_idle {
			pinctrl-single,pins = <0xBC    0x0>;
		};

		iomg048_pmx_func: iomg048_pmx_func {
			pinctrl-single,pins = <0xC0    0x0>;
		};

		iomg048_pmx_idle: iomg048_pmx_idle {
			pinctrl-single,pins = <0xC0    0x0>;
		};

		iomg049_pmx_func: iomg049_pmx_func {
			pinctrl-single,pins = <0xC4    0x0>;
		};

		iomg049_pmx_idle: iomg049_pmx_idle {
			pinctrl-single,pins = <0xC4    0x0>;
		};

		iomg050_pmx_func: iomg050_pmx_func {
			pinctrl-single,pins = <0xC8    0x0>;
		};

		iomg050_pmx_idle: iomg050_pmx_idle {
			pinctrl-single,pins = <0xC8    0x0>;
		};

		iomg051_pmx_func: iomg051_pmx_func {
			pinctrl-single,pins = <0xCC    0x0>;
		};

		iomg051_pmx_idle: iomg051_pmx_idle {
			pinctrl-single,pins = <0xCC    0x0>;
		};

		iomg052_pmx_func: iomg052_pmx_func {
			pinctrl-single,pins = <0xD0    0x0>;
		};

		iomg052_pmx_idle: iomg052_pmx_idle {
			pinctrl-single,pins = <0xD0    0x0>;
		};

		iomg053_pmx_func: iomg053_pmx_func {
			pinctrl-single,pins = <0xD4    0x0>;
		};

		iomg053_pmx_idle: iomg053_pmx_idle {
			pinctrl-single,pins = <0xD4    0x0>;
		};

		iomg055_pmx_func: iomg055_pmx_func {
			pinctrl-single,pins = <0xDC    0x0>;
		};

		iomg055_pmx_idle: iomg055_pmx_idle {
			pinctrl-single,pins = <0xDC    0x0>;
		};

		iomg056_pmx_func: iomg056_pmx_func {
			pinctrl-single,pins = <0xE0    0x0>;
		};

		iomg056_pmx_idle: iomg056_pmx_idle {
			pinctrl-single,pins = <0xE0    0x0>;
		};

		iomg057_pmx_func: iomg057_pmx_func {
			pinctrl-single,pins = <0xE4    0x0>;
		};

		iomg057_pmx_idle: iomg057_pmx_idle {
			pinctrl-single,pins = <0xE4    0x0>;
		};

		iomg058_pmx_func: iomg058_pmx_func {
			pinctrl-single,pins = <0xE8    0x0>;
		};

		iomg058_pmx_idle: iomg058_pmx_idle {
			pinctrl-single,pins = <0xE8    0x0>;
		};
		iomg059_pmx_func: iomg059_pmx_func {
			pinctrl-single,pins = <0xEC    0x0>;
		};

		iomg059_pmx_idle: iomg059_pmx_idle {
			pinctrl-single,pins = <0xEC    0x0>;
		};

		iomg060_pmx_func: iomg060_pmx_func {
			pinctrl-single,pins = <0xF0    0x1>;
		};

		iomg060_pmx_idle: iomg060_pmx_idle {
			pinctrl-single,pins = <0xF0    0x1>;
		};

		iomg061_pmx_func: iomg061_pmx_func {
			pinctrl-single,pins = <0xF4    0x1>;
		};

		iomg061_pmx_idle: iomg061_pmx_idle {
			pinctrl-single,pins = <0xF4    0x1>;
		};

		iomg062_pmx_func: iomg062_pmx_func {
			pinctrl-single,pins = <0xF8    0x1>;
		};

		iomg062_pmx_idle: iomg062_pmx_idle {
			pinctrl-single,pins = <0xF8    0x1>;
		};

		iomg063_pmx_func: iomg063_pmx_func {
			pinctrl-single,pins = <0xFC    0x1>;
		};

		iomg063_pmx_idle: iomg063_pmx_idle {
			pinctrl-single,pins = <0xFC    0x1>;
		};

		iomg064_pmx_func: iomg064_pmx_func {
			pinctrl-single,pins = <0x100    0x1>;
		};

		iomg064_pmx_idle: iomg064_pmx_idle {
			pinctrl-single,pins = <0x100    0x1>;
		};

		iomg065_pmx_func: iomg065_pmx_func {
			pinctrl-single,pins = <0x104    0x1>;
		};

		iomg065_pmx_idle: iomg065_pmx_idle {
			pinctrl-single,pins = <0x104    0x1>;
		};

		iomg066_pmx_func: iomg066_pmx_func {
			pinctrl-single,pins = <0x108    0x0>;
		};

		iomg066_pmx_idle: iomg066_pmx_idle {
			pinctrl-single,pins = <0x108    0x1>;
		};
	};

	pmx_hac: pinmux@8b160000 {
		compatible = "pinctrl-single", "pinctrl-single2";
		reg = <0x0 0x8b160000 0x0 0x38>;
		#gpio-range-cells = <3>;
		pinctrl-single,register-width = <32>;
		pinctrl-single,function-mask = <7>;
		#pinctrl-cells = <1>;

		iomg000_pmx_func: iomg000_pmx_func {
			pinctrl-single,pins = <0x00    0x0>;
		};

		iomg000_pmx_idle: iomg000_pmx_idle {
			pinctrl-single,pins = <0x00    0x0>;
		};

		iomg001_pmx_func: iomg001_pmx_func {
			pinctrl-single,pins = <0x04    0x0>;
		};

		iomg001_pmx_idle: iomg001_pmx_idle {
			pinctrl-single,pins = <0x04    0x0>;
		};

		/* uart1 */
		iomg002_pmx_func: iomg002_pmx_func {
			pinctrl-single,pins = <0x8    0x0>;
		};

		iomg002_pmx_idle: iomg002_pmx_idle {
			pinctrl-single,pins = <0x8    0x0>;
		};

		iomg003_pmx_func: iomg003_pmx_func {
			pinctrl-single,pins = <0xc    0x0>;
		};

		iomg003_pmx_idle: iomg003_pmx_idle {
			pinctrl-single,pins = <0xc    0x0>;
		};

		/* uart2 */
		iomg004_pmx_func: iomg004_pmx_func {
			pinctrl-single,pins = <0x10    0x0>;
		};

		iomg004_pmx_idle: iomg004_pmx_idle {
			pinctrl-single,pins = <0x10    0x0>;
		};

		iomg005_pmx_func: iomg005_pmx_func {
			pinctrl-single,pins = <0x14    0x0>;
		};

		iomg005_pmx_idle: iomg005_pmx_idle {
			pinctrl-single,pins = <0x14    0x0>;
		};

		iomg006_pmx_func: iomg006_pmx_func {
			pinctrl-single,pins = <0x18    0x2>;
		};

		iomg006_pmx_idle: iomg006_pmx_idle {
			pinctrl-single,pins = <0x18    0x2>;
		};

		iomg007_pmx_func: iomg007_pmx_func {
			pinctrl-single,pins = <0x1C    0x2>;
		};

		iomg007_pmx_idle: iomg007_pmx_idle {
			pinctrl-single,pins = <0x1C    0x2>;
		};

		iomg008_pmx_func: iomg008_pmx_func {
			pinctrl-single,pins = <0x20    0x2>;
		};

		iomg008_pmx_idle: iomg008_pmx_idle {
			pinctrl-single,pins = <0x20    0x2>;
		};

		iomg009_pmx_func: iomg009_pmx_func {
			pinctrl-single,pins = <0x24    0x2>;
		};

		iomg009_pmx_idle: iomg009_pmx_idle {
			pinctrl-single,pins = <0x24    0x2>;
		};

		iomg010_pmx_func: iomg010_pmx_func {
			pinctrl-single,pins = <0x28    0x2>;
		};

		iomg010_pmx_idle: iomg010_pmx_idle {
			pinctrl-single,pins = <0x28    0x2>;
		};

		iomg011_pmx_func: iomg011_pmx_func {
			pinctrl-single,pins = <0x2C    0x2>;
		};

		iomg011_pmx_idle: iomg011_pmx_idle {
			pinctrl-single,pins = <0x2C    0x2>;
		};

		iomg012_pmx_func: iomg012_pmx_func {
			pinctrl-single,pins = <0x30    0x2>;
		};

		iomg012_pmx_idle: iomg012_pmx_idle {
			pinctrl-single,pins = <0x30    0x2>;
		};

		iomg013_pmx_func: iomg013_pmx_func {
			pinctrl-single,pins = <0x34    0x2>;
		};

		iomg013_pmx_idle: iomg013_pmx_idle {
			pinctrl-single,pins = <0x34    0x2>;
		};
	};

	pmx_ao: pinmux@84020000 {
		compatible = "pinctrl-single", "pinctrl-single3";
		reg = <0x0 0x84020000 0x0 0x138>;
		#gpio-range-cells = <3>;
		pinctrl-single,register-width = <32>;
		pinctrl-single,function-mask = <7>;
		#pinctrl-cells = <1>;

		aomg040_pmx_func: aomg040_pmx_func {
			pinctrl-single,pins = <0xA0    0x1>;
		};

		aomg040_pmx_idle: aomg040_pmx_idle {
			pinctrl-single,pins = <0xA0    0x1>;
		};

		aomg041_pmx_func: aomg041_pmx_func {
			pinctrl-single,pins = <0xA4    0x1>;
		};

		aomg041_pmx_idle: aomg041_pmx_idle {
			pinctrl-single,pins = <0xA4    0x1>;
		};

		aomg042_pmx_func: aomg042_pmx_func {
			pinctrl-single,pins = <0xA8    0x1>;
		};

		aomg042_pmx_idle: aomg042_pmx_idle {
			pinctrl-single,pins = <0xA8    0x1>;
		};

		aomg043_pmx_func: aomg043_pmx_func {
			pinctrl-single,pins = <0xAC    0x1>;
		};

		aomg043_pmx_idle: aomg043_pmx_idle {
			pinctrl-single,pins = <0xAC    0x1>;
		};

		aomg048_pmx_func: aomg048_pmx_func {
			pinctrl-single,pins = <0xC0    0x2>;
		};

		aomg048_pmx_idle: aomg048_pmx_idle {
			pinctrl-single,pins = <0xC0    0x2>;
		};

		aomg049_pmx_func: aomg049_pmx_func {
			pinctrl-single,pins = <0xC4    0x2>;
		};

		aomg049_pmx_idle: aomg049_pmx_idle {
			pinctrl-single,pins = <0xC4    0x2>;
		};
		
		gpio178_pmx_func: gpio178_pmx_func {
			pinctrl-single,pins = <0xA0    0x1>;
		};

		gpio178_pmx_idle: gpio178_pmx_idle {
			pinctrl-single,pins = <0xA0    0x1>;
		};

		gpio179_pmx_func: gpio179_pmx_func {
			pinctrl-single,pins = <0xA4    0x1>;
		};

		gpio179_pmx_idle: gpio179_pmx_idle {
			pinctrl-single,pins = <0xA4    0x1>;
		};

		gpio180_pmx_func: gpio180_pmx_func {
			pinctrl-single,pins = <0xA8    0x1>;
		};

		gpio180_pmx_idle: gpio180_pmx_idle {
			pinctrl-single,pins = <0xA8    0x1>;
		};

		gpio181_pmx_func: gpio181_pmx_func {
			pinctrl-single,pins = <0xAC    0x1>;
		};

		gpio181_pmx_idle: gpio181_pmx_idle {
			pinctrl-single,pins = <0xAC    0x1>;
		};

		pwm2_pmx_func: pwm2_pmx_func {
			pinctrl-single,pins = <0xC8    0x0>;
		};

		pwm2_pmx_idle: pwm2_pmx_idle {
			pinctrl-single,pins = <0xC8    0x0>;
		};

		gpio189_pmx_func: gpio189_pmx_func {
			pinctrl-single,pins = <0xd4    0x1>;
		};

		gpio189_pmx_idle: gpio189_pmx_idle {
			pinctrl-single,pins = <0xd4    0x1>;
		};

		gpio190_pmx_func: gpio190_pmx_func {
			pinctrl-single,pins = <0x50    0x0>;
		};

		gpio190_pmx_idle: gpio190_pmx_idle {
			pinctrl-single,pins = <0x50    0x0>;
		};

		gpio258_pmx_func: gpio258_pmx_func {
			pinctrl-single,pins = <0xE4    0x0>;
		};

		gpio258_pmx_idle: gpio258_pmx_idle {
			pinctrl-single,pins = <0xE4    0x0>;
		};

		gpio271_pmx_func: gpio271_pmx_func {
			pinctrl-single,pins = <0x118    0x0>;
		};
	};

	pmx_media: pinmux@FA6E0000 {
		compatible = "pinctrl-single", "pinctrl-single4";
		reg = <0x0 0xFA6E0000 0x0 0x80>;
		#gpio-range-cells = <3>;
		pinctrl-single,register-width = <32>;
		pinctrl-single,function-mask = <7>;
		#pinctrl-cells = <1>;

		media000_pmx_func: media000_pmx_func {
			pinctrl-single,pins = <0x00    0x0>;
		};

		media000_pmx_idle: media000_pmx_idle {
			pinctrl-single,pins = <0x00    0x0>;
		};

		media001_pmx_func: media001_pmx_func {
			pinctrl-single,pins = <0x04    0x0>;
		};

		media001_pmx_idle: media001_pmx_idle {
			pinctrl-single,pins = <0x04    0x0>;
		};

		media002_pmx_func: media002_pmx_func {
			pinctrl-single,pins = <0x08    0x0>;
		};

		media002_pmx_idle: media002_pmx_idle {
			pinctrl-single,pins = <0x08    0x0>;
		};

		media003_pmx_func: media003_pmx_func {
			pinctrl-single,pins = <0x0c    0x0>;
		};

		media003_pmx_idle: media003_pmx_idle {
			pinctrl-single,pins = <0x0c    0x0>;
		};

		media026_pmx_func: media026_pmx_func {
			pinctrl-single,pins = <0x68    0x1>;
		};

		media026_pmx_idle: media026_pmx_idle {
			pinctrl-single,pins = <0x68    0x1>;
		};

		media027_pmx_func: media027_pmx_func {
			pinctrl-single,pins = <0x6c    0x1>;
		};

		media027_pmx_idle: media027_pmx_idle {
			pinctrl-single,pins = <0x6c    0x1>;
		};
		media104_pmx_func: media104_pmx_func {
			pinctrl-single,pins = <0x18   0x0>;
		};

		media104_pmx_idle: media104_pmx_idle {
			pinctrl-single,pins = <0x18    0x0>;
		};

		media105_pmx_func: media105_pmx_func {
			pinctrl-single,pins = <0x1c    0x0>;
		};

		media105_pmx_idle: media105_pmx_idle {
			pinctrl-single,pins = <0x1c    0x0>;
		};

		media106_pmx_func: media106_pmx_func {
			pinctrl-single,pins = <0x20    0x0>;
		};

		media106_pmx_idle: media106_pmx_idle {
			pinctrl-single,pins = <0x20    0x0>;
		};

		media107_pmx_func: media107_pmx_func {
			pinctrl-single,pins = <0x24    0x0>;
		};

		media107_pmx_idle: media107_pmx_idle {
			pinctrl-single,pins = <0x24    0x0>;
		};

		media108_pmx_func: media108_pmx_func {
			pinctrl-single,pins = <0x28   0x0>;
		};

		media108_pmx_idle: media108_pmx_idle {
			pinctrl-single,pins = <0x28    0x0>;
		};

		media109_pmx_func: media109_pmx_func {
			pinctrl-single,pins = <0x2c    0x0>;
		};

		media109_pmx_idle: media109_pmx_idle {
			pinctrl-single,pins = <0x2c    0x0>;
		};

		media110_pmx_func: media110_pmx_func {
			pinctrl-single,pins = <0x30    0x0>;
		};

		media110_pmx_idle: media110_pmx_idle {
			pinctrl-single,pins = <0x30    0x0>;
		};

		media111_pmx_func: media111_pmx_func {
			pinctrl-single,pins = <0x34    0x0>;
		};

		media111_pmx_idle: media111_pmx_idle {
			pinctrl-single,pins = <0x34    0x0>;
		};

		media112_pmx_func: media112_pmx_func {
			pinctrl-single,pins = <0x38   0x0>;
		};

		media112_pmx_idle: media112_pmx_idle {
			pinctrl-single,pins = <0x38    0x0>;
		};

		media113_pmx_func: media113_pmx_func {
			pinctrl-single,pins = <0x3c    0x0>;
		};

		media113_pmx_idle: media113_pmx_idle {
			pinctrl-single,pins = <0x3c    0x0>;
		};

		media114_pmx_func: media114_pmx_func {
			pinctrl-single,pins = <0x40    0x0>;
		};

		media114_pmx_idle: media114_pmx_idle {
			pinctrl-single,pins = <0x40    0x0>;
		};

		media115_pmx_func: media115_pmx_func {
			pinctrl-single,pins = <0x44    0x0>;
		};

		media115_pmx_idle: media115_pmx_idle {
			pinctrl-single,pins = <0x44    0x0>;
		};

		media116_pmx_func: media116_pmx_func {
			pinctrl-single,pins = <0x48   0x0>;
		};

		media116_pmx_idle: media116_pmx_idle {
			pinctrl-single,pins = <0x48    0x0>;
		};

		media117_pmx_func: media117_pmx_func {
			pinctrl-single,pins = <0x4c    0x0>;
		};

		media117_pmx_idle: media117_pmx_idle {
			pinctrl-single,pins = <0x4c    0x0>;
		};

		media118_pmx_func: media118_pmx_func {
			pinctrl-single,pins = <0x50    0x0>;
		};

		media118_pmx_idle: media118_pmx_idle {
			pinctrl-single,pins = <0x50    0x0>;
		};

		media119_pmx_func: media119_pmx_func {
			pinctrl-single,pins = <0x54    0x0>;
		};

		media119_pmx_idle: media119_pmx_idle {
			pinctrl-single,pins = <0x54    0x0>;
		};

		media120_pmx_func: media120_pmx_func {
			pinctrl-single,pins = <0x58   0x0>;
		};

		media120_pmx_idle: media120_pmx_idle {
			pinctrl-single,pins = <0x58    0x0>;
		};

		media121_pmx_func: media121_pmx_func {
			pinctrl-single,pins = <0x5c    0x0>;
		};

		media121_pmx_idle: media121_pmx_idle {
			pinctrl-single,pins = <0x5c    0x0>;
		};

		media122_pmx_func: media122_pmx_func {
			pinctrl-single,pins = <0x60    0x0>;
		};

		media122_pmx_idle: media122_pmx_idle {
			pinctrl-single,pins = <0x60    0x0>;
		};

		media123_pmx_func: media123_pmx_func {
			pinctrl-single,pins = <0x64    0x0>;
		};

		media123_pmx_idle: media123_pmx_idle {
			pinctrl-single,pins = <0x64    0x0>;
		};

		media124_pmx_func: media124_pmx_func {
			pinctrl-single,pins = <0x70    0x1>;
		};

		media124_pmx_idle: media124_pmx_idle {
			pinctrl-single,pins = <0x70    0x1>;
		};

		media125_pmx_func: media125_pmx_func {
			pinctrl-single,pins = <0x74    0x1>;
		};

		media125_pmx_idle: media125_pmx_idle {
			pinctrl-single,pins = <0x74    0x1>;
		};

		media126_pmx_func: media126_pmx_func {
			pinctrl-single,pins = <0x78    0x1>;
		};

		media126_pmx_idle: media126_pmx_idle {
			pinctrl-single,pins = <0x78    0x1>;
		};

		media127_pmx_func: media127_pmx_func {
			pinctrl-single,pins = <0x7c    0x1>;
		};

		media127_pmx_idle: media127_pmx_idle {
			pinctrl-single,pins = <0x7c    0x1>;
		};
	};

	pmx_isp: pinmux@a80e0000 {
		compatible = "pinctrl-single", "pinctrl-single5";
		reg = <0x0 0xa80e0000 0x0 0x20>;
		#gpio-range-cells = <3>;
		pinctrl-single,register-width = <32>;
		pinctrl-single,function-mask = <7>;
		#pinctrl-cells = <1>;

		gpio224_pmx_func: gpio224_pmx_func {
			pinctrl-single,pins = <0x00    0x0>;
		};

		gpio224_pmx_idle: gpio224_pmx_idle {
			pinctrl-single,pins = <0x00    0x0>;
		};

		gpio225_pmx_func: gpio225_pmx_func {
			pinctrl-single,pins = <0x04    0x0>;
		};

		gpio225_pmx_idle: gpio225_pmx_idle {
			pinctrl-single,pins = <0x04    0x0>;
		};

		gpio226_pmx_func: gpio226_pmx_func {
			pinctrl-single,pins = <0x08    0x0>;
		};

		gpio226_pmx_idle: gpio226_pmx_idle {
			pinctrl-single,pins = <0x08    0x0>;
		};

		gpio227_pmx_func: gpio227_pmx_func {
			pinctrl-single,pins = <0x0c    0x0>;
		};

		gpio227_pmx_idle: gpio227_pmx_idle {
			pinctrl-single,pins = <0x0c    0x0>;
		};

		gpio228_pmx_func: gpio228_pmx_func {
			pinctrl-single,pins = <0x10    0x0>;
		};

		gpio228_pmx_idle: gpio228_pmx_idle {
			pinctrl-single,pins = <0x10    0x0>;
		};

		gpio229_pmx_func: gpio229_pmx_func {
			pinctrl-single,pins = <0x14    0x0>;
		};

		gpio229_pmx_idle: gpio229_pmx_idle {
			pinctrl-single,pins = <0x14    0x0>;
		};

		gpio230_pmx_func: gpio230_pmx_func {
			pinctrl-single,pins = <0x18    0x0>;
		};

		gpio230_pmx_idle: gpio230_pmx_idle {
			pinctrl-single,pins = <0x18    0x0>;
		};
		gpio231_pmx_func: gpio231_pmx_func {
			pinctrl-single,pins = <0x1c    0x0>;
		};

		gpio231_pmx_idle: gpio231_pmx_idle {
			pinctrl-single,pins = <0x1c    0x0>;
		};
	};

	pmx_cfg_peri: pinmux@A4560800 {
		compatible = "pinconf-single", "pinctrl-single1";
		reg = <0x0 0xA4560800 0x0 0x110>;
		pinctrl-single,register-width = <32>;
		#pinctrl-cells = <1>;

		gpio13_cfg_func: gpio13_cfg_func {
				pinctrl-single,pins = <0x1C  0>;
				pinctrl-single,bias-pulldown = <0 2 0 2>;
				pinctrl-single,bias-pullup = <0 1 0 1>;
				pinctrl-single,drive-strength = <0x40 0x70>;
		};
		gpio13_cfg_idle: gpio13_cfg_idle {
				pinctrl-single,pins = <0x1C  0>;
				pinctrl-single,bias-pulldown = <0 2 0 2>;
				pinctrl-single,bias-pullup = <0 1 0 1>;
				pinctrl-single,drive-strength = <0x40 0x70>;
		};

		gpio14_cfg_func: gpio14_cfg_func {
				pinctrl-single,pins = <0x20  0>;
				pinctrl-single,bias-pulldown = <0 2 0 2>;
				pinctrl-single,bias-pullup = <1 1 0 1>;
				pinctrl-single,drive-strength = <0x40 0x70>;
		};
		gpio14_cfg_idle: gpio14_cfg_idle {
				pinctrl-single,pins = <0x20  0>;
				pinctrl-single,bias-pulldown = <0 2 0 2>;
				pinctrl-single,bias-pullup = <1 1 0 1>;
				pinctrl-single,drive-strength = <0x40 0x70>;
		};

		gpio15_cfg_func: gpio15_cfg_func {
				pinctrl-single,pins = <0x24  0>;
				pinctrl-single,bias-pulldown = <0 2 0 2>;
				pinctrl-single,bias-pullup = <1 1 0 1>;
				pinctrl-single,drive-strength = <0x40 0x70>;
		};
		gpio15_cfg_idle: gpio15_cfg_idle {
				pinctrl-single,pins = <0x24  0>;
				pinctrl-single,bias-pulldown = <0 2 0 2>;
				pinctrl-single,bias-pullup = <1 1 0 1>;
				pinctrl-single,drive-strength = <0x40 0x70>;
		};

		gpio16_cfg_func: gpio16_cfg_func {
				pinctrl-single,pins = <0x28  0>;
				pinctrl-single,bias-pulldown = <0 2 0 2>;
				pinctrl-single,bias-pullup = <1 1 0 1>;
				pinctrl-single,drive-strength = <0x40 0x70>;
		};
		gpio16_cfg_idle: gpio16_cfg_idle {
				pinctrl-single,pins = <0x28  0>;
				pinctrl-single,bias-pulldown = <0 2 0 2>;
				pinctrl-single,bias-pullup = <1 1 0 1>;
				pinctrl-single,drive-strength = <0x40 0x70>;
		};

		gpio17_cfg_func: gpio17_cfg_func {
				pinctrl-single,pins = <0x2C  0>;
				pinctrl-single,bias-pulldown = <0 2 0 2>;
				pinctrl-single,bias-pullup = <1 1 0 1>;
				pinctrl-single,drive-strength = <0x40 0x70>;
		};
		gpio17_cfg_idle: gpio17_cfg_idle {
				pinctrl-single,pins = <0x2C  0>;
				pinctrl-single,bias-pulldown = <0 2 0 2>;
				pinctrl-single,bias-pullup = <1 1 0 1>;
				pinctrl-single,drive-strength = <0x40 0x70>;
		};

		gpio18_cfg_func: gpio18_cfg_func {
			pinctrl-single,pins = <0x30  0>;
			pinctrl-single,bias-pulldown = <0 2 0 2>;
			pinctrl-single,bias-pullup = <1 1 0 1>;
			pinctrl-single,drive-strength = <0x40 0x70>;
		};
		gpio18_cfg_idle: gpio18_cfg_idle {
			pinctrl-single,pins = <0x30  0>;
			pinctrl-single,bias-pulldown = <0 2 0 2>;
			pinctrl-single,bias-pullup = <1 1 0 1>;
			pinctrl-single,drive-strength = <0x40 0x70>;
		};
		gpio19_cfg_func: gpio19_cfg_func {
			pinctrl-single,pins = <0x34  0>;
			pinctrl-single,bias-pulldown = <0 2 0 2>;
			pinctrl-single,bias-pullup = <1 1 0 1>;
			pinctrl-single,drive-strength = <0x40 0x70>;
		};
		gpio19_cfg_idle: gpio19_cfg_idle {
			pinctrl-single,pins = <0x34  0>;
			pinctrl-single,bias-pulldown = <0 2 0 2>;
			pinctrl-single,bias-pullup = <1 1 0 1>;
			pinctrl-single,drive-strength = <0x40 0x70>;
		};
		gpio20_cfg_func: gpio20_cfg_func {
			pinctrl-single,pins = <0x38  0>;
			pinctrl-single,bias-pulldown = <0 2 0 2>;
			pinctrl-single,bias-pullup = <1 1 0 1>;
			pinctrl-single,drive-strength = <0x40 0x70>;
		};
		gpio20_cfg_idle: gpio20_cfg_idle {
			pinctrl-single,pins = <0x38  0>;
			pinctrl-single,bias-pulldown = <0 2 0 2>;
			pinctrl-single,bias-pullup = <1 1 0 1>;
			pinctrl-single,drive-strength = <0x40 0x70>;
		};
		gpio21_cfg_func: gpio21_cfg_func {
			pinctrl-single,pins = <0x3C  0>;
			pinctrl-single,bias-pulldown = <0 2 0 2>;
			pinctrl-single,bias-pullup = <1 1 0 1>;
			pinctrl-single,drive-strength = <0x40 0x70>;
		};
		gpio21_cfg_idle: gpio21_cfg_idle {
			pinctrl-single,pins = <0x3C  0>;
			pinctrl-single,bias-pulldown = <0 2 0 2>;
			pinctrl-single,bias-pullup = <1 1 0 1>;
			pinctrl-single,drive-strength = <0x40 0x70>;
		};
		gpio22_cfg_func: gpio22_cfg_func {
			pinctrl-single,pins = <0x40  0>;
			pinctrl-single,bias-pulldown = <0 2 0 2>;
			pinctrl-single,bias-pullup = <1 1 0 1>;
			pinctrl-single,drive-strength = <0x40 0x70>;
		};
		gpio22_cfg_idle: gpio22_cfg_idle {
			pinctrl-single,pins = <0x40  0>;
			pinctrl-single,bias-pulldown = <0 2 0 2>;
			pinctrl-single,bias-pullup = <1 1 0 1>;
			pinctrl-single,drive-strength = <0x40 0x70>;
		};
		gpio26_cfg_default: gpio26_cfg_default {
			pinctrl-single,pins = <0x68  0>;
			pinctrl-single,bias-pulldown = <0 2 0 2>;
			pinctrl-single,bias-pullup = <0 1 0 1>;
			pinctrl-single,drive-strength = <0x40 0x70>;
		};
		gpio26_cfg_idle: gpio26_cfg_idle {
			pinctrl-single,pins = <0x68  0>;
			pinctrl-single,bias-pulldown = <0 2 0 2>;
			pinctrl-single,bias-pullup = <0 1 0 1>;
			pinctrl-single,drive-strength = <0x40 0x70>;
		 };
	};

	pmx_cfg_hac: pinmux@8b160800 {
		compatible = "pinconf-single", "pinctrl-single2";
		reg = <0x0 0x8b160800 0x0 0x38>;
		pinctrl-single,register-width = <32>;
		#pinctrl-cells = <1>;

		gpio136_cfg_func: gpio136_cfg_func {
			pinctrl-single,pins = <0x0C  0>;
			pinctrl-single,bias-pulldown = <2 2 0 2>;
			pinctrl-single,bias-pullup = <0 1 0 1>;
			pinctrl-single,drive-strength = <0x40 0x70>;
		};
		gpio136_cfg_idle: gpio136_cfg_idle {
			pinctrl-single,pins = <0x0C  0>;
			pinctrl-single,bias-pulldown = <2 2 0 2>;
			pinctrl-single,bias-pullup = <0 1 0 1>;
			pinctrl-single,drive-strength = <0x40 0x70>;
		};
		scl0_cfg_func: scl0_cfg_func {
			pinctrl-single,pins = <0x0  0>;
			pinctrl-single,bias-pulldown = <0 2 0 2>;
			pinctrl-single,bias-pullup = <0 1 0 1>;
			pinctrl-single,drive-strength = <0x40 0x70>;
		};
		sda0_cfg_func: sda0_cfg_func {
			pinctrl-single,pins = <0x4  0>;
			pinctrl-single,bias-pulldown = <0 2 0 2>;
			pinctrl-single,bias-pullup = <0 1 0 1>;
			pinctrl-single,drive-strength = <0x40 0x70>;
		};
	};

	pmx_cfg_ao: pinmux@84020800 {
		compatible = "pinconf-single", "pinctrl-single3";
		reg = <0x0 0x84020800 0x0 0x140>;
		pinctrl-single,register-width = <32>;
		#pinctrl-cells = <1>;

		gpio190_cfg_func: gpio190_cfg_func {
			pinctrl-single,pins = <0x50  0>;
			pinctrl-single,bias-pulldown = <0 2 0 2>;
			pinctrl-single,bias-pullup = <0 1 0 1>;
			pinctrl-single,drive-strength = <0x40 0x70>;
		};
		gpio190_cfg_idle: gpio190_cfg_idle {
			pinctrl-single,pins = <0x50  0>;
			pinctrl-single,bias-pulldown = <0 2 0 2>;
			pinctrl-single,bias-pullup = <0 1 0 1>;
			pinctrl-single,drive-strength = <0x40 0x70>;
		};

		gpio258_cfg_func: gpio258_cfg_func {
			pinctrl-single,pins = <0xE4  0>;
			pinctrl-single,bias-pulldown = <0 2 0 2>;
			pinctrl-single,bias-pullup = <0 1 0 1>;
			pinctrl-single,drive-strength = <0x40 0x70>;
		};
		gpio258_cfg_idle: gpio258_cfg_idle {
			pinctrl-single,pins = <0xE4  0>;
			pinctrl-single,bias-pulldown = <0 2 0 2>;
			pinctrl-single,bias-pullup = <0 1 0 1>;
			pinctrl-single,drive-strength = <0x40 0x70>;
		};

		gpio265_cfg_func: gpio265_cfg_func {
			pinctrl-single,pins = <0x100  0>;
			pinctrl-single,bias-pulldown = <2 2 0 2>;
			pinctrl-single,bias-pullup = <0 1 0 1>;
			pinctrl-single,drive-strength = <0x40 0x70>;
		};
		gpio265_cfg_idle: gpio265_cfg_idle {
			pinctrl-single,pins = <0x100  0>;
			pinctrl-single,bias-pulldown = <2 2 0 2>;
			pinctrl-single,bias-pullup = <0 1 0 1>;
			pinctrl-single,drive-strength = <0x40 0x70>;
		};

		gpio268_cfg_func: gpio268_cfg_func {
			pinctrl-single,pins = <0x10C  0>;
			pinctrl-single,bias-pulldown = <0 2 0 2>;
			pinctrl-single,bias-pullup = <1 1 0 1>;
			pinctrl-single,drive-strength = <0x40 0x70>;
		};
		gpio268_cfg_idle: gpio268_cfg_idle {
			pinctrl-single,pins = <0x10C  0>;
			pinctrl-single,bias-pulldown = <0 2 0 2>;
			pinctrl-single,bias-pullup = <1 1 0 1>;
			pinctrl-single,drive-strength = <0x40 0x70>;
		};

		gpio271_cfg_func: gpio271_cfg_func {
			pinctrl-single,pins = <0x118  0>;
			pinctrl-single,bias-pulldown = <0 2 0 2>;
			pinctrl-single,bias-pullup = <1 1 0 1>;
			pinctrl-single,drive-strength = <0x40 0x70>;
		};
		gpio271_cfg_idle: gpio271_cfg_idle {
			pinctrl-single,pins = <0x118  0>;
			pinctrl-single,bias-pulldown = <0 2 0 2>;
			pinctrl-single,bias-pullup = <1 1 0 1>;
			pinctrl-single,drive-strength = <0x40 0x70>;
		};

		gpio272_cfg_func: gpio272_cfg_func {
			pinctrl-single,pins = <0x11C  0>;
			pinctrl-single,bias-pulldown = <0 2 0 2>;
			pinctrl-single,bias-pullup = <1 1 0 1>;
			pinctrl-single,drive-strength = <0x40 0x70>;
		};
		gpio272_cfg_idle: gpio272_cfg_idle {
			pinctrl-single,pins = <0x11C  0>;
			pinctrl-single,bias-pulldown = <0 2 0 2>;
			pinctrl-single,bias-pullup = <1 1 0 1>;
			pinctrl-single,drive-strength = <0x40 0x70>;
		};
		
		scl2_cfg_func: scl2_cfg_func {
			pinctrl-single,pins = <0xa0  0>;
			pinctrl-single,bias-pulldown = <0 2 0 2>;
			pinctrl-single,bias-pullup = <0 1 0 1>;
			pinctrl-single,drive-strength = <0x40 0x70>;
		};
		sda2_cfg_func: sda2_cfg_func {
			pinctrl-single,pins = <0xa4  0>;
			pinctrl-single,bias-pulldown = <0 2 0 2>;
			pinctrl-single,bias-pullup = <0 1 0 1>;
			pinctrl-single,drive-strength = <0x40 0x70>;
		};
		scl3_cfg_func: scl3_cfg_func {
			pinctrl-single,pins = <0xa8  0>;
			pinctrl-single,bias-pulldown = <0 2 0 2>;
			pinctrl-single,bias-pullup = <0 1 0 1>;
			pinctrl-single,drive-strength = <0x40 0x70>;
		};
		sda3_cfg_func: sda3_cfg_func {
			pinctrl-single,pins = <0xac  0>;
			pinctrl-single,bias-pulldown = <0 2 0 2>;
			pinctrl-single,bias-pullup = <0 1 0 1>;
			pinctrl-single,drive-strength = <0x40 0x70>;
		};
		scl11_cfg_func: scl11_cfg_func {
			pinctrl-single,pins = <0xc0  0>;
			pinctrl-single,bias-pulldown = <0 2 0 2>;
			pinctrl-single,bias-pullup = <0 1 0 1>;
			pinctrl-single,drive-strength = <0x40 0x70>;
		};
		sda11_cfg_func: sda11_cfg_func {
			pinctrl-single,pins = <0xc4  0>;
			pinctrl-single,bias-pulldown = <0 2 0 2>;
			pinctrl-single,bias-pullup = <0 1 0 1>;
			pinctrl-single,drive-strength = <0x40 0x70>;
		};
	};

	pmx_cfg_media: pinmux@FA6E0800 {
		compatible = "pinconf-single", "pinctrl-single4";
		reg = <0x0 0x0FA6E0800 0x0 0x080>;
		pinctrl-single,register-width = <32>;
		#pinctrl-cells = <1>;

		gpio99_cfg_idle: gpio99_cfg_idle {
			pinctrl-single,pins = <0x14  0>;
			pinctrl-single,bias-pulldown = <2 2 0 2>;
			pinctrl-single,bias-pullup = <0 1 0 1>;
			pinctrl-single,drive-strength = <0x00 0x70>;
		};
		scl4_cfg_func: scl4_cfg_func {
			pinctrl-single,pins = <0x0  0>;
			pinctrl-single,bias-pulldown = <0 2 0 2>;
			pinctrl-single,bias-pullup = <0 1 0 1>;
			pinctrl-single,drive-strength = <0x40 0x70>;
		};
		sda4_cfg_func: sda4_cfg_func {
			pinctrl-single,pins = <0x4  0>;
			pinctrl-single,bias-pulldown = <0 2 0 2>;
			pinctrl-single,bias-pullup = <0 1 0 1>;
			pinctrl-single,drive-strength = <0x40 0x70>;
		};
		scl5_cfg_func: scl5_cfg_func {
			pinctrl-single,pins = <0x8  0>;
			pinctrl-single,bias-pulldown = <0 2 0 2>;
			pinctrl-single,bias-pullup = <0 1 0 1>;
			pinctrl-single,drive-strength = <0x40 0x70>;
		};
		sda5_cfg_func: sda5_cfg_func {
			pinctrl-single,pins = <0xc  0>;
			pinctrl-single,bias-pulldown = <0 2 0 2>;
			pinctrl-single,bias-pullup = <0 1 0 1>;
			pinctrl-single,drive-strength = <0x40 0x70>;
		};
		scl12_cfg_func: scl12_cfg_func {
			pinctrl-single,pins = <0x68  0>;
			pinctrl-single,bias-pulldown = <0 2 0 2>;
			pinctrl-single,bias-pullup = <0 1 0 1>;
			pinctrl-single,drive-strength = <0x40 0x70>;
		};
		sda12_cfg_func: sda12_cfg_func {
			pinctrl-single,pins = <0x6c  0>;
			pinctrl-single,bias-pulldown = <0 2 0 2>;
			pinctrl-single,bias-pullup = <0 1 0 1>;
			pinctrl-single,drive-strength = <0x40 0x70>;
		};
	};

	pmx_cfg_isp: pinmux@a80e0800 {
		compatible = "pinconf-single", "pinctrl-single5";
		reg = <0x0 0xa80e0800 0x0 0x020>;
		pinctrl-single,register-width = <32>;
		#pinctrl-cells = <1>;

		gpio224_cfg_idle: gpio224_cfg_idle {
			pinctrl-single,pins = <0x00  0>;
			pinctrl-single,bias-pulldown = <2 2 0 2>;
			pinctrl-single,bias-pullup = <0 1 0 1>;
			pinctrl-single,drive-strength = <0x40 0x70>;
		};

		gpio225_cfg_idle: gpio225_cfg_idle {
			pinctrl-single,pins = <0x04  0>;
			pinctrl-single,bias-pulldown = <2 2 0 2>;
			pinctrl-single,bias-pullup = <0 1 0 1>;
			pinctrl-single,drive-strength = <0x40 0x70>;
		};
	};
