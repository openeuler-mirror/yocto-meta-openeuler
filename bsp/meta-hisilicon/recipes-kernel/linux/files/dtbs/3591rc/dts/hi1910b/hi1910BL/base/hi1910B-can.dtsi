    mttcan@0 {
        compatible = "hisi,mttcan";
        mttcan-id = <0>;
        cclk-freq-hz = <80000000>;
        hclk-freq-hz = <150000000>;
        interrupts = <0 176 0x04>,
                     <0 177 0x04>;
        interrupt-names = "int0", "int1";
        reg = <0x00 0x822A0000 0x00 0x200>,
              <0x00 0x822A1000 0x00 0x1000>,
              <0x00 0x80130A38 0x00 0x8>,
              <0x00 0x82320000 0x00 0x60>,
              <0x00 0xC014FFF8 0x00 0x8>;
        reg-names = "reg-base", "mram-base", "reset-base", "gpio-base", "plat-base";
        pinctrl-names = "default", "idle";
        pinctrl-0 = <&gpio23_pmx_func &gpio22_pmx_func>;
        pinctrl-1 = <&gpio23_pmx_idle &gpio22_pmx_idle>;
    };

    mttcan@1 {
        compatible = "hisi,mttcan";
        mttcan-id = <1>;
        cclk-freq-hz = <80000000>;
        hclk-freq-hz = <150000000>;
        interrupts = <0 178 0x04>,
                     <0 179 0x04>;
        interrupt-names = "int0", "int1";
        reg = <0x00 0x822B0000 0x00 0x200>,
              <0x00 0x822B1000 0x00 0x1000>,
              <0x00 0x80130A38 0x00 0x8>,
              <0x00 0x82320000 0x00 0x60>,
              <0x00 0xC014FFF8 0x00 0x8>;
        reg-names = "reg-base", "mram-base", "reset-base", "gpio-base", "plat-base";
        pinctrl-names = "default", "idle";
        pinctrl-0 = <&gpio21_pmx_func &gpio20_pmx_func>;
        pinctrl-1 = <&gpio21_pmx_idle &gpio20_pmx_idle>;
    };

    mttcan@2 {
        compatible = "hisi,mttcan";
        mttcan-id = <2>;
        cclk-freq-hz = <80000000>;
        hclk-freq-hz = <150000000>;
        interrupts = <0 180 0x04>,
                     <0 181 0x04>;
        interrupt-names = "int0", "int1";
        reg = <0x00 0x822C0000 0x00 0x200>,
              <0x00 0x822C1000 0x00 0x1000>,
              <0x00 0x80130A38 0x00 0x8>,
              <0x00 0x82320000 0x00 0x60>,
              <0x00 0xC014FFF8 0x00 0x8>;
        reg-names = "reg-base", "mram-base", "reset-base", "gpio-base", "plat-base";
        pinctrl-names = "default", "idle";
        pinctrl-0 = <&gpio19_pmx_func &gpio18_pmx_func>;
        pinctrl-1 = <&gpio19_pmx_idle &gpio18_pmx_idle>;
    };

    mttcan@3 {
        compatible = "hisi,mttcan";
        mttcan-id = <3>;
        cclk-freq-hz = <80000000>;
        hclk-freq-hz = <150000000>;
        interrupts = <0 182 0x04>,
                     <0 183 0x04>;
        interrupt-names = "int0", "int1";
        reg = <0x00 0x822D0000 0x00 0x200>,
              <0x00 0x822D1000 0x00 0x1000>,
              <0x00 0x80130A38 0x00 0x8>,
              <0x00 0x82320000 0x00 0x60>,
              <0x00 0xC014FFF8 0x00 0x8>;
        reg-names = "reg-base", "mram-base", "reset-base", "gpio-base", "plat-base";
        pinctrl-names = "default", "idle";
        pinctrl-0 = <&gpio17_pmx_func &gpio16_pmx_func>;
        pinctrl-1 = <&gpio17_pmx_idle &gpio16_pmx_idle>;
    };
