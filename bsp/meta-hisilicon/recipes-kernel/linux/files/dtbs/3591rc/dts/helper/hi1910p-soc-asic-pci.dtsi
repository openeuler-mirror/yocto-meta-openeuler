    pcie@d0000000 {
                    compatible = "pci-host-ecam-generic";
                    /* ECAM 0xd0000000 pci host bridge0*/
                    reg = <0x0 0xd0000000 0 0x4000000>;
                    reg-names = "ecam-cfg";
                    bus-range = <0 63>;
                    msi-map = <0x0 &its 0x0 0x2000>;
                    msi-map-mask = <0xffff>;
                    #address-cells = <3>;
                    #size-cells = <2>;
                    device_type = "pci";
                    dma-coherent;
                    ranges = <0x02000000 0 0xe0000000 0x0 0xe0000000 0 0x14000000
                              0x01000000 0 0x00000000 0x0 0xF8000000 0 0x0010000
                              0x43000000 0x40 0x0 0x40 0x0 0x30 0x0>;
                    #interrupt-cells = <1>;
                    interrupt-map-mask = <0x0 0x0 0x0 0x7>;
                    interrupt-map = <0x0 0x0 0x0 0x1 &mbigen_io_mbigen 108 1
                                     0x0 0x0 0x0 0x2 &mbigen_io_mbigen 109 1
                                     0x0 0x0 0x0 0x3 &mbigen_io_mbigen 110 1
                                     0x0 0x0 0x0 0x4 &mbigen_io_mbigen 111 1>;
                    status = "ok";
    };

	pcie@d7a00000 {
		compatible = "pci-host-ecam-generic";
		/* ECAM 0xd7a00000 pci host bridge0*/
		reg = <0x0 0xd7a00000 0 0x100000>;
		reg-names = "ecam-cfg";
		bus-range = <0x7a 0x7a>;
		msi-parent = <&its 0x7a00>;
		msi-map = <0x7a00 &its 0x7a00 0x2000>;
		msi-map-mask = <0xffff>;
		#address-cells = <3>;
		#size-cells = <2>;
		device_type = "pci";
		dma-coherent;
		ranges = <0x03000000 0x0 0xa2c00000 0x0 0xa2c00000 0 0x400000>;
		#interrupt-cells = <1>;
 		//interrupt-map-mask = <0xf800 0 0 0x7>;
		//interrupt-map = <0x0000 0 0 1 &gic 0 0 0 608 4>;	
             
		status = "disabled";
	};
