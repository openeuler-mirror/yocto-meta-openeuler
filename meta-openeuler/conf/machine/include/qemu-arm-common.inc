## meta-openeuler/conf/machine/include/qemu-arm-common.inc
```bitbake
# Description: Machine description for little-endian arm32

MACHINEOVERRIDES =. "march32:"
require conf/machine/include/qemu-common.inc
require conf/machine/include/arm/arch-armv7a.inc

#kernel modules to install and autoload
require conf/machine/include/kernel-modules-conf/common.inc
INSTALLMODULES += " \
kernel-module-unix \
"
KERNEL_MODULE_AUTOLOAD = "${INSTALLMODULES}"

TUNE_FEATURES:append = " cortexa9"
TUNE_FEATURES:remove = " vfp"

TUNE_CCARGS .= " -mno-unaligned-access"

# simplest serial console setting, no VT
SERIAL_CONSOLES ?= "115200;ttyAMA0"
USE_VT ?= "0"
```

## meta-openeuler/conf/machine/include/qemu.inc
```bitbake
# common image fs type for qemu targets
IMAGE_FSTYPES = "cpio.gz"
IMAGE_FSTYPES_DEBUGFS = "cpio.gz"

MACHINEOVERRIDES =. "qemuall:"

# support runqemu function
IMAGE_CLASSES += "qemuboot"
EXTRA_IMAGEDEPENDS += "qemu-helper-native:do_addto_recipe_sysroot"
```

## meta-openeuler/conf/machine/kernel-modules-conf/iso-install.inc
```bitbake
# Notice: we need CONFIG_VIRTIO_BLK=y CONFIG_EXT4_FS=y for vda ext4 filesystem to setup.
# For x86-64, also relies on CONFIG_ATA_PIIX=y CONFIG_BLK_DEV_SD=y

INSTALLMODULES =+ " \
kernel-module-cdrom \
kernel-module-sr-mod \
kernel-module-isofs \
kernel-module-msdos \
kernel-module-virtiofs \
"
```

## meta-openeuler/conf/machine/qemu-aarch64-common.inc
```bitbake
# Description: Config for arm64 machine

MACHINEOVERRIDES =. "march64:"
KERNEL_IMAGETYPE =. "zImage"
KERNEL_IMAGETYPE_FOR_MAKE =. "zImage Image"
require conf/machine/qemu-common.inc

#kernel modules to install and autoload
require conf/machine/kernel-modules-conf/common.inc
KERNEL_MODULE_AUTOLOAD = "${INSTALLMODULES}"

# Different from arm32, here we use armv8a.inc instead
# of conf/machine/include/tune-cortexa53.inc because
# we are not sure our CPU is cortex a53.
require conf/machine/include/arm/arch-armv8a.inc

# but we are sure in compat32 we should use -mcpu=cortexa9.
# This is may not correct, but to make sure compat32 and arm32
# give same binary.
# Should not use conf/machine/include/tune-cortexa9.inc directly.
# In case when using compat32, we alert cflags with same way in tune-cortexa9.inc

TUNE_CCARGS .= "${@bb.utils.contains('TUNE_FEATURES', 'cortexa9', ' -mtune=cortex-a9', '', d)}"
MACHINEOVERRIDES =. "${@bb.utils.contains('TUNE_FEATURES', 'cortexa9', 'armv7a:', '' ,d)}"

MACHINEOVERRIDES_remove_virtclass-multilib-lib32 =. "march64:"
MACHINEOVERRIDES_append_virtclass-multilib-lib32 =. "march32:"
TUNE_FEATURES_append_virtclass-multilib-lib32 += " cortexa9"
TUNE_FEATURES_remove_virtclass-multilib-lib32 += " vfp"

# simplest serial console setting, no VT
SERIAL_CONSOLES ?= "115200;ttyAMA0"
USE_VT ?= "0"
```

## meta-openeuler/conf/machine/qemu-aarch64.conf
```bitbake
# Description: Machine description for little-endian aarch64

MACHINE_FEATURES += "efi"
DEFAULTTUNE = "aarch64"
require conf/machine/include/qemu-aarch64-common.inc

# arm and arm64 both support -mlittle-endian so no
# need to consider compat32.
TUNE_CCARGS .= " -mlittle-endian"

DEFAULTTUNE:virtclass-multilib-lib32 = "armv7a"
PACKAGE_EXTRA_ARCHS:tune-armv7a += " armv7a"
PACKAGE_EXTRA_ARCHS:virtclass-multilib-lib32 = "armv7a"

require conf/multilib.conf
# for qemu-aarch64,don't enable multilib lib32 support,
# by default everything is 64 bit
MULTILIBS ?= ""
DEFAULTTUNE:virtclass-multilib-ilp32 =. "aarch64_ilp32:"
export ROOTFS_PACKAGE_ARCH = "aarch64"
export ROOTFS_PACKAGE_ARCH:virtclass-multilib-lib32 = "armv7l"

# qemuboot options
QB_SYSTEM_NAME = "qemu-system-aarch64"
# get the first item from IMAGE_FSTYPES
QB_DEFAULT_FSTYPE = "${@d.getVar('IMAGE_FSTYPES').split(' ')[0]}"
QB_MACHINE = "-machine virt"
QB_CPU = "-cpu cortex-a53"
QB_SMP = "-smp 4"
QB_CPU_KVM = "-cpu host -machine gic-version=3"
# For graphics to work we need to define the VGA device as well as the necessary USB devices
QB_GRAPHICS = "-device virtio-gpu-pci"
QB_OPT_APPEND = "-device qemu-xhci -device usb-tablet -device usb-kbd"
# Virtio Networking support
# QB_TAP_OPT = "-netdev tap,id=net0,ifname=@TAP@,script=no,downscript=no"
# QB_NETWORK_DEVICE = "-device virtio-net-pci,netdev=net0,mac=@MAC@"
# set network configure like openeuler guide
QB_TAP_OPT = "-netdev tap,id=tap0,script=/etc/qemu-ifup"
QB_NETWORK_DEVICE = "-device virtio-net-device,netdev=tap0"
# Virtio block device
QB_ROOTFS_OPT = "-drive id=disk0,file=@ROOTFS@,if=none,format=raw -device virtio-blk-pci,drive=disk0"
# Virtio serial console
QB_SERIAL_OPT = "-device virtio-serial-pci -chardev null,id=virtcon -device virtconsole,chardev=virtcon"
QB_TCPSERIAL_OPT = "-device virtio-serial-pci -chardev socket,id=virtcon,port=@PORT@,host=127.0.0.1 -device virtconsole,chardev=virtcon"
```

## meta-openeuler/conf/machine/qemu-aarch64_be.conf
```bitbake
# Description: Machine description for little-endian aarch64

MACHINEOVERRIDES =. "march64be:bigendian:"
DEFAULTTUNE = "aarch64_be"
require conf/machine/qemu-aarch64-common.inc

# See comments in qemu-aarch64.conf. No need
# to consider compat32 for -mbig-endian.
TUNE_CCARGS .= " -mbig-endian"

COMPAT32_MACHINEOVERRIDES_DEL =. "march64be:"
COMPAT32_MACHINEOVERRIDES_ADD =. "march32be:"
COMPAT32_DEFAULTTUNE = "armv7ab"

# See conf/machine/qemu-arm_be.conf
PACKAGE_EXTRA_ARCHS_tune-armv7ab += " armv7ab"
COMPAT32_PACKAGE_EXTRA_ARCHS = "armv7ab"

COMPAT32_QA_REMOVE += "arch"

COMPAT32_TUNE_FEATURES_APPEND += " rruarm"
```

## meta-openeuler/conf/machine/qemu-arm-common.inc
```bitbake
# Description: Conf for arm

MACHINEOVERRIDES =. "march32:"
require conf/machine/qemu-common.inc
require conf/machine/include/arm/arch-armv7a.inc

#kernel modules to install and autoload
require conf/machine/kernel-modules-conf/common.inc
INSTALLMODULES += " \
kernel-module-unix \
"
KERNEL_MODULE_AUTOLOAD = "${INSTALLMODULES}"

TUNE_FEATURES_append += " cortexa9"
TUNE_FEATURES_remove += " vfp"

TUNE_CCARGS .= " -mno-unaligned-access"
```

## meta-openeuler/conf/machine/qemu-arm.conf
```bitbake
# Description: Machine description for little-endian arm

DEFAULTTUNE = "armv7a"
require conf/machine/include/qemu-arm-common.inc

TUNE_CCARGS .= " -mlittle-endian"
export ROOTFS_PACKAGE_ARCH = "armv7l"

# qemuboot options
QB_DEFAULT_FSTYPE = "${IMAGE_FSTYPES}"
QB_SYSTEM_NAME = "qemu-system-arm"
QB_MACHINE = "-machine virt,highmem=off"
QB_CPU = "-cpu cortex-a15"
QB_SMP = "-smp 4"
# Standard Serial console
QB_KERNEL_CMDLINE_APPEND = "vmalloc=256"
# For graphics to work we need to define the VGA device as well as the necessary USB devices
QB_GRAPHICS = "-device virtio-gpu-pci"
QB_OPT_APPEND = "-device qemu-xhci -device usb-tablet -device usb-kbd"
# Virtio Networking support
# QB_TAP_OPT = "-netdev tap,id=net0,ifname=@TAP@,script=no,downscript=no"
# QB_NETWORK_DEVICE = "-device virtio-net-device,netdev=net0,mac=@MAC@"
# set network configure like openeuler guide
QB_TAP_OPT = "-netdev tap,id=tap0,script=/etc/qemu-ifup"
QB_NETWORK_DEVICE = "-device virtio-net-device,netdev=tap0"
# Virtio block device
QB_ROOTFS_OPT = "-drive id=disk0,file=@ROOTFS@,if=none,format=raw -device virtio-blk-device,drive=disk0"
# Virtio serial console
QB_SERIAL_OPT = "-device virtio-serial-device -chardev null,id=virtcon -device virtconsole,chardev=virtcon"
QB_TCPSERIAL_OPT = "-device virtio-serial-device -chardev socket,id=virtcon,port=@PORT@,host=127.0.0.1 -device virtconsole,chardev=virtcon"
```

## meta-openeuler/conf/machine/qemu-arm_be.conf
```bitbake
# Copyright (C) Huawei Technologies Co., Ltd. 2020. All rights reserved.
# Description: Machine description for little-endian aarch64
# Author: Huawei OS Kernel Lab
# Create: Sat Aug 29 02:49:36 2020

MACHINEOVERRIDES =. "march32be:bigendian:"
DEFAULTTUNE = "armv7ab"
require conf/machine/qemu-arm-common.inc

# A bug in yocto misses armv7ab in
# PACKAGE_EXTRA_ARCHS_tune-armv7ab (but armv7ab-vfp is there).
PACKAGE_EXTRA_ARCHS_tune-armv7ab += " armv7ab"
TUNE_CCARGS .= " -mbig-endian"

TUNE_FEATURES_append += ' rruarm'

ERROR_QA_remove += 'arch'
WARN_QA_remove += 'arch'
```

## meta-openeuler/conf/machine/qemu-common.inc
```bitbake
MACHINEOVERRIDES =. "eulermachine:"
KERNEL_IMAGETYPE ?= "zImage"
KERNEL_IMAGETYPE_FOR_MAKE ?= "zImage"
```

## meta-openeuler/conf/machine/qemu-riscv64.conf
```bitbake
# Description: Config for riscv64 machine

DEFAULTTUNE = "riscv64"

export ROOTFS_PACKAGE_ARCH = "riscv64"

KERNEL_IMAGETYPE = "Image"
KERNEL_IMAGETYPE_FOR_MAKE = "Image"

require conf/machine/include/riscv/tune-riscv.inc
BASE_LIB:tune-riscv64 = "lib64/lp64d"

require conf/multilib.conf
MULTILIBS ?= ""

# simplest serial console setting, no VT
SERIAL_CONSOLES ?= "115200;ttyS0"
USE_VT="0"

# qemuboot options
QB_DEFAULT_FSTYPE = "${IMAGE_FSTYPES}"
QB_SYSTEM_NAME = "qemu-system-riscv64"
QB_SMP = "-smp 4"
QB_KERNEL_CMDLINE_APPEND = "earlycon=sbi"
QB_MACHINE = "-machine virt"
QB_DEFAULT_BIOS = "fw_jump.elf"
# QB_TAP_OPT = "-netdev tap,id=net0,ifname=@TAP@,script=no,downscript=no"
# QB_NETWORK_DEVICE = "-device virtio-net-device,netdev=net0,mac=@MAC@"
# set network configure like as openeuler guidance
QB_TAP_OPT = "-netdev tap,id=tap0,script=/etc/qemu-ifup"
QB_NETWORK_DEVICE = "-device virtio-net-device,netdev=tap0"
QB_ROOTFS_OPT = "-drive id=disk0,file=@ROOTFS@,if=none,format=raw -device virtio-blk-device,drive=disk0"
QB_SERIAL_OPT = "-device virtio-serial-device -chardev null,id=virtcon -device virtconsole,chardev=virtcon"
QB_TCPSERIAL_OPT = " -device virtio-serial-device -chardev socket,id=virtcon,port=@PORT@,host=127.0.0.1 -device virtconsole,chardev=virtcon"
QB_GRAPHICS = "-device bochs-display"
QB_OPT_APPEND = "-device virtio-tablet-pci -device virtio-keyboard-pci"
```

## meta-openeuler/conf/machine/qemu-x86-64.conf
```bitbake
#@TYPE: Machine
#@NAME: QEMU x86-64 machine
#@DESCRIPTION: Machine configuration for running an x86-64 system on QEMU

DEFAULTTUNE ?= "x86-64"
require conf/machine/include/x86/arch-x86.inc

UBOOT_MACHINE ?= "qemu-x86_64_defconfig"

KERNEL_IMAGETYPE =. "bzImage"
KERNEL_IMAGETYPE_FOR_MAKE =. "bzImage"

MACHINE_FEATURES += "x86 efi isohybrid"

MACHINE_EXTRA_RRECOMMENDS = "kernel-module-snd-ens1370 kernel-module-snd-rawmidi"

# specify the suffix of packages for installation of rootfs
export ROOTFS_PACKAGE_ARCH = "x86_64"

# simplest serial console setting, no VT
SERIAL_CONSOLES ?= "115200;ttyS0"
USE_VT="0"
```

## meta-openeuler/wic/virtdisk-qemu.wks
```
# short-description: Create virtual disk rootfs for QEMU use
# long-description: If users want to reuse the data they create in first boot,
# init ram file system cannot satisfy their needs.
# Use virtual disk to provide long-last data storage.

part / --source rootfs --ondisk mmcblk0 --fstype=ext4 --label root --align 4096 --mkfs-extraopts='-E no_copy_xattrs' --size 1024
```

## rtos/meta-freertos/conf/layer.conf
```bitbake
# We have a conf and classes directory, add to BBPATH
BBPATH .= ":${LAYERDIR}"

# We have recipes-* directories, add to BBFILES
BBFILES += "${LAYERDIR}/recipes-*/*/*.bb \
	${LAYERDIR}/recipes-*/*/*.bbappend"

BBFILE_COLLECTIONS += "freertosproject"
BBFILE_PATTERN_freertosproject = "^${LAYERDIR}/"
BBFILE_PRIORITY_freertosproject = "25"

# This should only be incremented on significant changes that will
# cause compatibility issues with other layers
LAYERVERSION_freertosproject = "1"

LAYERDEPENDS:freertosproject = "core meta-python"

LAYERSERIES_COMPAT_freertosproject = "kirkstone"
```

## rtos/meta-openeuler-rtos/conf/layer.conf
```bitbake
# We have a conf and classes directory, add to BBPATH
BBPATH =. "${LAYERDIR}:"

# We have recipes-* directories, add to BBFILES
BBFILES += "${LAYERDIR}/recipes-*/*/*.bb \
            ${LAYERDIR}/recipes-*/*/*.bbappend"

BBFILE_COLLECTIONS += "openeuler-rtos"
BBFILE_PATTERN_openeuler-rtos = "^${LAYERDIR}/"
BBFILE_PRIORITY_openeuler-rtos = "25"

LAYERSERIES_COMPAT_openeuler-rtos = "kirkstone"
#no bb file under meta-openeuler-rtos, set it to 1 to ignore "No bb files" warning
BBFILE_PATTERN_IGNORE_EMPTY_openeuler-rtos = "1"


#enable RTOS specific .bb
BBFILES_DYNAMIC += " \
rtthread:${LAYERDIR}/rtthread/*.bb \
rtthread:${LAYERDIR}/rtthread/*.bbappend \
"
# Most rtos can't be built directly with xxx-linux-gcc toolchain, because of C library
# A baremetal gcc toolchain is needed. The following variables are used to
# describe the baremetal gcc toolchain. By default, Zephyr Project's toolchain
# is used and can be downloaded from Zephyr Project's github repo.
OPENEULER_RTOS_TOOLCHAIN_DIR_aarch64 ?= "${STAGING_BINDIR_TOOLCHAIN}"
OPENEULER_RTOS_TOOLCHAIN_PREFIX_aarch64 ?= "${TARGET_PREFIX}"
```

## rtos/meta-rtthread/conf/layer.conf
```bitbake
# We have a conf and classes directory, add to BBPATH
BBPATH .= ":${LAYERDIR}"

# We have recipes-* directories, add to BBFILES
BBFILES += "${LAYERDIR}/recipes-*/*.bb \
            ${LAYERDIR}/recipes-*/*.bbappend"

BBFILE_COLLECTIONS += "rtthread"
BBFILE_PATTERN_rtthread = "^${LAYERDIR}/"
BBFILE_PRIORITY_rtthread = "24"

LAYERVERSION_rtthread = "1"

LAYERDEPENDS_rtthread = "core"

LAYERSERIES_COMPAT_rtthread = "hardknott"

# rtthread is built with scons
HOSTTOOLS_append = " scons"
```

## rtos/meta-zephyr/conf/layer.conf
```bitbake
# We have a conf and classes directory, add to BBPATH
BBPATH .= ":${LAYERDIR}"

# We have recipes-* directories, add to BBFILES
BBFILES += "${LAYERDIR}/recipes-*/*/*.bb \
	${LAYERDIR}/recipes-*/*/*.bbappend"

BBFILE_COLLECTIONS += "zephyrproject"
BBFILE_PATTERN_zephyrproject = "^${LAYERDIR}/"
BBFILE_PRIORITY_zephyrproject = "6"

# This should only be incremented on significant changes that will
# cause compatibility issues with other layers
LAYERVERSION_zephyrproject = "1"

LAYERDEPENDS:zephyrproject = "core meta-python"

LAYERSERIES_COMPAT_zephyrproject = "kirkstone"
```
